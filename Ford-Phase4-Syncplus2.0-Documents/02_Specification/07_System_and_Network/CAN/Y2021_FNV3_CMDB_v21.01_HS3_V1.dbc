VERSION ""

NS_ :

BS_:

BU_: APIM_CISM APIM ESPM DSP FCIMB RACM_RCIM HUD_ADV WCM TRM_ITRM ACM GWM _delete IPC GENERIC TSTR
VAL_TABLE_ Null_Request 1 "Request" 0 "Null" ;
VAL_TABLE_ NfcMyKeyCreate_D_Stat 3 "KeyAlreadyMyKey" 2 "TapTimeOut" 1 "TapNfcCard" 0 "Null" ;
VAL_TABLE_ RoadSignRgltry_D_Dsply 3 "NoEntry" 2 "Stop" 1 "Yield" 0 "None" ;
VAL_TABLE_ SeatRelxPosSet_D_Rq 3 "NotUsed" 2 "Active" 1 "Store" 0 "Inactive" ;
VAL_TABLE_ FailSuccess 1 "Success" 0 "Fail" ;
VAL_TABLE_ AwdLckMde_D_Stat 7 "NotUsed_2" 6 "NotUsed_1" 5 "PrimaryAxleSpeedControl" 4 "DualAxleSpeedControl" 3 "EfficiencySplit" 2 "SecondaryAxleTorqueCtrl" 1 "SecondaryAxleSpeedCtrl" 0 "Off" ;
VAL_TABLE_ EngIdlShutDown_D2_Type 3 "Fleet" 2 "Keyless" 1 "Keyed" 0 "Null" ;
VAL_TABLE_ LaActAvail_D2_Actl 3 "Intervention_Available" 2 "NoIntervention_Available" 1 "Intervention_NotAvailable" 0 "NoIntervention_NotAvailabl" ;
VAL_TABLE_ LaActvStats_D2_Dsply 31 "Unused7" 30 "LA_Off" 29 "ECE_OFF_RTT" 28 "Unused4" 27 "Unused3" 26 "Unused2" 25 "Unused1" 24 "InerveneLeft_InterveneRght" 23 "WarnLeft_InterveneRight" 22 "SuppressLeft_InterveneRght" 21 "AvailLeft_InterveneRhtt" 20 "NoLeft_InterveneRight" 19 "InterveneLeft_WarnRight" 18 "WarnLeft_WarnRight" 17 "SuppressLeft_WarnRight" 16 "AvailableLeft_WarnRight" 15 "NoLeft_WarnRight" 14 "InterveneLeft_SuppressRght" 13 "WarnLeft_SuppressRight" 12 "SuppressLeft_SuppressRight" 11 "AvailLeft_SuppressRight" 10 "NoLeft_SuppressRight" 9 "InterveneLeft_AvailRight" 8 "WarnLeft_AvailRight" 7 "SuppressLeft_AvailRight" 6 "AvailableLeft_AvailRight" 5 "NoLeft_AvailableRight" 4 "InterveneLeft_NoRight" 3 "WarnLeft_NoRight" 2 "SuppressLeft_NoRight" 1 "AvailableLeft_NoRight" 0 "NoLeft_NoRight" ;
VAL_TABLE_ TlghtTestPrecnd_D2_Stat 7 "TrailerNotConnected" 6 "NotStationary" 5 "InteractionPresent" 4 "PreconditionsPassed" 3 "BattSocLessThan75Percent" 2 "TailLightsOn" 1 "IgnitionNotOn" 0 "Null" ;
VAL_TABLE_ TlghtTestLght_D2_Stat 7 "TestingRearFogLights" 6 "AllOff" 5 "TestingReverseLights" 4 "TestingBrakeLights" 3 "TestingLeftTurnSignal" 2 "TestingRightTurnSignal" 1 "ParkingLightsIlluminated" 0 "Null" ;
VAL_TABLE_ TjaCanclMsgTxt_D_Dsply 15 "NotUsed_9" 14 "NotUsed_8" 13 "NotUsed_7" 12 "NotUsed_6" 11 "NotUsed_5" 10 "NotUsed_4" 9 "NotUsed_3" 8 "NotUsed_2" 7 "NotUsed_1" 6 "DriverNotSeen2" 5 "DriverNotSeen1" 4 "HandsFreeUnavailInThisArea" 3 "HandsFreeUnavailForMaxSpd" 2 "CancelledForLaneConditions" 1 "CancelledForRoadCurvature" 0 "NoMessage" ;
VAL_TABLE_ NotPressed_PressedStuckNotUsed 3 "NotUsed" 2 "Stuck" 1 "Pressed" 0 "Not_Pressed" ;
VAL_TABLE_ GfhbMnu_D_Rq 3 "EnableADB" 2 "EnableGFHB" 1 "Disable" 0 "Null" ;
VAL_TABLE_ PwTrnkFrontRleas_D_Src 15 "NotUsed_5" 14 "NotUsed_4" 13 "NotUsed_3" 12 "NotUsed_2" 11 "NotUsed_1" 10 "SelfTest" 9 "Diagnostics" 8 "EmergencyReleaseSwitch" 7 "ManualCinch" 6 "ExteriorSwitch" 5 "IpSwitch" 4 "Cpp" 3 "Sync" 2 "Keypad" 1 "Remote" 0 "PowerOff" ;
VAL_TABLE_ EngIdlShutDown_D_Type 3 "Fleet" 2 "Keyless" 1 "Keyed" 0 "Off" ;
VAL_TABLE_ TrfcLghtType_D_Stat 3 "Faulty" 2 "DirectionalArrow" 1 "RoundBall" 0 "Inactive" ;
VAL_TABLE_ TrfcLghtOn_D_Stat 7 "Faulty" 6 "NoDataExists" 5 "NotUsed" 4 "FocusedBlink" 3 "FocusedOn" 2 "Blink" 1 "On" 0 "Inactive" ;
VAL_TABLE_ TrfcLghtColr_D_Stat 7 "Faulty" 6 "NoDataExists" 5 "NotUsed_2" 4 "NotUsed_1" 3 "Green" 2 "Orange" 1 "Red" 0 "Inactive" ;
VAL_TABLE_ VehToInfrstrctr_D_Stat 3 "SubComponentUnknownError" 2 "LostConnection" 1 "InServiceWithoutV2IData" 0 "InServiceFunctionOK" 7 "Faulty" 6 "NoDataExists" 5 "NotUsed_2" 4 "NotUsed_1" ;
VAL_TABLE_ RoadSignInfo1_D_Dsply 255 "Faulty" 254 "NoDataExists" 253 "NotUsed_219" 35 "NotUsed_1" 34 "DangerRoadAhead" 33 "WaterPipeBreak" 32 "WaterOnRoad" 31 "VehiclesInQue" 30 "VehicleBreak" 29 "TunnelInWaterAhead" 28 "TrafficControlAhead" 27 "TrafficAccidentAhead" 26 "Speedlimit_120" 25 "Speedlimit_110" 24 "Speedlimit_100" 23 "Speedlimit_90" 22 "Speedlimit_80" 21 "Speedlimit_70" 20 "Speedlimit_60" 19 "Speedlimit_50" 18 "Speedlimit_40" 17 "Speedlimit_30" 16 "Speedlimit_20" 15 "Speedlimit_10" 14 "SlipperyRoad" 13 "SandstormAhead" 12 "FrozenRoad" 11 "FireAlarmOnRoad" 10 "RoadCrack" 9 "RainOrSnowRoad" 8 "Pedestrian" 7 "GoodsDrop" 6 "GasPipeLeakWarning" 5 "FogAhead" 4 "DriveWrongWay" 3 "CrossWindAhead" 2 "RoadWorksAhead" 1 "SlowTrafficAhead" 0 "Inactive" ;
VAL_TABLE_ TrfcLghtDir_D_Stat 7 "Faulty" 6 "NoDataExists" 5 "NotUsed" 4 "UtrunActivated" 3 "RightActivated" 2 "LeftActivated" 1 "StraightActivated" 0 "Inactive" ;
VAL_TABLE_ TrfcLght_D_Stat 7 "Faulty" 6 "NoDataExists" 5 "NotUsed" 4 "Four" 3 "Three" 2 "Two" 1 "One" 0 "OffOrNoMatchedLight" ;
VAL_TABLE_ OffOn_Overruled_NotUsed_1 3 "NotUsed_1" 2 "Overruled" 1 "On" 0 "Off" ;
VAL_TABLE_ StrtrMtrCtlMsgTxt_D_Rq2 15 "Not_Used_12" 14 "Not_Used_11" 13 "Not_Used_10" 12 "Not_Used_9" 11 "Not_Used_8" 10 "Not_Used_7" 9 "Not_Used_6" 8 "Not_Used_5" 7 "Not_Used_4" 6 "Not_Used_3" 5 "Not_Used_2" 4 "Not_Used_1" 3 "Fault_UnableToStrtOrStop" 2 "PressTwiceToStart" 1 "Fault_GoToDealer" 0 "NoMessage" ;
VAL_TABLE_ BattChrgStrtStop_D2_Rq 15 "NotUsed_8" 14 "NotUsed_7" 13 "NotUsed_6" 12 "NotUsed_5" 11 "NotUsed_4" 10 "NotUsed_3" 9 "NotUsed_2" 8 "NotUsed_1" 7 "GridStopChargingPartial" 6 "GridStopChargingMandatory" 5 "GridStartChargingFree" 4 "GridStartChargingPreferred" 3 "ReturnToSettings" 2 "StopCharge" 1 "StartCharge" 0 "NoNewRequest" ;
VAL_TABLE_ Bpt_D_StatHtrn 15 "Faulty" 14 "NotUsed_8" 13 "NotUsed_7" 12 "NotUsed_6" 11 "NotUsed_5" 10 "NotUsed_4" 9 "NotUsed_3" 8 "NotUsed_2" 7 "NotUsed_1" 6 "VehicleFault" 5 "EvseFault" 4 "BptActive" 3 "Precharge" 2 "BptReady" 1 "Initialization" 0 "NotReady" ;
VAL_TABLE_ BptComm_D_RqHtrn 9 "EnergyTransferFault" 8 "EnergyTransferEnd" 7 "VehicleEnergyTransferActv" 6 "VehicleEnergyTransferReady" 5 "VehiclePreChargeReady" 4 "VehicleEnergyTransferWait" 3 "ConfirmConnection" 2 "VehicleReadyToToggle" 1 "AttemptDgtlCommunication" 0 "NoDigitalCommunication" 15 "NotUsed_6" 14 "NotUsed_5" 13 "NotUsed_4" 12 "NotUsed_3" 11 "NotUsed_2" 10 "NotUsed_1" ;
VAL_TABLE_ BptStrtStop_D_Stat 3 "NotUsed_1" 2 "Start" 1 "Stop" 0 "NoRequest" ;
VAL_TABLE_ BptMde_D_Stat 7 "NotUsed_4" 6 "NotUsed_3" 5 "NotUsed_2" 4 "NotUsed_1" 3 "Automatic" 2 "Manual" 1 "Off" 0 "Null" ;
VAL_TABLE_ OffRoadMde_D_Stat 7 "NotUsed_5" 6 "NotUsed_4" 5 "NotUsed_3" 4 "NotUsed_2" 3 "NotUsed_1" 2 "Off_Road2" 1 "Off_Road1" 0 "On_Road" ;
VAL_TABLE_ PersCtaSplitView_D_Rq 3 "EnabledFull" 2 "Enabled_180SwitchOnly" 1 "Disabled" 0 "Null" ;
VAL_TABLE_ DrvIdMde_D_Rq 7 "Faulty" 6 "NotUsed_2" 5 "NotUsed_1" 4 "DeleteMid" 3 "ClearAll" 2 "Enroll" 1 "Recognize" 0 "Disable" ;
VAL_TABLE_ DrvIdMde_D_Stat 7 "NotUsed_3" 6 "NotUsed_2" 5 "NotUsed_1" 4 "DeleteMid" 3 "ClearAll" 2 "Enroll" 1 "Recognize" 0 "Null" ;
VAL_TABLE_ Null_Fail_Success 3 "NotUsed" 2 "Success" 1 "Fail" 0 "Null" ;
VAL_TABLE_ DrvId_D_Stat 7 "NotUsed_3" 6 "NotUsed_2" 5 "NotUsed_1" 4 "FailTimeout" 3 "FailWeakMatch" 2 "OkNoMatch" 1 "OkMatched" 0 "Null" ;
VAL_TABLE_ DrvExpression_D_Stat 15 "NotUsed_5" 14 "NotUsed_4" 13 "NotUsed_3" 12 "NotUsed_2" 11 "NotUsed_1" 10 "HasRegister" 9 "ConstraintsOk" 8 "NotAFace" 7 "PoorTrackingQuality" 6 "EyesNotVisible" 5 "FaceBlockage" 4 "MouthOpen" 3 "OutsidePoseLimits" 2 "TooManyFaces" 1 "FaceNotInView" 0 "Null" ;
VAL_TABLE_ BattChrgInhbt_D2_Rq 7 "NotUsed_4" 6 "NotUsed_3" 5 "NotUsed_2" 4 "NotUsed_1" 3 "MaintainTargetSoc" 2 "EndAtTarget" 1 "InhibitCharging" 0 "Enable_Charging" ;
VAL_TABLE_ AhbFeat_D_Stat 3 "ADB" 2 "GFHB" 1 "AHBC" 0 "None" ;
VAL_TABLE_ E_Frt_Btn_Status_1st 63 "NotUsed_10" 62 "NotUsed_9" 61 "NotUsed_8" 60 "NotUsed_7" 59 "NotUsed_6" 58 "NotUsed_5" 57 "NotUsed_4" 56 "NotUsed_3" 55 "NotUsed_2" 54 "NotUsed_1" 53 "RHS_Cld_Seat3_Pressed" 52 "RHS_Cld_Seat2_Pressed" 51 "RHS_Cld_Seat1_Pressed" 50 "LHS_Cld_Seat3_Pressed" 49 "LHS_Cld_Seat2_Pressed" 48 "LHS_Cld_Seat1_Pressed" 47 "RHS_Auto_Seat_Pressed" 46 "RHS_Htd_Seat3_Pressed" 45 "RHS_Htd_Seat2_Pressed" 44 "RHS_Htd_Seat1_Pressed" 43 "RHS_Seat_Off_Pressed" 42 "LHS_Auto_Seat_Pressed" 41 "LHS_Htd_Seat3_Pressed" 40 "LHS_Htd_Seat2_Pressed" 39 "LHS_Htd_Seat1_Pressed" 38 "LHS_Seat_Off_Pressed" 37 "DrvrFcsdMde_Pressed" 36 "MdeMnu_Pressed" 35 "AAR_Pressed" 34 "Heat_Pressed" 33 "RearMnu_Pressed" 32 "FrontMnu_Pressed" 31 "Defrost_Pressed" 30 "Htg_Strg_Whl_Pressed" 29 "RHS_Cld_Seat_Pressed" 28 "LHS_Cld_Seat_Pressed" 27 "RHS_Htd_Seat_Pressed" 26 "LHS_Htd_Seat_Pressed" 25 "Max_Defrost_Pressed" 24 "My_Temp_Pressed" 23 "Front_Power_Pressed" 22 "Rear_Defrost_Pressed" 21 "Pnl_Flr_Ws_Pressed" 20 "Pnl_Ws_Pressed" 19 "Windscreen_Pressed" 18 "Htd_Frt_Wsh_Pressed" 17 "Auto_Recirc_Pressed" 16 "Outside_Pressed" 15 "Recirc_Pressed" 14 "Max_AC_Pressed" 13 "Auto_Pressed" 12 "Blwr_Dec_Pressed" 11 "Blwr_Inc_Pressed" 10 "RHS_Temp_Dec_Pressed" 9 "RHS_Temp_Inc_Pressed" 8 "LHS_Temp_Dec_Pressed" 7 "LHS_Temp_Inc_Pressed" 6 "Dual_Pressed" 5 "AC_Pressed" 4 "Floor_Ws_Pressed" 3 "Floor_Pressed" 2 "Panel_Floor_Pressed" 1 "Panel_Pressed" 0 "None_Pressed" ;
VAL_TABLE_ NavIod_D_Stat 15 "Faulty" 14 "NotUsed_9" 13 "NotUsed_8" 12 "NotUsed_7" 11 "NotUsed_6" 10 "NotUsed_5" 9 "NotUsed_4" 8 "NotUsed_3" 7 "NotUsed_2" 6 "NotUsed_1" 5 "NavigationMode_AR" 4 "NavigationMode_2D" 3 "CruiseMode_2D" 2 "OutputOn" 1 "FeatureAvailButNoOuput" 0 "FeatureNotAvailable" ;
VAL_TABLE_ NavIod_D_Rq 7 "NotUsed_5" 6 "NotUsed_4" 5 "NotUsed_3" 4 "NotUsed_2" 3 "NotUsed_1" 2 "ModeChange" 1 "VideoOutput" 0 "NoRequest" ;
VAL_TABLE_ NotDetClosedAjarDisabled 5 "NotUsed_2" 4 "NotUsed_1" 3 "Disabled" 2 "Ajar" 1 "Closed" 0 "NotDetermined" 7 "Faulty" 6 "NotUsed_3" ;
VAL_TABLE_ DcacEngOnMsgTxt_D2_Rq 15 "NotUsed_10" 14 "NotUsed_9" 13 "NotUsed_8" 12 "NotUsed_7" 11 "NotUsed_6" 10 "NotUsed_5" 9 "NotUsed_4" 8 "NotUsed_3" 7 "NotUsed_2" 6 "NotUsed_1" 5 "AeisFinalMinutesWarning" 4 "AeisDoorAjarWarning" 3 "AeisManualOverrideWarning" 2 "DisplayQuestion" 1 "DisplayWarning" 0 "Ok" ;
VAL_TABLE_ DcacChime_D_Rq 3 "NotUsed" 2 "SoftChime" 1 "InformationChime" 0 "NoChime" ;
VAL_TABLE_ NoEve_0_NotSup_FE_Faulty_FF 255 "Faulty" 254 "Not Supported" 0 "No Event" ;
VAL_TABLE_ NoEve_0_NotSup_1FFE_Faulty_1FFF 8191 "Faulty" 8190 "Not Supported" 0 "No Event" ;
VAL_TABLE_ NfcDevc_D_Dsply 15 "Message 15" 14 "Message 14" 13 "Message 13" 12 "Message 12" 11 "Message 11" 10 "Message 10" 9 "Message 9" 8 "Message 8" 7 "Message 7" 6 "Message 6" 5 "Message 5" 4 "Message 4" 3 "Message 3" 2 "Message 2" 1 "Message 1" 0 "No message" ;
VAL_TABLE_ SecondRowBuckle2 7 "Faulty" 6 "OccupiedBelted" 5 "SeatAbsent" 4 "EmptyUnbelted" 3 "OccupiedUnbelted" 2 "BatteryLow" 1 "NotDetermined" 0 "EmptyBelted" ;
VAL_TABLE_ _S_Off_On 1 "On" 0 "Off" ;
VAL_TABLE_ _S_NotSupported_Supported 1 "Supported" 0 "Not_Supported" ;
VAL_TABLE_ _S_SeekScan 1 "NoChannelsAvailable" 0 "Invalid" ;
VAL_TABLE_ _S_SDARS_ErrorConf 0 "Invalid" 2 "SDARS_OFF" 1 "SDARS_ON" ;
VAL_TABLE_ _S_Invalid_1_Locked_2_Unlocked 0 "Invalid" 2 "Unlocked" 1 "Locked" ;
VAL_TABLE_ _S_ChannelUpdate 3 "NotUsed_1" 2 "NewUpdatesAvailable" 1 "NoUpdates" 0 "Inactive" ;
VAL_TABLE_ _S_Invld_1_Inactv_2_Actv 0 "Invalid" 2 "Active" 1 "Inactive" ;
VAL_TABLE_ _S_Inctve_1_Enbl_2_Disbl 2 "Disable" 1 "Enable" 0 "Inactive" ;
VAL_TABLE_ _S_Invalid_1F_NoActivePreset 31 "NoActivePreset" 0 "Invalid" ;
VAL_TABLE_ _S_Invalid_1_Off_2_On 0 "Invalid" 1 "Off" 2 "On" ;
VAL_TABLE_ _S_NoUpdate_Update 1 "Update" 0 "NoUpdate" ;
VAL_TABLE_ _S_InactiveActive 1 "Active" 0 "Inactive" ;
VAL_TABLE_ _S_InfotainmentVer_C 0 "Invalid" 1 "C214Cd132My2003" 2 "C307My2004" ;
VAL_TABLE_ _S_DSPProgram 7 "Reserved2" 6 "Reserved1" 5 "Voice" 4 "Rock" 0 "Invalid" 1 "Normal" 2 "Pop" 3 "Classical" ;
VAL_TABLE_ _S_ChimeID_8bit 255 "Id255" 254 "Id254" 253 "Id253" 252 "Id252" 251 "Id251" 250 "Id250" 249 "Id249" 248 "Id248" 247 "Id247" 246 "Id246" 245 "Id245" 244 "Id244" 243 "Id243" 242 "Id242" 241 "Id241" 240 "Id240" 239 "Id239" 238 "Id238" 237 "Id237" 236 "Id236" 235 "Id235" 234 "Id234" 233 "Id233" 232 "Id232" 231 "Id231" 230 "Id230" 229 "Id229" 228 "Id228" 227 "Id227" 226 "Id226" 225 "Id225" 224 "Id224" 223 "Id223" 222 "Id222" 221 "Id221" 220 "Id220" 219 "Id219" 218 "Id218" 217 "Id217" 216 "Id216" 215 "Id215" 214 "Id214" 213 "Id213" 212 "Id212" 211 "Id211" 210 "Id210" 209 "Id209" 208 "Id208" 207 "Id207" 206 "Id206" 205 "Id205" 204 "Id204" 203 "Id203" 202 "Id202" 201 "Id201" 200 "Id200" 199 "Id199" 198 "Id198" 197 "Id197" 196 "Id196" 195 "Id195" 194 "Id194" 193 "Id193" 192 "Id192" 191 "Id191" 190 "Id190" 189 "Id189" 188 "Id188" 187 "Id187" 186 "Id186" 185 "Id185" 184 "Id184" 183 "Id183" 182 "Id182" 181 "Id181" 180 "Id180" 179 "Id179" 178 "Id178" 177 "Id177" 176 "Id176" 175 "Id175" 174 "Id174" 173 "Id173" 172 "Id172" 171 "Id171" 170 "Id170" 169 "Id169" 168 "Id168" 167 "Id167" 166 "Id166" 165 "Id165" 164 "Id164" 163 "Id163" 162 "Id162" 161 "Id161" 160 "Id160" 159 "Id159" 158 "Id158" 157 "Id157" 156 "Id156" 155 "Id155" 154 "Id154" 153 "Id153" 152 "Id152" 151 "Id151" 150 "Id150" 149 "Id149" 148 "Id148" 147 "Id147" 146 "Id146" 145 "Id145" 144 "Id144" 143 "Id143" 142 "Id142" 141 "Id141" 140 "Id140" 139 "Id139" 138 "Id138" 137 "Id137" 136 "Id136" 135 "Id135" 134 "Id134" 133 "Id133" 132 "Id132" 131 "Id131" 130 "Id130" 129 "Id129" 128 "Id128" 127 "Id127" 126 "Id126" 125 "Id125" 124 "Id124" 123 "Id123" 122 "Id122" 121 "Id121" 120 "Id120" 119 "Id119" 118 "Id118" 117 "Id117" 116 "Id116" 115 "Id115" 114 "Id114" 113 "Id113" 112 "Id112" 111 "Id111" 110 "Id110" 109 "Id109" 108 "Id108" 107 "Id107" 106 "Id106" 105 "Id105" 104 "Id104" 103 "Id103" 102 "Id102" 101 "Id101" 100 "Id100" 99 "Id99" 98 "Id98" 97 "Id97" 96 "Id96" 95 "Id95" 94 "Id94" 93 "Id93" 92 "Id92" 91 "Id91" 90 "Id90" 89 "Id89" 88 "Id88" 87 "Id87" 86 "Id86" 85 "Id85" 84 "Id84" 83 "Id83" 82 "Id82" 81 "Id81" 80 "Id80" 79 "Id79" 78 "Id78" 77 "Id77" 76 "Id76" 75 "Id75" 74 "Id74" 73 "Id73" 72 "Id72" 71 "Id71" 70 "Id70" 69 "Id69" 68 "Id68" 67 "Id67" 66 "Id66" 65 "Id65" 64 "Id64" 63 "Id63" 62 "Id62" 61 "Id61" 60 "Id60" 59 "Id59" 58 "Id58" 57 "Id57" 56 "Id56" 55 "Id55" 54 "Id54" 53 "Id53" 52 "Id52" 51 "Id51" 50 "Id50" 49 "Id49" 48 "Id48" 47 "Id47" 46 "Id46" 45 "Id45" 44 "Id44" 43 "Id43" 42 "Id42" 41 "Id41" 40 "Id40" 39 "Id39" 38 "Id38" 37 "Id37" 36 "Id36" 35 "Id35" 34 "Id34" 33 "Id33" 32 "Id32" 31 "Id31" 30 "Id30" 29 "Id29" 28 "Id28" 27 "Id27" 26 "Id26" 25 "Id25" 24 "Id24" 23 "Id23" 22 "Id22" 21 "Id21" 20 "Id20" 19 "Id19" 18 "Id18" 17 "Id17" 16 "Id16" 15 "Id15" 14 "Id14" 13 "Id13" 12 "Id12" 11 "Id11" 10 "Id10" 9 "Id9" 8 "Id8" 7 "Id7" 6 "Id6" 5 "Id5" 4 "Id4" 3 "Id3" 2 "Id2" 1 "Id1" 0 "Inactive" ;
VAL_TABLE_ _S_Inactive_1_NotSupp_2_Supp 3 "NotUsed_1" 2 "Supported" 1 "NotSupported" 0 "Inactive" ;
VAL_TABLE_ HvacCmprLim_D_Stat 7 "NotUsed_2" 6 "NotUsed_1" 5 "CompressorHeadPressure" 4 "AvailableTorque" 3 "PedalPosition" 2 "RPM" 1 "ECT" 0 "NoLimit" ;
VAL_TABLE_ EvseDcChrgIso_D_Stat 7 "Faulty" 6 "NoDataExists" 5 "NotUsed_3" 4 "NotUsed_2" 3 "NotUsed_1" 2 "Valid" 1 "Warning" 0 "Invalid" ;
VAL_TABLE_ SelectedNumOfPresets 31 "Reserved" 30 "Preset30" 4 "Preset4" 3 "Preset3" 2 "Preset2" 1 "Preset1" 0 "Inactive" ;
VAL_TABLE_ MultimediaRepeat_D_Stat 3 "RepeatOn" 2 "RepeatOff" 1 "RepeatOne" 0 "Null" ;
VAL_TABLE_ MultimediaSrc_D_Stat 10 "BaiduCarlife" 9 "AndroidAuto" 8 "CarPlay" 7 "AppLink" 6 "LineIn" 5 "BluetoothAudio" 4 "WiFi" 3 "SdCard" 2 "Usb" 1 "AudioVideoln" 0 "Null" ;
VAL_TABLE_ VehOnSrc_D_Stat 15 "NotUsed_11" 14 "NotUsed_10" 13 "NotUsed_9" 12 "NotUsed_8" 11 "NotUsed_7" 10 "NotUsed_6" 9 "EsclRssd" 8 "AutonomousVehicle" 7 "SecureIdle" 6 "FleetVehicleInhibit" 5 "StolenVehicleInhibit" 4 "OverTheAir" 3 "RemoteParkAssist" 2 "RemoteStart" 1 "Manual" 0 "Off" ;
VAL_TABLE_ OfbChrgSetSync_D_Rq 3 "Fail" 2 "Success" 1 "InProgress" 0 "NoSyncInProgress" ;
VAL_TABLE_ WrlssAcsyChrgr_D_Stat 7 "NotUsed" 6 "Misalignment" 5 "Overheat" 4 "MetalObjectDetected" 3 "ChargingComplete" 2 "ChargingInProgress" 1 "ChargingNotInProgress" 0 "Null" ;
VAL_TABLE_ NoMessage_Msg1_63 31 "Message31" 30 "Message30" 29 "Message29" 28 "Message28" 27 "Message27" 26 "Message26" 25 "Message25" 24 "Message24" 23 "Message23" 22 "Message22" 21 "Message21" 20 "Message20" 19 "Message19" 18 "Message18" 17 "Message17" 16 "Message16" 15 "Message15" 14 "Message14" 13 "Message13" 12 "Message12" 11 "Message11" 10 "Message10" 9 "Message9" 8 "Message8" 7 "Message7" 6 "Message6" 5 "Message5" 4 "Message4" 3 "Message3" 2 "Message2" 1 "Message1" 0 "NoMessage" 63 "Message63" 47 "Message47" ;
VAL_TABLE_ TrlrRvrseEnbl_D2_Stat 7 "NotUsed" 6 "TbaActiveExpertActive" 5 "TbaActiveExpertAvail" 4 "TbaOffTrgActive" 3 "TbaOffTrgSetup" 2 "TbaSetup" 1 "TbaActive" 0 "Inactive" ;
VAL_TABLE_ Off_On_FlashChime 7 "NotUsed_5" 6 "NotUsed_4" 5 "NotUsed_3" 4 "NotUsed_2" 3 "NotUsed_1" 2 "FlashChime" 1 "On" 0 "Off" ;
VAL_TABLE_ DieslPrtcWarn_D_Rq 15 "NotUsed_4" 14 "NotUsed_3" 13 "NotUsed_2" 12 "NotUsed_1" 11 "OCR_ExhFilterClean_Stopped" 10 "OCR_ExhFilterCleaned" 9 "RgnOff_AtLimit" 8 "RgnOff_OverLoaded" 7 "RgnOff_Loaded" 6 "Exhaust_Filter_Full" 5 "DPF_OverLimit" 4 "DPF_AtLimit" 3 "ExhFilter_Drive_Completed" 2 "Cleaning_Exhaust_Filter" 1 "DPF_OverLoaded" 0 "DPF_Normal_Operation" ;
VAL_TABLE_ StrtrMtrCtlMsgTxt_D2_Rq 3 "NoRequestPcmStartingMsgCtl" 2 "ShiftToNeutralToStart" 1 "ShiftToParkToStart" 0 "NoRequestBcmStartingMsgCtl" ;
VAL_TABLE_ InvalidNotSupported_FE_FF 255 "NotSupported" 254 "Invalid" ;
VAL_TABLE_ PaakMyKey_D_Rq 3 "NotUsed" 2 "ConfirmNewPaakMyKey" 1 "RequestNewPaakMyKey" 0 "None" ;
VAL_TABLE_ PaakMyKeySearch_D_Stat 7 "PhoneErased" 6 "LockButtonTimeOut" 5 "PressLockButton" 4 "ConfirmHmi" 3 "MyKeyPaakFound" 2 "StandardPaakFound" 1 "NoValidPaakFound" 0 "Null" ;
VAL_TABLE_ DcChrgRdy_D_Stat 15 "Faulty" 14 "NotUsed_4" 13 "NotUsed_3" 12 "NotUsed_2" 11 "CableCheck" 10 "EvseFault" 9 "EvseNotCompatible" 8 "EvsePaused" 7 "GbtPrecharge" 6 "ChargeComplete" 5 "Charging" 4 "Precharge" 3 "WeldCheck" 2 "ChargeReady" 1 "Initialization" 0 "NotReady" ;
VAL_TABLE_ TrlrIdType_D_Stat 3 "Gooseneck" 2 "FifthWheel" 1 "Conventional" 0 "Null" ;
VAL_TABLE_ TrlrAidSetup_D2_Rq 15 "NotUsed_9" 14 "NotUsed_8" 13 "NotUsed_7" 12 "NotUsed_6" 11 "NotUsed_5" 10 "NotUsed_4" 9 "NotUsed_3" 8 "NotUsed_2" 7 "NotUsed_1" 6 "CompleteSetup" 5 "ReturnToSetup" 4 "StickerNotCircled" 3 "ConfirmSetup" 2 "EndSetup" 1 "BeginSetup" 0 "Inactive" ;
VAL_TABLE_ TrlrAidEnbl_D2_Rq 7 "NotUsed_4" 6 "NotUsed_3" 5 "NotUsed_2" 4 "NotUsed_1" 3 "Deactivate" 2 "ActivateTrg" 1 "ActivateTba" 0 "Inactive" ;
VAL_TABLE_ SwitchNotActive_Active 1 "Switch_Active" 0 "Switch_Not_Active" ;
VAL_TABLE_ DgtlCommGtwyMde_D_Stat 11 "NotUsed_3" 10 "DgtlCommFailed" 9 "DgtlCommEstablished" 8 "Inactive" 7 "RestartRequest" 6 "AcPnc_Eim" 5 "AcPnc" 4 "AcEim" 3 "DcPnc_Eim" 2 "DcPnc" 1 "DcEim" 0 "NotDetected" 15 "NotUsed_7" 14 "NotUsed_6" 13 "NotUsed_5" 12 "NotUsed_4" ;
VAL_TABLE_ InvalidValidWarningFaulty 3 "Faulty" 2 "Warning" 1 "Valid" 0 "Invalid" ;
VAL_TABLE_ BattTracType_D_Actl 15 "NotUsed_7" 14 "NotUsed_6" 13 "NotUsed_5" 12 "NotUsed_4" 11 "NotUsed_3" 10 "NotUsed_2" 9 "NotUsed_1" 8 "Other" 7 "LithiumTitanateOxide" 6 "LithiumIonPolymer" 5 "TernaryMaterial" 4 "LithiumCobaltOxide" 3 "LithiumManganese" 2 "LithiumIronPhosphate" 1 "NickelMetalHydride" 0 "LeadAcid" ;
VAL_TABLE_ NoSelect_LowMed_High 3 "High" 2 "Medium" 1 "Low" 0 "NoSelection" ;
VAL_TABLE_ LcwaMsgTxt_D_Stat 3 "SodXFaulty" 2 "SodXBlocked" 1 "TrailerConnected" 0 "NoMessage" ;
VAL_TABLE_ Level_0_3 3 "Level_3" 2 "Level_2" 1 "Level_1" 0 "Level_0" ;
VAL_TABLE_ SteWhlSwtchMde_D_Stat 3 "NotUsed_2" 2 "NotUsed_1" 1 "Dialog" 0 "Domain" ;
VAL_TABLE_ SeatMasgDrvRr_D_Stat 15 "NotUsed_10" 14 "NotUsed_9" 13 "NotUsed_8" 12 "NotUsed_7" 11 "NotUsed_6" 10 "Pattern10" 9 "Pattern9" 8 "Pattern8" 7 "Pattern7" 6 "Pattern6" 5 "Pattern5" 4 "Pattern4" 3 "Pattern3" 2 "Pattern2" 1 "Pattern1" 0 "Null" ;
VAL_TABLE_ TrlrRvrse_D_Stat 3 "Faulty" 2 "TrailerReverseGuidanceLite" 1 "On" 0 "Off" ;
VAL_TABLE_ TrlrAid_D2_Stat 15 "Faulty" 14 "NotUsed_4" 13 "NotUsed_3" 12 "NotUsed_2" 11 "NotUsed_1" 10 "DirtyCamera" 9 "IncorrectLighting" 8 "TrackingLost" 7 "TrackingUnknownConfidence" 6 "TrackingHighConfidence" 5 "TrackingMediumConfidence" 4 "TrackingLowConfidence" 3 "TurnRequested" 2 "DriveStraighRequested" 1 "Initializing" 0 "NotTracking" ;
VAL_TABLE_ AwdDrvMde_D2 15 "Faulty" 14 "NotUsed_7" 13 "NotUsed_6" 12 "NotUsed_5" 11 "NotUsed_4" 10 "NotUsed_3" 9 "NotUsed_2" 8 "NotUsed_1" 7 "NotAvailable" 6 "TowHaul" 5 "RockCrawl" 4 "Baja" 3 "MudAndSand" 2 "Weather" 1 "Sport" 0 "Normal" ;
VAL_TABLE_ TrlrAidSetup_D2_Stat 7 "NotUsed_2" 6 "NotUsed_1" 5 "SetupAcquisitionSuccess" 4 "TbaTadMonitor" 3 "SetupStartAcquisition" 2 "SetupPrepForAcquisition" 1 "TbaActive" 0 "Null" ;
VAL_TABLE_ CamraRearOn_D2_Stat2 7 "Faulty" 6 "NotUsed_3" 5 "NotUsed_2" 4 "NotUsed_1" 3 "Decommission" 2 "Activate" 1 "Deactivate" 0 "Null" ;
VAL_TABLE_ BattChrgTrgtSoC_D_Rq 7 "Percent_50" 6 "Percent_60" 5 "Percent_70" 4 "Percent_80" 3 "Percent_85" 2 "Percent_90" 1 "Percent_95" 0 "Percent_100" ;
VAL_TABLE_ OffNormalSoft 3 "NotUsed" 2 "Soft" 1 "Normal" 0 "Off" ;
VAL_TABLE_ OffOnDisabledInhibited 3 "Inhibited" 2 "Disabled" 1 "On" 0 "Off" ;
VAL_TABLE_ KeyPadCodeProg_D_Rq 7 "NotUsed_3" 6 "NotUsed_2" 5 "NotUsed_1" 4 "DeleteAll" 3 "Delete" 2 "Add" 1 "ProgrammingMode" 0 "Null" ;
VAL_TABLE_ SldrrMsgTxt_D2_Rq 7 "NotUsed_3" 6 "NotUsed_2" 5 "NotUsed_1" 4 "SlidingDrCalibNeeded2" 3 "SlidingDrOpenCltchReleased" 2 "SlidingDrCalibNeeded" 1 "SlidingDrClutchReleased" 0 "Null" ;
VAL_TABLE_ FobTrgtZone_D_Rq 15 "NotUsed_9" 14 "NotUsed_8" 13 "NotUsed_7" 12 "NotUsed_6" 11 "NotUsed_5" 10 "NotUsed_4" 9 "NotUsed_3" 8 "NotUsed_2" 7 "NotUsed_1" 6 "Approach" 5 "RearInterior" 4 "RearExterior" 3 "Passenger" 2 "Driver" 1 "Interior" 0 "Null" ;
VAL_TABLE_ FobTrgtType_D_Rq 7 "NotUsed_4" 6 "NotUsed_3" 5 "NotUsed_2" 4 "NotUsed_1" 3 "Polling" 2 "Registry" 1 "Crypto" 0 "Null" ;
VAL_TABLE_ DgtlCommGtwyMde_D_Rq 15 "NotUsed_10" 14 "NotUsed_9" 13 "NotUsed_8" 12 "NotUsed_7" 11 "NotUsed_6" 10 "NotUsed_5" 9 "NotUsed_4" 8 "NotUsed_3" 7 "NotUsed_2" 6 "NotUsed_1" 5 "AcPnC" 4 "AcEIM" 3 "DcPnC" 2 "DcEIM" 1 "AttemptDgtlComm" 0 "NoDgtlComm" ;
VAL_TABLE_ BattDcCnnct_D_Cmd 7 "NotUsed_3" 6 "NotUsed_2" 5 "NotUsed_1" 4 "WeldCheck" 3 "OkToDischarge" 2 "Closed" 1 "Precharge" 0 "Open" ;
VAL_TABLE_ SeatPsngrMem_D_Cmd 15 "NotUsed_7" 14 "NotUsed_6" 13 "NotUsed_5" 12 "NotUsed_4" 11 "NotUsed_3" 10 "NotUsed_2" 9 "NotUsed_1" 8 "RECALL_4" 7 "RECALL_3" 6 "RECALL_2" 5 "RECALL_1" 4 "STORE_4" 3 "STORE_3" 2 "STORE_2" 1 "STORE_1" 0 "Null" ;
VAL_TABLE_ Null_Inactive_Active 3 "NotUsed" 2 "Active" 1 "Inactive" 0 "Null" ;
VAL_TABLE_ Null_Yes 1 "Yes" 0 "Null" ;
VAL_TABLE_ Null_NoFault_Fault 3 "NotUsed" 2 "Fault" 1 "NoFault" 0 "Null" ;
VAL_TABLE_ ModemReset_D_Stat 15 "NotUsed_10" 14 "NotUsed_9" 13 "NotUsed_8" 12 "NotUsed_7" 11 "NotUsed_6" 10 "NotUsed_5" 9 "NotUsed_4" 8 "NotUsed_3" 7 "NotUsed_2" 6 "NotUsed_1" 5 "WifiHotSpotResetComplete" 4 "CcsResetComplete" 3 "OnlineTrafficResetComplete" 2 "PaakResetComplete" 1 "ResetNotComplete" 0 "Null" ;
VAL_TABLE_ ModemReset_D_Rq 15 "NotUsed_11" 14 "NotUsed_10" 13 "NotUsed_9" 12 "NotUsed_8" 11 "NotUsed_7" 10 "NotUsed_6" 9 "NotUsed_5" 8 "NotUsed_4" 7 "NotUsed_3" 6 "BrandConnectReset2" 5 "BrandConnectReset1" 4 "CcsReset" 3 "OnlineTrafficReset" 2 "PaakReset" 1 "WifiHotspotReset" 0 "Null" ;
VAL_TABLE_ RstrnOnPsngr_D_RqMnu 15 "Faulty" 14 "NotUsed_11" 13 "NotUsed_10" 12 "ConfiguredOff" 11 "NotUsed_9" 10 "On" 9 "NotUsed_8" 8 "NotUsed_7" 7 "NotUsed_6" 6 "NotUsed_5" 5 "Off" 4 "NotUsed_4" 3 "NotUsed_3" 2 "NotUsed_2" 1 "NotUsed_1" 0 "NoAction" ;
VAL_TABLE_ PwStepLeft_D_Rq 1 "Deploy" 0 "Null" 3 "NotUsed" 2 "Stow" ;
VAL_TABLE_ SldrlUnlckSwtch_D_Stat 3 "InnerHandle" 2 "RearInteriorSwitch" 1 "IpSwitch" 0 "Null" ;
VAL_TABLE_ SldrlChime_D_Rq 7 "NotUsed3" 6 "NotUsed2" 5 "NotUsed1" 4 "Warning" 3 "WarningRepeated" 2 "Programming" 1 "Operation" 0 "Off" ;
VAL_TABLE_ Sldrl_D_Stat 3 "NotCalibrated" 2 "Closing" 1 "Opening" 0 "NotMoving" ;
VAL_TABLE_ NoReq_AutoUp_Stop 3 "NotUsed" 2 "Stop" 1 "AutoUp" 0 "NoRequest" ;
VAL_TABLE_ BalrSnsLeft_D_Falt 3 "Invalid" 2 "SystemFailure" 1 "Blocked" 0 "Clear" ;
VAL_TABLE_ Null_Low_Med_High 3 "High" 2 "Medium" 1 "Low" 0 "Null" ;
VAL_TABLE_ Null_NotPressed_Pressed 3 "NotUsed" 2 "Pressed" 1 "NotPressed" 0 "Null" ;
VAL_TABLE_ Low_Med_High 3 "NotUsed" 2 "High" 1 "Medium" 0 "Low" ;
VAL_TABLE_ Null_NotAvail_Avail 3 "NotUsed" 2 "Available" 1 "NotAvailable" 0 "Null" ;
VAL_TABLE_ ChrgToPcWkndSav_D_Stat 7 "Percent_50" 6 "Percent_60" 5 "Percent_70" 4 "Percent_80" 3 "Percent_85" 2 "Percent_90" 1 "Percent_95" 0 "Percent_100" ;
VAL_TABLE_ ChrgGoTMnte_D_Stat 15 "NotUsed_4" 14 "NotUsed_3" 13 "NotUsed_2" 12 "NotUsed_1" 11 "Minute_55" 10 "Minute_50" 9 "Minute_45" 8 "Minute_40" 7 "Minute_35" 6 "Minute_30" 5 "Minute_25" 4 "Minute_20" 3 "Minute_15" 2 "Minute_10" 1 "Minute_5" 0 "Minute_0" ;
VAL_TABLE_ NoData_Faulty_1E_1F 31 "Faulty" 30 "NoDataExists" ;
VAL_TABLE_ PwFlwBatt_D_Dsply 15 "NotUsed_8" 14 "NotUsed_7" 13 "NotUsed_6" 12 "NotUsed_5" 11 "NotUsed_4" 10 "NotUsed_3" 9 "NotUsed_2" 8 "NotUsed_1" 7 "FlwFromWallToBatt" 6 "FlwFromAllWhlsToBatt" 5 "FlwFromBattToAllWhls" 4 "FlwFromFrontWhlsToBatt" 3 "FlwFromBattToFrontWhls" 2 "FlwFromRearWhlsToBatt" 1 "FlwFromBattToRearWhls" 0 "NoFlow" ;
VAL_TABLE_ PwFlwFuelDrv_D_Dsply 7 "NotUsed_4" 6 "NotUsed_3" 5 "NotUsed_2" 4 "NotUsed_1" 3 "FlwFromFuelToAllWhls" 2 "FlwFromFuelToFrontWhls" 1 "FlwFromFuelToRearWhls" 0 "NoFlow" ;
VAL_TABLE_ TrlrAidMsgTxt_D2_Rq 63 "Message63" 62 "Message62" 61 "Message61" 60 "Message60" 55 "Message55" 50 "Message50" 45 "Message45" 40 "Message40" 35 "Message35" 31 "Message31" 30 "Message30" 29 "Message29" 28 "Message28" 27 "Message27" 26 "Message26" 25 "Message25" 24 "Message24" 23 "Message23" 22 "Message22" 21 "Message21" 20 "Message20" 19 "Message19" 18 "Message18" 17 "Message17" 16 "Message16" 15 "Message15" 14 "Message14" 13 "Message13" 12 "Message12" 11 "Message11" 10 "Message10" 9 "Message9" 8 "Message8" 7 "Message7" 6 "Message6" 5 "Message5" 4 "Message4" 3 "Message3" 2 "Message2" 1 "Message1" 0 "NoMessage" ;
VAL_TABLE_ TrlrAidEnbl_D2_Stat 7 "NotUsed_1" 6 "TbaActiveExpertActive" 5 "TbaActiveExpertAvail" 4 "TbaOffTrgActive" 3 "TbaOffTrgSetup" 2 "TbaSetup" 1 "TbaActive" 0 "Inactive" ;
VAL_TABLE_ RbaCta_D_Stat 7 "Faulty" 6 "NotUsed_2" 5 "NotUsed_1" 4 "Invalid" 3 "Disabled" 2 "On" 1 "Trailer_Tow_Off" 0 "Off" ;
VAL_TABLE_ NoRequest_Mode1_2_3 3 "Mode_3" 2 "Mode_2" 1 "Mode_1" 0 "NoRequest" ;
VAL_TABLE_ RvltnMatchAllw_D_Stat 3 "RevolutionMatchDisabled" 2 "RevolutionMatchEnabled" 1 "ChangeWithDriveMode" 0 "NoSelection" ;
VAL_TABLE_ SeatFnChng2 15 "Faulty" 14 "NotUsed9" 13 "NotUsed8" 12 "NotUsed7" 11 "NotUsed6" 10 "High_2" 9 "Med_2" 8 "Low_2" 7 "Off_2" 6 "High" 5 "Low" 4 "Off" 3 "Decrease" 2 "Increase" 1 "NotUsed1" 0 "Inactive" ;
VAL_TABLE_ BattTracCnnct_D_Cmd 7 "NotUsed_3" 6 "NotUsed_2" 5 "NotUsed_1" 4 "WeldCheck" 3 "OkToDischarge" 2 "Closed" 1 "Precharge" 0 "Open" ;
VAL_TABLE_ Faulty_1F 31 "Faulty" ;
VAL_TABLE_ NotDiagnose_FailPass 3 "NotUsed" 2 "Pass" 1 "Fail" 0 "Not_Diagnose_Yet" ;
VAL_TABLE_ Null_Off_UnavailFaulty 3 "Faulty" 2 "Unavailable" 1 "Off" 0 "Null" ;
VAL_TABLE_ OffOnDisabledNotUsed 3 "NotUsed" 2 "Disabled" 1 "On" 0 "Off" ;
VAL_TABLE_ OffGraphicTextBoth 3 "Both" 2 "Text" 1 "Graphic" 0 "Off" ;
VAL_TABLE_ NoneInactiveActive_NotUsed 3 "NotUsed" 2 "Active" 1 "Inactive" 0 "None" ;
VAL_TABLE_ Off_On_NotUsed 3 "NotUsed_2" 2 "NotUsed_1" 1 "On" 0 "Off" ;
VAL_TABLE_ BrkAppl_D_RqPt 3 "BrakesSlowRelease" 2 "BrakesFastRelease" 1 "BrakesEngage" 0 "NotActive" ;
VAL_TABLE_ SeatLmbr_D_Rq 15 "NotUsed_7" 14 "NotUsed_6" 13 "NotUsed_5" 12 "NotUsed_4" 11 "NotUsed_3" 10 "NotUsed_2" 9 "NotUsed_1" 8 "PassengerDown" 7 "PassengerUp" 6 "PassengerAft" 5 "PassengerFore" 4 "DriverDown" 3 "DriverUp" 2 "DriverAft" 1 "DriverFore" 0 "Null" ;
VAL_TABLE_ Inactive_Enable_Disable 0 "Inactive" 2 "Disable" 1 "Enable" ;
VAL_TABLE_ PmSnsCabn_D_Stat 7 "NotUsed_1" 6 "IntermittentInhibit" 5 "NoIssue" 4 "BlankField" 3 "ReplaceSensor" 2 "CleanSensor" 1 "Unsupported" 0 "Initializing" ;
VAL_TABLE_ Mtr2State_D_ActlMntr 7 "Faulty" 6 "NoDataExists" 5 "NotUsed_1" 4 "ReadinessState" 3 "DeactivationState" 2 "PowerGeneration" 1 "PowerConsumption" 0 "Null" ;
VAL_TABLE_ HybVehMde_D_ActlMntr 7 "Faulty" 6 "NoDataExists" 5 "NotUsed_2" 4 "NotUsed_1" 3 "Fuel" 2 "HybridElectric" 1 "AllElectric" 0 "Null" ;
VAL_TABLE_ ChrgStat_D_ActlMntr 7 "Faulty" 6 "NoDataExists" 5 "NotUsed" 4 "ChargingCompleted" 3 "NotCharging" 2 "ChargingInDrivingState" 1 "ChargingInParkingState" 0 "Null" ;
VAL_TABLE_ Null_HiPower_Low_Med 3 "MediumPower" 2 "LowPower" 1 "HighPower" 0 "Null" ;
VAL_TABLE_ Inactive_Enable_Disable_NotUsed 0 "Inactive" 2 "Disable" 1 "Enable" ;
VAL_TABLE_ Inactive_OffOn_NotUsed 0 "Inactive" 1 "Off" 2 "On" 3 "NotUsed" ;
VAL_TABLE_ Null_NotPressed_Faulty 3 "Faulty" 2 "Pressed" 1 "NotPressed" 0 "Null" ;
VAL_TABLE_ Null_Off_LowMedHigh 7 "NotUsed_3" 6 "NotUsed_2" 5 "NotUsed_1" 4 "High" 3 "Medium" 2 "Low" 1 "Off" 0 "Null" ;
VAL_TABLE_ SeatMasgDrv_D_Stat 15 "NotUsed_10" 14 "NotUsed_9" 13 "NotUsed_8" 12 "NotUsed_7" 11 "NotUsed_6" 10 "Pattern10" 9 "Pattern9" 8 "Pattern8" 7 "Pattern7" 6 "Pattern6" 5 "Pattern5" 4 "Pattern4" 3 "Pattern3" 2 "Pattern2" 1 "Pattern1" 0 "Null" ;
VAL_TABLE_ TrailCtl_D_Stat 7 "Faulty" 6 "DescentOnly" 5 "EnabledDeny" 4 "StandbyOverThreshold" 3 "StandbyOverride" 2 "Active" 1 "EnabledDescent" 0 "Off" ;
VAL_TABLE_ Faulty_3F 63 "Faulty" ;
VAL_TABLE_ ChimeId_No_Rq 255 "Id255" 250 "Id250" 240 "Id240" 220 "Id220" 200 "Id200" 180 "Id180" 160 "Id160" 140 "Id140" 120 "Id120" 100 "Id100" 90 "Id90" 80 "Id80" 70 "Id70" 60 "Id60" 50 "Id50" 40 "Id40" 30 "Id30" 20 "Id20" 10 "Id10" 1 "Id1" 0 "Inactive" ;
VAL_TABLE_ ClimtSeat_D_Rq 128 "H3_High_Heat_MAX" 64 "H2_Medium_Heat" 32 "H1_Low_Heat" 16 "C3_High_Cool_MAX" 8 "C2_Medium_Cool" 4 "C1_Low_Cool" 2 "Off" ;
VAL_TABLE_ ChrgOvrdExitScrn_D_Rq 3 "NotUsed_1" 2 "Request_override" 1 "Do_not_request_override" 0 "Inactive" ;
VAL_TABLE_ NoData_Faulty_FFFFFFFFFFFE_FF -1 "Faulty_FFFFFFFFFFFF" -2 "NoDataExists_FFFFFFFFFFFE" ;
VAL_TABLE_ AirAmbTePlgIn_D_Dsply 3 "NotUsed" 2 "Hot_Outside_Plg_In_Msg" 1 "Cold_Outside_Plg_In_Msg" 0 "No_Plg_In_Msg" ;
VAL_TABLE_ NoFault_Fault 1 "Fault" 0 "NoFault" ;
VAL_TABLE_ ClimtRearView_D_Stat 3 "ThirdRow" 2 "SecondRow" 1 "Both" 0 "NotDisplayed" ;
VAL_TABLE_ OtaTrg_D_Stat 3 "NotUsed_1" 2 "Accepted" 1 "NotAccepted" 0 "Null" ;
VAL_TABLE_ EdmMsgTxt_D_Rq 15 "NotUsed_4" 14 "NotUsed_3" 13 "NotUsed_2" 12 "NotUsed_1" 11 "OverallGoodScore" 10 "WorkOnCompliance" 9 "GoodCompliance" 8 "WorkOnGearShifting" 7 "GoodGearShifting" 6 "WorkOnEfficientSpeed" 5 "GoodEfficientSpeed" 4 "WorkOnDeceleration" 3 "GoodDeceleration" 2 "WorkOnAcceleration" 1 "GoodAcceleration" 0 "NoMessage" ;
VAL_TABLE_ EdmLamp_D_Dsply 15 "NotUsed_7" 14 "NotUsed_6" 13 "NotUsed_5" 12 "NotUsed_4" 11 "NotUsed_3" 10 "NotUsed_2" 9 "NotUsed_1" 8 "CoastingEngineBrake" 7 "CoastingShiftToNeutral" 6 "FreewayJunction" 5 "Curve2" 4 "Curve1" 3 "SpeedLimit" 2 "Crossing" 1 "FreewayExit" 0 "NoRecommendation" ;
VAL_TABLE_ AwdCnnct_D_Stat 3 "Connecting" 2 "Disconnecting" 1 "Connected" 0 "Disconnected" ;
VAL_TABLE_ PaakCtlActv_D_Rq 31 "NotUsed_13" 30 "NotUsed_12" 29 "NotUsed_11" 28 "NotUsed_10" 27 "NotUsed_9" 26 "NotUsed_8" 25 "NotUsed_7" 24 "NotUsed_6" 23 "NotUsed_5" 22 "NotUsed_4" 21 "NotUsed_3" 20 "TrunkFrontRelease" 19 "RemoteStop" 18 "RemoteStart" 17 "PowerDecklid" 16 "RightPowerSlidingDoor" 15 "LeftPowerSlidingDoor" 14 "PowerLiftgate" 13 "GlobalClose" 12 "GlobalOpen" 11 "PanicOff" 10 "PanicOn" 9 "LiftgateGlassRelease" 8 "LiftgateRelease" 7 "DecklidRelease" 6 "DoubleLock" 5 "LockAll" 4 "UnlockAllDoorsPlusCargo" 3 "UnlockCargoDoor" 2 "UnlockAllDoors" 1 "UnlockDriverDoor" 0 "Null" ;
VAL_TABLE_ Null_Invalid_Valid 3 "NotUsed" 2 "Valid" 1 "Invalid" 0 "Null" ;
VAL_TABLE_ PaakCtlData_D_Stat 7 "NotUsed_3" 6 "NotUsed_2" 5 "NotUsed_1" 4 "Response" 3 "EchoTargetIdBlock1" 2 "RequestTargetIdBlock2" 1 "RequestTargetIdBlock1" 0 "Idle" ;
VAL_TABLE_ EngAirFiltMsgTxt_D_Rq 7 "NotUsed_2" 6 "ReducedEngPwCheckAirFilter" 5 "EngineAirFilterMonitorFalt" 4 "ResetComplete" 3 "Clogged" 2 "ReplaceNow" 1 "ReplaceSoon" 0 "NoMessage" ;
VAL_TABLE_ ElPwPoint_D_Rq 3 "On" 2 "Off2" 1 "Off1" 0 "Null" ;
VAL_TABLE_ EngExhMdeQuiet_D2_Rq 7 "NotUsed_3" 6 "NotUsed_2" 5 "NotUsed_1" 4 "Track" 3 "Sport" 2 "Normal" 1 "Stealth" 0 "Null" ;
VAL_TABLE_ NoInhibit_Inhibit 1 "Inhibit" 0 "NoInhibit" ;
VAL_TABLE_ PersRecallSrc_D_Actl 7 "NotUsed_3" 6 "NotUsed_2" 5 "NotUsed_1" 4 "MemorySwitch" 3 "RemoteStart" 2 "KeyFob" 1 "CenterStack" 0 "Null" ;
VAL_TABLE_ BattTracChiller_D_Stat 3 "NotUsed" 2 "ChillerNotAvailable" 1 "ChillerBrieflyAvailable" 0 "ChillerAvailable" ;
VAL_TABLE_ MK_SpeedMinderConf_St 31 "mph90" 30 "mph85" 29 "mph80" 28 "mph75" 27 "mph70" 26 "mph65" 25 "mph60" 24 "mph55" 23 "mph50" 22 "mph45" 21 "mph40" 20 "Kmh165" 19 "Kmh160" 18 "Kmh155" 17 "Kmh150" 16 "Kmh145" 15 "Kmh140" 14 "Kmh135" 13 "Kmh130" 12 "Kmh125" 11 "Kmh120" 10 "Kmh115" 9 "Kmh110" 8 "Kmh105" 7 "Kmh100" 6 "kmh95" 5 "kmh90" 4 "kmh85" 3 "kmh80" 2 "kmh75" 1 "kmh70" 0 "Off" ;
VAL_TABLE_ MK_UserMyKeyCount_Rsp 15 "Inactive" 14 "Unlimited" 13 "Thirteen" 12 "Twelve" 11 "Eleven" 10 "Ten" 9 "Nine" 8 "Eight" 7 "Seven" 6 "Six" 5 "Five" 4 "Four" 3 "Three" 2 "Two" 1 "One" 0 "Zero" ;
VAL_TABLE_ TwoStatePressedNotPressed 3 "NotDetermined" 2 "SwitchState2" 1 "SwitchState1" 0 "NotPressed" ;
VAL_TABLE_ Rear_Temp 15 "NotUsed_6" 14 "NotUsed_5" 13 "NotUsed_4" 12 "NotUsed_3" 11 "NotUsed_2" 10 "NotUsed_1" 9 "Max_Heating" 8 "Level_3_Heating" 7 "Level_2_Heating" 6 "Level_1_Heating" 5 "No_Heating_Cooling" 4 "Level_1_Cooling" 3 "Level_2_Cooling" 2 "Level_3_Cooling" 1 "Max_Cooling" 0 "No_Request" ;
VAL_TABLE_ Null_NotInUse_InUse 3 "NotUsed" 2 "InUse" 1 "NotInUse" 0 "Null" ;
VAL_TABLE_ BattElecPerf_D2_Actl 7 "NotUsed" 6 "SeverelyLimitedPerformance" 5 "LimitedPerformance" 4 "SeverelyLimPerf_MotorTe" 3 "LimitedPerf_MotorTe" 2 "SeverelyLimPerf_BatteryTe" 1 "LimitedPerf_BatteryTe" 0 "NoMessage" ;
VAL_TABLE_ TemperatureColorDsply 3 "NotUsed" 2 "ColorForSeverlyLimited" 1 "ColorForLimited" 0 "ColorForNormal" ;
VAL_TABLE_ DrHandle_D_Stat 7 "NotUsed" 6 "Transition" 5 "FlushFault" 4 "DeployFault2" 3 "DeployFault1" 2 "Flush" 1 "Deploy" 0 "None" ;
VAL_TABLE_ TrlrTngLoad_D_Stat 7 "Faulty" 6 "NoDataExists" 5 "NotUsed_3" 4 "NotUsed_2" 3 "NotUsed_1" 2 "AboveRange" 1 "InRange" 0 "BelowRange" ;
VAL_TABLE_ TailLghtLoadMde_D_Rq 7 "NotUsed_3" 6 "NotUsed_2" 5 "NotUsed_1" 4 "DeactivateAll" 3 "ActivateFalrMode" 2 "ActivateHitchLoadMode" 1 "ActivatePayloadMode" 0 "NoCommand" ;
VAL_TABLE_ NoRequestReqNotUsedFaulty 3 "Faulty" 2 "NotUsed" 1 "Request" 0 "NoRequest" ;
VAL_TABLE_ VehPayloadScrn_D_Rq 7 "CheckLoadScreenActive" 6 "WeightCarryScreenActive" 5 "GooseneckScreenActive" 4 "FifthWheelScreenActive" 3 "WeightDistScreenActive" 2 "AddMassEstScreenActive" 1 "PayloadEstScreenActive" 0 "ScaleScreenNotActive" ;
VAL_TABLE_ VehFalr_D_Stat 7 "Faulty" 6 "NotUsed_3" 5 "NotUsed_2" 4 "NotUsed_1" 3 "HeightCorrectionCompleted" 2 "SecondMeasurementCollected" 1 "FirstMeasurementCollected" 0 "NotActive" ;
VAL_TABLE_ VehFalr_D_Rq 7 "NotUsed_3" 6 "NotUsed_2" 5 "NotUsed_1" 4 "NotComplete" 3 "Complete" 2 "RequestSecondMeasurement" 1 "RequestFirstMeasurement" 0 "NoRequest" ;
VAL_TABLE_ TailLghtLoadMde_D_Stat 7 "Faulty" 6 "NotUsed_2" 5 "NotUsed_1" 4 "TailLightModeOverride" 3 "FalrModeActive" 2 "HitchLoadModeActive" 1 "PayloadModeActive" 0 "NoTailLightActive" ;
VAL_TABLE_ ActvNseMute_D_Stat 3 "NotUsed_1" 2 "Muted" 1 "NotMuted" 0 "Inactive" ;
VAL_TABLE_ ActvNseMute_D_Rq 3 "NotUsed_1" 2 "Mute" 1 "Unmute" 0 "Inactive" ;
VAL_TABLE_ DrvBhavAudioAlrt_D_Rq 58 "NotUsed_51" 57 "NotUsed_50" 56 "NotUsed_49" 55 "NotUsed_48" 54 "NotUsed_47" 53 "NotUsed_46" 52 "NotUsed_45" 25 "NotUsed_18" 24 "NotUsed_17" 23 "NotUsed_16" 22 "NotUsed_15" 21 "NotUsed_14" 20 "NotUsed_13" 19 "NotUsed_12" 18 "NotUsed_11" 17 "NotUsed_10" 16 "NotUsed_9" 15 "NotUsed_8" 14 "NotUsed_7" 13 "NotUsed_6" 12 "NotUsed_5" 11 "NotUsed_4" 10 "NotUsed_3" 9 "NotUsed_2" 8 "NotUsed_1" 7 "ExcessiveIdleAndUnbuckled" 6 "ExcessiveSpeedAndUnbuckled" 5 "SeatbeltUnbuckled" 4 "HardBrakingBegin" 3 "HardAccelerationBegin" 2 "ExcessiveSpeedBegin" 1 "ExcessiveIdleBegin" 0 "NoMessage" 63 "NotUsed_56" 62 "NotUsed_55" 61 "NotUsed_54" 60 "NotUsed_53" 59 "NotUsed_52" ;
VAL_TABLE_ Inactive_Disable_Enable_NotUsed 3 "NotUsed" 0 "Inactive" 2 "Enable" 1 "Disable" ;
VAL_TABLE_ CrtsyLghtRear_D_Stat 3 "NotUsed_1" 2 "Automatic" 1 "Manual" 0 "Null" ;
VAL_TABLE_ Low_Med_High_Faulty 3 "Faulty" 2 "High" 1 "Medium" 0 "Low" ;
VAL_TABLE_ TrlrTireCnt_D_Stat 7 "Faulty" 6 "TwelveTire" 5 "EightTire" 4 "FourTireOneAxle" 3 "SixTire" 2 "FourTire" 1 "TwoTire" 0 "Unconfigured" ;
VAL_TABLE_ TrlrTireDual_D_Stat 15 "NotUsed_11" 14 "NotUsed_10" 13 "NotUsed_9" 12 "NotUsed_8" 11 "NotUsed_7" 10 "NotUsed_6" 9 "NotUsed_5" 8 "NotUsed_4" 7 "NotUsed_3" 6 "NotUsed_2" 5 "NotUsed_1" 4 "NotSupported" 3 "Invalid" 2 "InnerTire" 1 "OuterTire" 0 "SystemUnknown" ;
VAL_TABLE_ LoadShedRelayMde_D_Stat 3 "NotUsed_1" 2 "EngRunRelay" 1 "SnowPlow" 0 "LoadShed" ;
VAL_TABLE_ Frt_Btn_Status_1st_2 63 "NotUsed_5" 62 "NotUsed_4" 61 "NotUsed_3" 60 "NotUsed_2" 59 "NotUsed_1" 58 "AUTO_Dec_Pressed" 57 "AUTO_Inc_Pressed" 56 "AUTO_Hi_Pressed" 55 "AUTO_Med_Pressed" 54 "AUTO_Lo_Pressed" 53 "RHS_Cld_Seat3_Pressed" 52 "RHS_Cld_Seat2_Pressed" 51 "RHS_Cld_Seat1_Pressed" 50 "LHS_Cld_Seat3_Pressed" 49 "LHS_Cld_Seat2_Pressed" 48 "LHS_Cld_Seat1_Pressed" 47 "RHS_Auto_Seat_Pressed" 46 "RHS_Htd_Seat3_Pressed" 45 "RHS_Htd_Seat2_Pressed" 44 "RHS_Htd_Seat1_Pressed" 43 "RHS_Seat_Off_Pressed" 42 "LHS_Auto_Seat_Pressed" 41 "LHS_Htd_Seat3_Pressed" 40 "LHS_Htd_Seat2_Pressed" 39 "LHS_Htd_Seat1_Pressed" 38 "LHS_Seat_Off_Pressed" 37 "DrvrFcsdMde_Pressed" 36 "MdeMnu_Pressed" 35 "AAR_Pressed" 34 "Heat_Pressed" 33 "RearMnu_Pressed" 32 "FrontMnu_Pressed" 31 "Defrost_Pressed" 30 "Htd_Strg_Whl_Pressed" 29 "RHS_Cld_Seat_Pressed" 28 "LHS_Cld_Seat_Pressed" 27 "RHS_Htd_Seat_Pressed" 26 "LHS_Htd_Seat_Pressed" 25 "Max_Defrost_Pressed" 24 "My_Temp_Pressed" 23 "Front_Defrost_Pressed" 22 "Rear_Defrost_Pressed" 21 "Pnl_Flr_Ws_Pressed" 20 "Pnl_Ws_Pressed" 19 "Windscreen_Pressed" 18 "Htd_Frt_Wsh_Pressed" 17 "Auto_Recirc_Pressed" 16 "Outside_Pressed" 15 "Recirc_Pressed" 14 "Max_AC_Pressed" 13 "AUTO_Pressed" 12 "Blwr_Dec_Pressed" 11 "Blwr_Inc_Pressed" 10 "RHS_Temp_Dec_Pressed" 9 "RHS_Temp_Inc_Pressed" 8 "LHS_Temp_Dec_Pressed" 7 "LHS_Temp_Inc_Pressed" 6 "Dual_Pressed" 5 "AC_Pressed" 4 "Floor_Ws_Pressed" 3 "Floor_Pressed" 2 "Panel_Floor_Pressed" 1 "Panel_Pressed" 0 "None_Pressed" ;
VAL_TABLE_ Drv_Set_Tmp2 31 "HI" 30 "29_5" 29 "29_0" 28 "28_5" 27 "28_0" 26 "27_5" 25 "27_0" 24 "26_5" 23 "26_0" 22 "25_5" 21 "25_0" 20 "24_5" 19 "24_0" 18 "23_5" 17 "23_0" 16 "22_5" 15 "22_0" 14 "21_5" 13 "21_0" 12 "20_5" 11 "20_0" 10 "19_5" 9 "19_0" 8 "18_5" 7 "18_0" 6 "17_5" 5 "17_0" 4 "16_5" 3 "16_0" 2 "15_5" 1 "LO" 0 "No_Request" ;
VAL_TABLE_ Manual_Temp_Setting 31 "Full_Heat" 30 "Setting_30" 29 "Setting_29" 28 "Setting_28" 27 "Setting_27" 26 "Setting_26" 25 "Setting_25" 24 "Setting_24" 23 "Setting_23" 22 "Setting_22" 21 "Setting_21" 20 "Setting_20" 19 "Setting_19" 18 "Setting_18" 17 "Setting_17" 16 "Setting_16" 15 "Setting_15" 14 "Setting_14" 13 "Setting_13" 12 "Setting_12" 11 "Setting_11" 10 "Setting_10" 9 "Setting_9" 8 "Setting_8" 7 "Setting_7" 6 "Setting_6" 5 "Setting_5" 4 "Setting_4" 3 "Setting_3" 2 "Setting_2" 1 "Full_Cool" 0 "Off" ;
VAL_TABLE_ Null_Disabled_Enabled_Faulty 3 "Faulty" 2 "Enabled" 1 "Disabled" 0 "Null" ;
VAL_TABLE_ AprSnd_D_Rq 63 "NotUsed_24" 62 "NotUsed_23" 61 "NotUsed_22" 60 "NotUsed_21" 59 "NotUsed_20" 58 "NotUsed_19" 57 "NotUsed_18" 56 "NotUsed_17" 55 "NotUsed_16" 54 "NotUsed_15" 53 "NotUsed_14" 52 "NotUsed_13" 51 "NotUsed_12" 50 "NotUsed_11" 49 "NotUsed_10" 48 "NotUsed_9" 47 "NotUsed_8" 46 "NotUsed_7" 45 "NotUsed_6" 44 "NotUsed_5" 43 "NotUsed_4" 42 "NotUsed_3" 41 "NotUsed_2" 40 "ROpenDoor" 39 "MgMercOpenDoor" 38 "MgRecAuthFail_Max" 37 "RCustCareCalling" 36 "MgRecCustCareCalling" 35 "RCallCustCare" 34 "MgRecCallCustCare" 33 "RItemDetection" 32 "MgRecItemDetection" 31 "MgMercItemDetection" 30 "MgRecOpenDoor" 29 "MgMercLoadOrder" 28 "MgRecBarcodeError" 27 "MgRecBarcode" 26 "RAuthFailMax" 25 "MgMercAuthFailMax" 24 "RAuthFail" 23 "MgMercAuthFail" 22 "R_6ft" 21 "MgRec_6ft" 20 "RAuthSucc" 19 "MgRecAuthSucc" 18 "MgMercAuthSucc" 17 "RMaxTime" 16 "MgRecMaxTime" 15 "MgMercMaxTime" 14 "RExtendTimeUnloading" 13 "RExtendTimeLoading" 12 "MgReciExtendTime" 11 "MgMercExtendTime" 10 "RTimeOutLoading" 9 "RTimeOutUnloading" 8 "MgMercTimeOut" 7 "MgRecTimeOut" 6 "RBttnPressKeypad" 5 "MgRecBttnPressKeypad" 4 "MgMercBttnPressKeypad" 3 "MgMercBttnPressOrder" 2 "RNudge" 1 "MgMercNudge" 0 "NoSound" ;
VAL_TABLE_ TjaLaneBias_D_Stat 7 "NotUsed" 6 "ElBiasRight" 5 "ElBiasLeft" 4 "SystemBiasRight" 3 "SystemBiasLeft" 2 "ManualBiasRight" 1 "ManualBiasLeft" 0 "NoBias" ;
VAL_TABLE_ AwdMdeCstm_D_RqDrv 7 "Faulty" 6 "NotUsed_3" 5 "NotUsed_2" 4 "NotUsed_1" 3 "FourByFourLow" 2 "FourByFourHigh" 1 "FourByFourAuto" 0 "FourByTwo" ;
VAL_TABLE_ Off_On_SlowFastFlash 3 "Fast_Flash" 2 "Slow_Flash" 1 "On" 0 "Off" ;
VAL_TABLE_ SelDrvMdeCstm_D_RqDrv 7 "Faulty" 6 "NotUsed_3" 5 "NotUsed_2" 4 "NotUsed_1" 3 "Recall" 2 "Save" 1 "Activate" 0 "Null" ;
VAL_TABLE_ NotAvail_OffOn_Faulty 3 "Faulty" 2 "On" 1 "Off" 0 "NotAvailable" ;
VAL_TABLE_ ClrExitAsstMsgTxt2_D_Rq 15 "NotUsed_7" 14 "NotUsed_6" 13 "NotUsed_5" 12 "NotUsed_4" 11 "NotUsed_3" 10 "NotUsed_2" 9 "NotUsed_1" 8 "FrontLeftRearRight" 7 "RearLeftFrontRight" 6 "FrontLeftFrontRight" 5 "RearLeftRearRight" 4 "FrontRight" 3 "FrontLeft" 2 "RearRight" 1 "RearLeft" 0 "NoMessage" ;
VAL_TABLE_ ApaDrvRq2MsgTxt_D_Rq 15 "NotUsed_7" 14 "NotUsed_6" 13 "NotUsed_5" 12 "NotUsed_4" 11 "NotUsed_3" 10 "NotUsed_2" 9 "NotUsed_1" 8 "CloseDoor" 7 "TakeControl" 6 "ReleaseEpb" 5 "ReleaseSteering" 4 "ReleaseBrake" 3 "DriveBackward" 2 "DriveForward" 1 "Stop" 0 "NoRequest" ;
VAL_TABLE_ ApaDrvRq1MsgTxt_D_Rq 7 "NotUsed" 6 "ExitVehicle" 5 "PressApaButton" 4 "ShiftToP" 3 "ShiftToN" 2 "ShiftToD" 1 "ShiftToR" 0 "NoRequest" ;
VAL_TABLE_ PulledAtRest 1 "Pulled" 0 "AtRest" ;
VAL_TABLE_ DcacFaltMsgTxt_D2_Rq 35 "NotUsed_1" 34 "FrontTrnkPlgWarnDertExceed" 33 "FrontTrnkPlgWarnDerate" 32 "FrontTrnkPlgWarnFullPw" 31 "IpcPlugWarnDrive" 30 "DcacbOvercurrentLp" 29 "DcacbService" 28 "DcacbNotAvailable" 27 "DcacbAcOnOutput" 26 "DcacbTemperature" 25 "DcacbGfci" 24 "DcacbOvercurrent" 23 "PpoUsageWhenVehlsCharging" 22 "RpsNewKeyCycleWarning" 21 "LowSocRpsWarning" 20 "RpsResetWarn_ChngDrvToPark" 19 "RpsResetWarning" 18 "FirstRpsWarning" 63 "NotUsed_29" 17 "PowerTakeoff" 16 "HevDerate" 15 "HvacOn" 14 "OvercurrentLP" 13 "EngineRun" 12 "Service" 11 "NotAvailable" 10 "PlugWarn" 9 "PlugWarnDrive" 8 "BreakerC" 7 "BreakerB" 6 "BreakerA" 5 "FuelLow" 4 "AcOnOutput" 3 "Temperature" 2 "Gfci" 1 "Overcurrent" 0 "Ok" ;
VAL_TABLE_ Hour5bitNull 31 "NotUsed_7" 30 "NotUsed_6" 29 "NotUsed_5" 28 "NotUsed_4" 27 "NotUsed_3" 26 "NotUsed_2" 25 "NotUsed_1" 24 "Hour23_11pm" 23 "Hour22_10pm" 22 "Hour21_9pm" 21 "Hour20_8pm" 20 "Hour19_7pm" 19 "Hour18_6pm" 18 "Hour17_5pm" 17 "Hour16_4pm" 16 "Hour15_3pm" 15 "Hour14_2pm" 14 "Hour13_1pm" 13 "Hour12_12pm" 12 "Hour11_11am" 11 "Hour10_10am" 10 "Hour9_9am" 9 "Hour8_8am" 8 "Hour7_7am" 7 "Hour6_6am" 6 "Hour5_5am" 5 "Hour4_4am" 4 "Hour3_3am" 3 "Hour2_2am" 2 "Hour1_1am" 1 "Hour0_12am" 0 "Null" ;
VAL_TABLE_ Null_Dis_En_NotConfig 3 "NotConfigured" 2 "Enabled" 1 "Disabled" 0 "Null" ;
VAL_TABLE_ IaccVAdjReas_D_Dsply 15 "NotUsed_21" 11 "NotUsed_1" 10 "SpeedSign" 9 "LeftRamp" 8 "RightRamp" 7 "Roundabout_CCW" 6 "Roundabout_CW" 5 "LeftCurve" 4 "RightCurve" 3 "LeftTurnIntersection" 2 "RightTurnIntersection" 1 "RoadGeometryUnavailable" 0 "NoDisplay" ;
VAL_TABLE_ TelematicsSrvc_D_St2 7 "NotUsed_1" 6 "NotifyNotActivatedYet" 5 "NotActivatedYet" 4 "NotifyExpired" 3 "Expired" 2 "ExpiringSoon" 1 "Active" 0 "Null" ;
VAL_TABLE_ Null_8bit_GenericValues 255 "Value254" 2 "Value1_up_to_0xFE_Value253" 1 "Value0" 0 "Null" ;
VAL_TABLE_ BattTracLimPerf_D_Dsply 3 "NotUsed" 2 "SeverelyLimitedPerformance" 1 "LimitedPerformance" 0 "NoDisplay" ;
VAL_TABLE_ SdarsAudioRtng_D_Stat 3 "NotUsed" 2 "APIMStereoOut" 1 "X40l2SStereoOut" 0 "NotDetermined" ;
VAL_TABLE_ SdarsAudioRtng_D_Rq 3 "NotUsed" 2 "APIMStereoOut" 1 "X40l2SStereoOut" 0 "Null" ;
VAL_TABLE_ ApaSlotAlrtSet_D_RqDrv 3 "TemporarySuppression" 2 "Disable" 1 "Enable" 0 "None" ;
VAL_TABLE_ ApaFeat_D_RqDrv 7 "Faulty" 6 "Off" 5 "RePA" 4 "ParkIn" 3 "POA" 2 "PPA" 1 "SAPP" 0 "Inactive" ;
VAL_TABLE_ ApaSlot_D_Stat 7 "NotUsed_3" 6 "NotUsed_2" 5 "NotUsed_1" 4 "IPeReady" 3 "IPeFound" 2 "IPaReady" 1 "IPaFound" 0 "None" ;
VAL_TABLE_ OffOnOutageFaulty 3 "Faulty" 2 "Outage" 1 "On" 0 "Off" ;
VAL_TABLE_ PrkMde_D_ET 3 "NotUsed" 2 "FreeDrive" 1 "ParkIn" 0 "None" ;
VAL_TABLE_ RmtCtlPrkInSlot_D_ET 7 "NotUsed_3" 6 "NotUsed_2" 5 "NotUsed_1" 4 "Right" 3 "Left" 2 "Rear" 1 "Front" 0 "None" ;
VAL_TABLE_ MoveDir_D_ET 3 "NotUsed" 2 "Backward" 1 "Forward" 0 "None" ;
VAL_TABLE_ ApaSys_D2_Stat 15 "NotUsed_5" 14 "NotUsed_4" 13 "NotUsed_3" 12 "NotUsed_2" 11 "NotUsed_1" 10 "NoSideSelectable" 9 "RightSideSelectable" 8 "LeftSideSelectable" 7 "BothSidesSelectable" 6 "Faulty" 5 "Finished" 4 "Cancelled" 3 "NotAvailable" 2 "Overspeed" 1 "Pause" 0 "NormalOperation" ;
VAL_TABLE_ ApaSlotTrgt_D_Stat 15 "NotUsed_7" 14 "NotUsed_6" 13 "NotUsed_5" 12 "NotUsed_4" 11 "NotUsed_3" 10 "NotUsed_2" 9 "NotUsed_1" 8 "Front" 7 "Rear" 6 "Right3" 5 "Right2" 4 "Right1" 3 "Left3" 2 "Left2" 1 "Left1" 0 "None" ;
VAL_TABLE_ ApaMsgTxt_D2_Stat 15 "ReducedFunction" 14 "TrailerFeatureNotAvailable" 13 "AcceleratorPedalInactive" 12 "SensorsBlocked" 11 "TrailerAttached" 10 "TcsDeactivated" 9 "WheelSlip" 8 "HighInclination" 7 "DoorOpen" 6 "SteeringInteraction" 5 "WrongDirection" 4 "SpeedLimitExceeded" 3 "BrakeEvent" 2 "ObstacleInPath" 1 "WaitForSteering" 0 "None" ;
VAL_TABLE_ DisplayMode 3 "NotUsed" 2 "FullScreen" 1 "Menu" 0 "Off" ;
VAL_TABLE_ ClrExitAsstMsgTxt_D_Rq 15 "NotUsed_8" 14 "NotUsed_7" 13 "NotUsed_6" 12 "NotUsed_5" 11 "NotUsed_4" 10 "NotUsed_3" 9 "NotUsed_2" 8 "NotUsed_1" 7 "SystemFault" 6 "ChildLockMaintained" 5 "WarningRight" 4 "WarningLeft" 3 "InformationRight" 2 "InformationLeft" 1 "Shutdown" 0 "NoMessage" ;
VAL_TABLE_ InactiveDisableEnableNotUsed 3 "NotUsed" 0 "Inactive" 2 "Enable" 1 "Disable" ;
VAL_TABLE_ ClrExitAsstChime_D_Rq 7 "NotUsed_4" 6 "NotUsed_3" 5 "NotUsed_2" 4 "NotUsed_1" 3 "WarningChimeFront" 2 "WarningChimeRear" 1 "InformationChime" 0 "Off" ;
VAL_TABLE_ NtfctnConflict1_D_Rq 7 "NotUsed_4" 6 "NotUsed_3" 5 "NotUsed_2" 4 "NotUsed_1" 3 "ChargeWindow" 2 "DepartureTime" 1 "NoConflictExists" 0 "Null" ;
VAL_TABLE_ Null_Manual_Automatic 3 "NotUsed" 2 "Automatic" 1 "Manual" 0 "Null" ;
VAL_TABLE_ BattChrgStrtStop_D_Rq 3 "ReturnToSettings" 2 "StopCharge" 1 "StartCharge" 0 "NoNewRequest" ;
VAL_TABLE_ Disp_LangSel2_Rq 33 "Ukrainian" 32 "Indian_English" 31 "Thai" 30 "Slovak" 29 "Arabic" 28 "Taiwanese" 27 "Mandarin_Chinese" 26 "Korean" 25 "AU_English" 24 "Japanese" 23 "Braz_Portuguese" 22 "EU_Portuguese" 21 "Finish" 20 "Norwegian" 19 "Danish" 18 "Swedish" 17 "Hungarian" 16 "Greek" 15 "Czech" 14 "Polish" 13 "Flemish" 12 "Dutch" 11 "Russian" 10 "Turkish" 9 "Mex_Spanish" 8 "EU_Spanish" 7 "Cana_French" 6 "EU_French" 5 "Italian" 4 "German" 3 "NA_English" 2 "UK_English" 1 "Unknown" 0 "Invalid" ;
VAL_TABLE_ VehShutDownMsgTxt_D_Rq 3 "NotUsed" 2 "ProhibitedRestart" 1 "ShutdownWarning" 0 "NoMessage" ;
VAL_TABLE_ VehHorn_D_Rq 15 "NotUsed_7" 14 "NotUsed_6" 13 "NotUsed_5" 12 "NotUsed_4" 11 "NotUsed_3" 10 "NotUsed_2" 9 "NotUsed_1" 8 "Chirp_3" 7 "ManualOn" 6 "Honk" 5 "ChirpHonk" 4 "Chirp_2H" 3 "Chirp_2" 2 "Chirp_1" 1 "Null" 0 "Off" ;
VAL_TABLE_ Audio_Demo_CMND 2 "On" 1 "Off" 0 "Inactive" ;
VAL_TABLE_ Audio_Visualizer 2 "On" 1 "Off" 0 "Inactive" ;
VAL_TABLE_ AplSnd_D_Rq 63 "NotUsed_24" 62 "NotUsed_23" 61 "NotUsed_22" 60 "NotUsed_21" 59 "NotUsed_20" 58 "NotUsed_19" 57 "NotUsed_18" 56 "NotUsed_17" 55 "NotUsed_16" 54 "NotUsed_15" 53 "NotUsed_14" 52 "NotUsed_13" 51 "NotUsed_12" 50 "NotUsed_11" 49 "NotUsed_10" 48 "NotUsed_9" 47 "NotUsed_8" 46 "NotUsed_7" 45 "NotUsed_6" 44 "NotUsed_5" 43 "NotUsed_4" 42 "NotUsed_3" 41 "NotUsed_2" 40 "ROpenDoor" 39 "MgMercOpenDoor" 38 "MgRecAuthFail_Max" 37 "RCustCareCalling" 36 "MgRecCustCareCalling" 35 "RCallCustCare" 34 "MgRecCallCustCare" 33 "RItemDetection" 32 "MgRecItemDetection" 31 "MgMercItemDetection" 30 "MgRecOpenDoor" 29 "MgMercLoadOrder" 28 "MgRecBarcodeError" 27 "MgRecBarcode" 26 "RAuthFailMax" 25 "MgMercAuthFailMax" 24 "RAuthFail" 23 "MgMercAuthFail" 22 "R_6ft" 21 "MgRec_6ft" 20 "RAuthSucc" 19 "MgRecAuthSucc" 18 "MgMercAuthSucc" 17 "RMaxTime" 16 "MgRecMaxTime" 15 "MgMercMaxTime" 14 "RExtendTimeUnloading" 13 "RExtendTimeLoading" 12 "MgReciExtendTime" 11 "MgMercExtendTime" 10 "RTimeOutLoading" 9 "RTimeOutUnloading" 8 "MgMercTimeOut" 7 "MgRecTimeOut" 6 "RBttnPressKeypad" 5 "MgRecBttnPressKeypad" 4 "MgMercBttnPressKeypad" 3 "MgMercBttnPressOrder" 2 "RNudge" 1 "MgMercNudge" 0 "NoSound" ;
VAL_TABLE_ SetTimeFormat 3 "NotUsed" 2 "_24h_mode" 1 "_12h_mode" 0 "Inactive" ;
VAL_TABLE_ TrnkFrontRleas_D_Src 7 "NotUsed_3" 6 "NotUsed_2" 5 "NotUsed_1" 4 "Cpp" 3 "Sync" 2 "Keypad" 1 "Remote" 0 "Null" ;
VAL_TABLE_ StopoverType_D_Stat 7 "Faulty" 6 "NotUsed_1" 5 "Other" 4 "Work" 3 "Home" 2 "ChargeStation" 1 "FinalDestination" 0 "Null" ;
VAL_TABLE_ NoData_Faulty_3FFFE_3FFFF 262143 "Faulty" 262142 "NoDataExists" ;
VAL_TABLE_ InactiveNotSupported_Supported 3 "NotUsed_1" 2 "Supported" 1 "NotSupported" 0 "Inactive" ;
VAL_TABLE_ AwdStat2_D_RqDsply 31 "NotUsed_26" 30 "NotUsed_25" 29 "NotUsed_24" 28 "NotUsed_23" 27 "NotUsed_22" 26 "NotUsed_21" 25 "NotUsed_20" 24 "NotUsed_19" 23 "NotUsed_18" 22 "NotUsed_17" 21 "NotUsed_16" 20 "NotUsed_15" 19 "NotUsed_14" 18 "NotUsed_13" 17 "NotUsed_12" 16 "NotUsed_11" 15 "NotUsed_10" 14 "NotUsed_9" 13 "NotUsed_8" 12 "NotUsed_7" 11 "NotUsed_6" 10 "NotUsed_5" 9 "NotUsed_4" 8 "NotUsed_3" 7 "NotUsed_2" 6 "NotUsed_1" 5 "Unavailable4x4Mode

" 4 "UnavailableDriveMode" 3 "HillHoldFail" 2 "TCaseOilChanged" 1 "ChangeTCaseOil" 0 "Normal" ;
VAL_TABLE_ DrvDsplyPalette_D_Stat 7 "NotUsed_3" 6 "NotUsed_2" 5 "ManualNightDark" 4 "ManualNightBright" 3 "ManualDay" 2 "AutoNight" 1 "AutoDay" 0 "Null" ;
VAL_TABLE_ Degraded_Ok 1 "Ok" 0 "Degraded" ;
VAL_TABLE_ KeylessIdl_D_Rq 3 "Cancel" 2 "IgnitionOff" 1 "Active" 0 "Inactive" ;
VAL_TABLE_ DgtlCommGtwy_D_Falt 127 "NotUsed_63" 65 "NotUsed_1" 64 "EvseGbtCommTimeout" 63 "EvseGbtCrgVoltMismatch" 62 "EvseGbtChrgCurrntMismatch" 61 "EvseGbtOtherFalt" 60 "EvseGbtEmergShutdown" 59 "EvseGbtEnergyTransFalt" 58 "EvseGbtIntOverTemp" 57 "EvseGbtConnectorFalt" 56 "EvseGbtOverTemp" 55 "EvseResCpsRootCaCertRev" 54 "EvseResSubCA2CertRev" 53 "EvseResSubCA1CertRev" 52 "EvseResCpsProvCertRev" 51 "EvseResRootCaCertRev" 50 "EvseResMoSubCa2CertRev" 49 "EvseResMoSubCa1CertRev" 48 "EvseResMoProvCertRev" 47 "EvseResOemSubCa2CertRev" 46 "EvseResOemSubCa1CertRev" 45 "EvseResOemProvCertRev" 44 "EvseResMoUnknown" 43 "EvseResContractNotAccept" 42 "EvseResNoSuppAppProt" 41 "EvseResCertNotAllowed" 40 "EvseResContractErr" 39 "EvseResNoChrgSvcSelect" 38 "EvseResMeterSignNotVld" 37 "EvseResPwrDelNotApplied" 36 "EvseResTrfSelectInvld" 35 "EvseResChrgProfileInvld" 34 "EvseResWrongChrgParam" 33 "EvseResWrongEnrgyTransMde" 32 "EvseResChlgInvld" 31 "EvseResContractCancel" 30 "EvseResCertChainErr" 29 "EvseResNoCertAvail" 28 "EvseResCertRvk" 27 "EvseResCertExp" 26 "EvseResPymtSelectInvld" 25 "EvseResSvcldInvld" 24 "EvseResUnknownSession" 23 "EvseResSignErr" 22 "EvseResSeqErr" 21 "EvseResFailed" 20 "EvsePreChrgTimeout" 19 "EvseCableCheckTimeout" 18 "EvseCommSetupTimeout" 17 "EvseMsgTimeout" 16 "EvseTlsUnknownCA" 15 "EvseTlsCertExpired" 14 "EvseTlsBadCert" 13 "EvseTlsHandshakeFail" 12 "EvseTlsDecryptFail" 11 "EvseTlsBadRecordMac" 10 "EvseTlsUnexpectedMsg" 9 "EvseTlsFail" 8 "EvseTcpCnnctFail" 7 "EvseUpdErr" 6 "EvseSlaacErr" 5 "EvseStopNotification" 4 "EvseMalfunction" 3 "EvseEmergShutdown" 2 "EvseStatUtilityIntrpt" 1 "EvseStatShutdown" 0 "NoFault" ;
VAL_TABLE_ DteVehOffstMsgTxt_D_Rq 15 "NotUsed_7" 14 "NotUsed_6" 13 "NotUsed_5" 12 "NotUsed_4" 11 "NotUsed_3" 10 "NotUsed_2" 9 "NotUsed_1" 8 "PowerToTheBox" 7 "Payload" 6 "TrailerTowing_Off" 5 "TrailerTowing_On" 4 "TrafficAlongRoute" 3 "ExternalTemperature" 2 "HillyTerrain" 1 "DestinationRoute" 0 "NoMessage" ;
VAL_TABLE_ McEvntNotfnMsgId_D_Rq 3 "Deactivate" 2 "Update" 1 "Activate" 0 "Invalid" ;
VAL_TABLE_ McSelChoice_D_Stat 7 "Choice7" 6 "Choice6" 5 "Choice5" 4 "Choice4" 3 "Choice3" 2 "Choice2" 1 "Choice1" 0 "Ok" ;
VAL_TABLE_ McPrsntActv_D_Stat 7 "NotUsed_4" 6 "NotUsed_3" 5 "NotUsed_2" 4 "NotUsed_1" 3 "Deactivated" 2 "UpdateGranted" 1 "ActiveGranted" 0 "Inactive" ;
VAL_TABLE_ Null_InProcess_Complete 3 "NotUsed" 2 "Complete" 1 "InProcess" 0 "Null" ;
VAL_TABLE_ TrlrAlarmSpprt_D_Stat 3 "SupportedByBrakesAndLights" 2 "SupportedByLights" 1 "SupportedByBrakes" 0 "NotSupported" ;
VAL_TABLE_ StationTypeSel_D_Rq 0 "Inactive" 1 "PI_Code" 2 "SCIDI_SID_ECC" 3 "NotUsed_1" ;
VAL_TABLE_ DgtlCommPnc_D_Stat 7 "Faulty" 6 "NotUsed_3" 5 "NotUsed_2" 4 "NotUsed_1" 3 "Enable" 2 "Disable" 1 "NoContractsInstalled" 0 "Null" ;
VAL_TABLE_ Null_Restricted_NotRestricted 3 "NotUsed" 2 "NotRestricted" 1 "Restricted" 0 "Null" ;
VAL_TABLE_ Null_Extend_Retract 3 "NotUsed" 2 "Retract" 1 "Extend" 0 "Null" ;
VAL_TABLE_ SeatSlprPosPsngr_D_Stat 3 "Faulty" 2 "Sleeper" 1 "Upright" 0 "Null" ;
VAL_TABLE_ TrailOnePdlMde_D_Ind 7 "NotUsed_4" 6 "NotUsed_3" 5 "NotUsed_2" 4 "NotUsed_1" 3 "Standby" 2 "Active" 1 "Fault" 0 "Off" ;
VAL_TABLE_ Faulty_7F 63 "Faulty" ;
VAL_TABLE_ DcacHw_D_Confg 15 "NotUsed_11" 14 "NotUsed_10" 13 "NotUsed_9" 12 "NotUsed_8" 11 "NotUsed_7" 10 "NotUsed_6" 9 "NotUsed_5" 8 "NotUsed_4" 7 "NotUsed_3" 6 "NotUsed_2" 5 "Dual_2400WAnd7200W" 4 "Power_2300W" 3 "Power_7200W" 2 "Power_2400W" 1 "Power_2000W" 0 "NoDcacHardware" ;
VAL_TABLE_ DcacFaltMsgTxt_D_Rq 15 "HvacOn" 14 "OvercurrentLP" 13 "EngineRun" 12 "Service" 11 "NotAvailable" 10 "PlugWarn" 9 "PlugWarnDrive" 8 "BreakerC" 7 "BreakerB" 6 "BreakerA" 5 "FuelLow" 4 "AcOnOutput" 3 "Temperature" 2 "Gfci" 1 "Overcurrent" 0 "Ok" ;
VAL_TABLE_ DcacLoFuelMsgTxt_D_Rq 31 "Minute_31" 30 "Minute_30" 29 "Minute_29" 28 "Minute_28" 27 "Minute_27" 26 "Minute_26" 25 "Minute_25" 24 "Minute_24" 23 "Minute_23" 22 "Minute_22" 21 "Minute_21" 20 "Minute_20" 19 "Minute_19" 18 "Minute_18" 17 "Minute_17" 16 "Minute_16" 15 "Minute_15" 14 "Minute_14" 13 "Minute_13" 12 "Minute_12" 11 "Minute_11" 10 "Minute_10" 9 "Minute_9" 8 "Minute_8" 7 "Minute_7" 6 "Minute_6" 5 "Minute_5" 4 "Minute_4" 3 "Minute_3" 2 "Minute_2" 1 "Minute_1" 0 "Ok" ;
VAL_TABLE_ DcacEngOnMsgTxt_D_Rq 3 "NotUsed" 2 "DisplayQuestion" 1 "DisplayWarning" 0 "Ok" ;
VAL_TABLE_ DsmcMsgTxt_D_Dsply 3 "Blockage" 2 "DriverNotSeen" 1 "Fault" 0 "NoMessage" ;
VAL_TABLE_ VehInhbtMde_D_Stat 7 "NotUsed_3" 6 "NotUsed_2" 5 "NotUsed_1" 4 "FullVehicleOta" 3 "Iviota" 2 "SyncOta" 1 "NoOtaSupport" 0 "Unconfigured" ;
VAL_TABLE_ TlghtTest_D_Stat 3 "InProgress" 2 "Ended" 1 "Completed" 0 "Null" ;
VAL_TABLE_ TlightTest_D_Rq 3 "TestEndAcknowledge" 2 "StartTest" 1 "StopTest" 0 "Null" ;
VAL_TABLE_ TlghtTestPrecnd_D_Stat 7 "Error" 6 "NotStationary" 5 "InteractionPresent" 4 "PreconditionsPassed" 3 "BattSocLessThan75Percent" 2 "TailLightsOn" 1 "IgnitionNotOn" 0 "Null" ;
VAL_TABLE_ TlghtTestLght_D_Stat 7 "Error" 6 "AllOff" 5 "TestingReverseLights" 4 "TestingBrakeLights" 3 "TestingLeftTurnSignal" 2 "TestingRightTurnSignal" 1 "ParkingLightsIlluminated" 0 "Null" ;
VAL_TABLE_ Frt_Blower_Speed2 15 "NotUsed_6" 14 "NotUsed_5" 13 "NotUsed_4" 12 "NotUsed_3" 11 "NotUsed_2" 10 "Zero_Blower" 9 "Max_Blower" 8 "Min_Blower" 7 "Blower_Speed_7" 6 "Blower_Speed_6" 5 "Blower_Speed_5" 4 "Blower_Speed_4" 3 "Blower_Speed_3" 2 "Blower_Speed_2" 1 "Blower_Speed_1" 0 "No_Request" ;
VAL_TABLE_ Psngr_Set_Temp 31 "HI" 30 "_29_5" 29 "_29_0" 28 "_28_5" 27 "_28_0" 26 "_27_5" 25 "_27_0" 24 "_26_5" 23 "_26_0" 22 "_25_5" 21 "_25_0" 20 "_24_5" 19 "_24_0" 18 "_23_5" 17 "_23_0" 16 "_22_5" 15 "_22_0" 14 "_21_5" 13 "_21_0" 12 "_20_5" 11 "_20_0" 10 "_19_5" 9 "_19_0" 8 "_18_5" 7 "_18_0" 6 "_17_5" 5 "_17_0" 4 "_16_5" 3 "_16_0" 2 "_15_5" 1 "LO" 0 "No_Request" ;
VAL_TABLE_ Null_Disabled_Enabled 3 "NotUsed" 2 "Enabled" 1 "Disabled" 0 "Null" ;
VAL_TABLE_ LghtAmbDrvMde_D_Rq 3 "NotUsed" 2 "Automatic" 1 "Manual" 0 "Null" ;
VAL_TABLE_ LghtAmbDrvMde_B_Stat 1 "Automatic" 0 "Manual" ;
VAL_TABLE_ PaakLoclzd_D_Stat 15 "NotUsed_12" 14 "NotUsed_11" 13 "NotUsed_10" 12 "NotUsed_9" 11 "NotUsed_8" 10 "NotUsed_7" 9 "NotUsed_6" 8 "NotUsed_5" 7 "NotUsed_4" 6 "NotUsed_3" 5 "NotUsed_2" 4 "NotUsed_1" 3 "FullLoc" 2 "PausedLoc" 1 "MaintainLink" 0 "BackgroundScan" ;
VAL_TABLE_ NullMphKph 3 "NotUsed" 2 "Kph" 1 "Mph" 0 "Null" ;
VAL_TABLE_ GoTEditMnte_T_RqMnu 15 "Faulty" 14 "NoDataExists" 13 "NotUsed_2" 12 "NotUsed_1" 11 "Minute_55" 10 "Minute_50" 9 "Minute_45" 8 "Minute_40" 7 "Minute_35" 6 "Minute_30" 5 "Minute_25" 4 "Minute_20" 3 "Minute_15" 2 "Minute_10" 1 "Minute_5" 0 "Minute_0" ;
VAL_TABLE_ MK_CreateMyKey_Rsp 7 "NotUsed_3" 6 "NotUsed_2" 5 "NotUsed_1" 4 "Success" 3 "GenericFailure" 2 "NoKeyInSlot" 1 "KeyInSlotAlreadyMyKey" 0 "Inactive" ;
VAL_TABLE_ SelDrvMdeChassis2_D_Rq 31 "Faulty" 30 "NotUsed17" 29 "NotUsed16" 28 "NotUsed15" 27 "NotUsed14" 26 "NotUsed13" 25 "NotUsed12" 24 "NotUsed11" 23 "NotUsed10" 22 "NotUsed9" 21 "NotUsed8" 20 "NotUsed7" 19 "NotUsed6" 18 "NotUsed5" 17 "NotUsed4" 16 "OnePedalDrive" 15 "DragMode" 14 "RoughRoadMode" 13 "TrackMode" 12 "HighSpeedDesertMode" 11 "TowHaulMode" 10 "RockCrawlMode" 9 "SandMode" 8 "MudAndRutsMode" 7 "LowMuMode" 6 "ComfortAdaptiveMode" 5 "ComfortMode" 4 "SportAdaptiveMode" 3 "SportMode" 2 "EconomyMode" 1 "NormalAdaptiveMode" 0 "NormalMode" ;
VAL_TABLE_ TrnFaltOpenClu_B_Stat 1 "MayOpenClutch" 0 "Normal" ;
VAL_TABLE_ Closed_Open 1 "Open" 0 "Closed" ;
VAL_TABLE_ FactoryReset_St 3 "NotUsed_2" 2 "NotUsed_1" 1 "FactoryDefaultsRestored" 0 "Null" ;
VAL_TABLE_ TCU_Sftwr_Update_D_St 3 "SoftwareUpdateComplete" 2 "SoftwareUpdating" 1 "NoUpdate" 0 "Invalid" ;
VAL_TABLE_ CCOI_Policy 15 "NotUsed_4" 14 "NotUsed_3" 13 "NotUsed_2" 12 "NotUsed_1" 11 "DataStorageError" 10 "StateMachineInconsistent" 9 "UnrecoverableSyncError" 8 "OnBoardSyncFailed" 7 "OnBoardImplemented" 6 "OnBoardSynchronized" 5 "OnBoardSynchronizing" 4 "OnBoardSyncNeeded" 3 "OffBoardUpdatePending" 2 "OnBoardUpdatePending" 1 "Waiting" 0 "Null" ;
VAL_TABLE_ TelematicsSrvc_D_St 7 "NotUsed" 6 "NotifyNotActivatedYet" 5 "NotActivatedYet" 4 "NotifyExpired" 3 "Expired" 2 "ExpiringSoon" 1 "Active" 0 "Null" ;
VAL_TABLE_ TCU_ESN_D_Rq 3 "NotUsed" 2 "TCU_ESN_Request" 1 "NoRequest" 0 "Inactive" ;
VAL_TABLE_ FactoryReset_Rq 1 "ResetFactoryDefaults" 0 "Inactive" ;
VAL_TABLE_ Telematics_D_Falt 7 "NotUsed_5" 6 "NotUsed_4" 5 "NotUsed_3" 4 "NotUsed_2" 3 "NotUsed_1" 2 "RunTimeError" 1 "ChipsetInitializationFailu" 0 "Null" ;
VAL_TABLE_ Null_NotConnected_Conn 3 "NotUsed" 2 "Connected" 1 "NotConnected" 0 "Null" ;
VAL_TABLE_ TCU_Init_Actvtn_St 3 "NotUsed" 2 "InitialActivateDeny" 1 "InitialActivateAccept" 0 "Invalid" ;
VAL_TABLE_ TCU_Final_Actvtn_St 3 "NotUsed" 2 "FinalActivateDeny" 1 "FinalActivateAccept" 0 "Invalid" ;
VAL_TABLE_ Null_Disable_Enable 3 "NotUsed" 2 "Enable" 1 "Disable" 0 "Null" ;
VAL_TABLE_ WaitToStartLamp_D_Falt 3 "NotUsed" 2 "Wait_to_start_lamp_failed" 1 "Diagnosis_not_ready" 0 "Wait_to_start_lamp_OK" ;
VAL_TABLE_ UltraFreshCabn_D_Stat 7 "NotUsed_2" 6 "NotUsed_1" 5 "NotSupported" 4 "Interrupted" 3 "Complete" 2 "Active" 1 "Inactive" 0 "Null" ;
VAL_TABLE_ WifiHtsptTrial_D_RqDrv 3 "NotUsed_1" 2 "StopReminders" 1 "RemindMeLater" 0 "Null" ;
VAL_TABLE_ ModemTechnology_D2_Stat 7 "Lte" 6 "HspaPlus" 5 "Umts" 4 "Edge" 3 "Gprs" 2 "Gsm" 1 "NoNetwork" 0 "Null" ;
VAL_TABLE_ BattTracCoolLvl_D_Rq 7 "Faulty" 6 "NotUsed" 5 "ChillerCoolingBattFirst" 4 "ChillerCoolingCabinFirst" 3 "ForcedCoolingRadiator" 2 "OpportunisticCoolingRad" 1 "CoolantFlowBypassLine" 0 "Off" ;
VAL_TABLE_ BattClntVlvOvrrd_D_Rq 3 "NotUsed" 2 "OverrideTbcvToChiller" 1 "OverrideTbcvToRadiator" 0 "NoOverrideToTbcvCLogic" ;
VAL_TABLE_ NonMagnetic_Magnetic 1 "Magnetic" 0 "NonMagnetic" ;
VAL_TABLE_ AutoTowAllw_D_StatMnu 3 "TowHaulCommandedOn" 2 "AutoTowHaulEnabled" 1 "AutoTowHaulDisabled" 0 "NoSelection" ;
VAL_TABLE_ SpkrStd_D_Stat 3 "Faulty" 2 "Normal" 1 "NotPresent" 0 "Null" ;
VAL_TABLE_ NotAllowed_Allowed 1 "Allowed" 0 "NotAllowed" ;
VAL_TABLE_ EngTrlrCnnct_D_Stat 3 "NotUsed_1" 2 "UnverifiedTrailer" 1 "HeavyTrailer" 0 "NoTrailer" ;
VAL_TABLE_ Faulty_FFFF 65535 "Faulty" ;
VAL_TABLE_ NoData_Faulty_3FFE_3FFF 16383 "Faulty" 16382 "NoDataExists" ;
VAL_TABLE_ Faulty_3FFF 16383 "Faulty" ;
VAL_TABLE_ NotExceeded_Exceeded 1 "Exceeded" 0 "NotExceeded" ;
VAL_TABLE_ EmgcyCall_D_Stat 7 "NotUsed_3" 6 "NotUsed_2" 5 "NotUsed_1" 4 "ManualEmergencyCall" 3 "AutoEmergencyCall" 2 "NoEvent" 1 "EmergencyCallNotSupported" 0 "Null" ;
VAL_TABLE_ NotAsserted_Asserted 1 "Asserted" 0 "NotAsserted" ;
VAL_TABLE_ AirSprngRate_D_Rq 3 "NoRequest" 2 "Firm" 1 "Medium" 0 "Soft" ;
VAL_TABLE_ GearLvr_D_ActlDrv 15 "Fault" 14 "Unknown_Position" 13 "NotUsed_2" 12 "NotUsed_1" 11 "Range6" 10 "Range5" 9 "Range4" 8 "Range3_M3_L3" 7 "Range2_M2_L2" 6 "Range1_M1_L1" 5 "Low" 4 "Sport_DriveSport_Mposition" 3 "Drive" 2 "Neutral" 1 "Reverse" 0 "Park" ;
VAL_TABLE_ ChrgrInPwMde_D_Actl 15 "NotUsed_5" 14 "NotUsed_4" 13 "NotUsed_3" 12 "NotUsed_2" 11 "NotUsed_1" 10 "DcBpt" 9 "DigitalCommEnd" 8 "EvseFault" 7 "EvseNotCompatible" 6 "IcCharging" 5 "DcCharging" 4 "AcDigital" 3 "AcBasic" 2 "DigitalCommDetected" 1 "EvsePaused" 0 "EvseNotDetected" ;
VAL_TABLE_ ChrgCordLck_D_Stat 7 "Faulty" 6 "LockFail" 5 "UnlockFail" 4 "LockInProgress" 3 "UnlockInProgress" 2 "Lock" 1 "Unlock" 0 "Retain" ;
VAL_TABLE_ OffOnNoDataFaulty 3 "Faulty" 2 "No_Data_Exists" 1 "On" 0 "Off" ;
VAL_TABLE_ NoMessage_Msg1_3 3 "Message3" 2 "Message2" 1 "Message1" 0 "NoMessage" ;
VAL_TABLE_ TrnRng_D_RqGsm 15 "Fault" 14 "UnknownPosition" 13 "Undefined_2" 12 "Undefined_1" 11 "_6" 10 "_5" 9 "_4" 8 "_3" 7 "_2" 6 "_1" 5 "Low" 4 "Sport_DriveSport" 3 "Drive" 2 "Neutral" 1 "Reverse" 0 "Park" ;
VAL_TABLE_ PrkBrkActv_D_RqGsmGear 3 "NotUsed" 2 "RequestParkBrakeEngage" 1 "NoRequest" 0 "Null" ;
VAL_TABLE_ TrnPrkSys_D_Actl 15 "Faulty" 14 "NotUsed_5" 13 "NotUsed_4" 12 "NotUsed_3" 11 "NotUsed_2" 10 "NotUsed_1" 9 "FrequencyError" 8 "OutOfRangeHigh" 7 "OutOfRangeLow" 6 "Override" 5 "OutOfPark" 4 "TransitionCloseToOutOfPark" 3 "AtNoSpring" 2 "TransitionCloseToPark" 1 "Park" 0 "NotKnown" ;
VAL_TABLE_ OKLowUnknownInvalid 3 "Invalid" 2 "Unknown" 1 "Low" 0 "OK" ;
VAL_TABLE_ Dsp_RotAddrBtnEv_St 15 "NotUsed_1" 14 "Pos_7Steps" 13 "Pos_6Steps" 12 "Pos_5Steps" 11 "Pos_4Steps" 10 "Pos_3Steps" 9 "Pos_2Steps" 8 "Pos_1Step" 7 "NotPressed" 6 "Neg_1Steps" 5 "Neg_2Steps" 4 "Neg_3Steps" 3 "Neg_4Steps" 2 "Neg_5Steps" 1 "Neg_6Steps" 0 "Neg_7Steps" ;
VAL_TABLE_ PrkAidDrvDir_D_Stat 7 "NotUsed_2" 6 "NotUsed_1" 5 "BackwardNegative" 4 "ForwardNegative" 3 "BackwardPositive" 2 "ForwardPositive" 1 "NoMotion" 0 "DirectionNotKnown" ;
VAL_TABLE_ Pers1Phone_D_Stat 7 "SevenPhoneAssociated" 6 "SixPhoneAssociated" 5 "FivePhoneAssociated" 4 "FourPhoneAssociated" 3 "ThreePhoneAssociated" 2 "TwoPhoneAssociated" 1 "OnePhoneAssociated" 0 "NoPhoneAssociated" ;
VAL_TABLE_ EmgcyCallHmi_D_Stat 15 "NotUsed_1" 14 "Standby" 13 "Disabled" 12 "Malfunction" 11 "CallCompleted" 10 "CallDisconnected" 9 "CallNotPossible" 8 "CallCancelled" 7 "CallRetry" 6 "CallConnected" 5 "CallInProgress" 4 "CallMsdTransfer" 3 "CallDial" 2 "CallCancelTimer" 1 "NoEvent" 0 "Null" ;
VAL_TABLE_ EngExhMdeQuiet_D2_Stat 7 "Faulty" 6 "NotUsed_2" 5 "NotUsed_1" 4 "Track" 3 "Sport" 2 "Normal" 1 "Stealth" 0 "Null" ;
VAL_TABLE_ GasPrtc_D_RqDsply 7 "NotUsed_5" 6 "NotUsed_4" 5 "NotUsed_3" 4 "NotUsed_2" 3 "NotUsed_1" 2 "GpfOverLimit" 1 "GpfAtLimit" 0 "NormalOperation" ;
VAL_TABLE_ TjaWarn_D_Rq 7 "HardTakeOverEyesOff" 6 "SoftTakeOverEyesOff" 5 "HaLaneDeptWarningLeft" 4 "HaLaneDeptWarningRight" 3 "HardTakeOverLevel2" 2 "HardTakeOverLevel1" 1 "TrafficJamAssistCancel" 0 "NoWarning" ;
VAL_TABLE_ Faulty_7FF 2047 "Faulty" ;
VAL_TABLE_ Tja_D_Stat 7 "ExtendedActive" 6 "ActiveWarningRight" 5 "ActiveWarningLeft" 4 "ActiveInterventionRight" 3 "ActiveInterventionLeft" 2 "Active" 1 "Standby" 0 "Off" ;
VAL_TABLE_ TjaMsgTxt_D_Dsply 7 "Disclaimer" 6 "SmartOffering" 5 "HaSelected" 4 "HaUnavailable" 3 "TurnOnAdaptCruiseControl" 2 "TrafficJamAssistSelected" 1 "TrafficJamAssistUnavailabl" 0 "NoMessage" ;
VAL_TABLE_ PwSrcULowMde_D_Actl 3 "BuckSpecial" 2 "ReverseBoost" 1 "ForwardBuck" 0 "Standby" ;
VAL_TABLE_ CamraViewSplit_D_Actl 3 "NotUsed" 2 "Inactive" 1 "Active" 0 "Invalid" ;
VAL_TABLE_ EmgcyCallMute_D_Stat 7 "NotUsed4" 6 "NotUsed3" 5 "NotUsed2" 4 "NotUsed1" 3 "ManualEmergencyCallMute" 2 "AutomaticEmergencyCallMute" 1 "EmergencyCallUnmute" 0 "Null" ;
VAL_TABLE_ ApaTrgtDist_D_Stat 15 "Step15" 14 "Step14" 13 "Step13" 12 "Step12" 11 "Step11" 10 "Step10" 9 "Step9" 8 "Step8" 7 "Step7" 6 "Step6" 5 "Step5" 4 "Step4" 3 "Step3" 2 "Step2" 1 "Step1" 0 "Off" ;
VAL_TABLE_ Memory_2_SwPsngr_Stat 1 "Pressed" 0 "Null" ;
VAL_TABLE_ WifiHtsptEnbl_D_Rq 3 "Not used" 2 "On" 1 "Off" 0 "Null" ;
VAL_TABLE_ WifiHtsptVisbl_D_Rq 3 "Not used" 2 "On" 1 "Off" 0 "Null" ;
VAL_TABLE_ WifiRemoveDevc_D_Rq 3 "NotUsed_1" 2 "FromBlockedList" 1 "FromConnectedList" 0 "Null" ;
VAL_TABLE_ WifiHtsptEnbl_D_Stat 3 "OnDisabled" 2 "On" 1 "Off" 0 "Null" ;
VAL_TABLE_ WifiDevcListNew_B_Stat 1 "Available" 0 "NotAvailable" ;
VAL_TABLE_ WifiHtsptScrty_D_Rq 3 "NotUsed_1" 2 "Wapi" 1 "Wpa2_Wpa" 0 "Null" ;
VAL_TABLE_ WifiDevcList_D_Rq 3 "NoEntry" 2 "BlockedList" 1 "ConnectedList" 0 "Null" ;
VAL_TABLE_ WifiCarrierInfo_B_Rq 1 "Request" 0 "No  request" ;
VAL_TABLE_ WifiHtsptScrty_D_Stat 3 "NotUsed_1" 2 "Wapi" 1 "Wpa2_Wpa" 0 "Null" ;
VAL_TABLE_ WifiDataUsage_D_Rq 3 "RetriveDataFromBackend" 2 "RefreshData" 1 "CurrentData" 0 "Null" ;
VAL_TABLE_ WifiHtsptVisbl_D_Stat 3 "Not  used" 2 "On" 1 "Off" 0 "Null" ;
VAL_TABLE_ ModemSigStren_D_Stat 7 "NotUsed_1" 6 "NotDetermined" 5 "FiveBars" 4 "FourBars" 3 "ThreeBars" 2 "TwoBars" 1 "OneBar" 0 "ZeroBars" ;
VAL_TABLE_ WifiHtsptMacAddr_B_Rq 1 "Request" 0 "No request" ;
VAL_TABLE_ WifiDataUsage_D_Stat 3 "PercentDataUsed" 2 "DataPlanExpired" 1 "FreeTrialPeriodWaiting" 0 "Null" ;
VAL_TABLE_ Pers3Key_D_Stat 3 "NotUsed_1" 2 "KeyUnAssociated" 1 "KeyAssociated" 0 "Null" ;
VAL_TABLE_ PwSrcULoMde_D_Rq 3 "BuckSpecial" 2 "ReverseBoost" 1 "ForwardBuck" 0 "Standby" ;
VAL_TABLE_ AccMsgTxt_D2_Rq 15 "Brakes_Warm" 14 "NCC_Enabled_Warning" 13 "IACC_TJA_Selected" 12 "ACC_TJA_Selected" 11 "IACC_Selected" 10 "Press_Brake_To_Hold" 9 "Only_Following_In_Low_Spd" 8 "TJA_Unavailable" 7 "Shift_Down" 6 "IACC_Unavailable" 5 "ACC_Selected" 4 "ACC_Overridden" 3 "Brake_Capacity_Warning" 2 "ACC_Cancelled" 1 "ACC_Unavailable" 0 "No_Text" ;
VAL_TABLE_ WakeAlarm0_B_Typ 1 "CanAndEcuDriveCircuit" 0 "CanOnly" ;
VAL_TABLE_ WakeAlarm0_D_Stat 3 "PublisherReset" 2 "Wake" 1 "AlarmRunning" 0 "AlarmOff" ;
VAL_TABLE_ EmPrflNo_D_Rq 7 "NotUsed_3" 6 "NotUsed_2" 5 "NotUsed_1" 4 "Pers4" 3 "Pers3" 2 "Pers2" 1 "Pers1" 0 "Null" ;
VAL_TABLE_ EmPrflKeyAssoc_D_Rq 7 "NotUsed_3" 6 "DisassociatePhone" 5 "EnterPhoneAssociation" 4 "OverwriteKey" 3 "DisassociateKey" 2 "ExitKeyAssociation" 1 "EnterKeyAssociation" 0 "Null" ;
VAL_TABLE_ Em_D_Stat 3 "NotSupported" 2 "ProfilesOff" 1 "ProfilesOn" 0 "Null" ;
VAL_TABLE_ EmButtn_D_Stat 7 "ButtonAssociationFailed" 6 "ButtonAssociationExited" 5 "ButtonAssociationEntered" 4 "Button4Pressed" 3 "Button3Pressed" 2 "Button2Pressed" 1 "Button1Pressed" 0 "Null" ;
VAL_TABLE_ EmPrflButtnAssoc_D_Rq 3 "NotUsed" 2 "ExitButtonAssociation" 1 "EnterButtonAssociation" 0 "Null" ;
VAL_TABLE_ EmPrflNo_D_Stat 7 "NotUsed_3" 6 "NotUsed_2" 5 "NotUsed_1" 4 "Pers4" 3 "Pers3" 2 "Pers2" 1 "Pers1" 0 "Null" ;
VAL_TABLE_ EmPrflKeyAssoc_D_Stat 7 "WrongDevice" 6 "KeyAssociateFailed" 5 "KeyAssociateSuccess" 4 "KeyAlreadyInUse" 3 "KeyDisassociated" 2 "KeyAssociationExited" 1 "KeyAssociationEntered" 0 "Null" ;
VAL_TABLE_ PersNo_D_Actl 7 "Unused_3" 6 "Unused_2" 5 "NotDetermined" 4 "Vehicle" 3 "PERS_4" 2 "PERS_3" 1 "PERS_2" 0 "PERS_1" ;
VAL_TABLE_ WiprFront_D_Stat2 15 "NO_DATA_EXISTS" 14 "STALLED" 13 "NotUsed" 12 "AUTO_ADJUST" 11 "COURTESYWIPE" 10 "AUTO_HIGH" 9 "AUTO_LOW" 8 "WASH" 7 "MIST_FLICK" 6 "MAN_HIGH" 5 "MAN_LOW" 4 "MAN_INT_ON" 3 "MAN_INT_OFF" 2 "OFF_MOVING" 1 "AUTO_OFF" 0 "OFF" ;
VAL_TABLE_ TurnLghtSwtch_D_Stat2 3 "NotUsed" 2 "Right" 1 "Left" 0 "Off" ;
VAL_TABLE_ CcButtnOnOffCnclPress3 1 "Pressed" 0 "Not pressed" ;
VAL_TABLE_ SelDrvMdePos01_B_Avail 1 "Available" 0 "NotAvailable" ;
VAL_TABLE_ SelDrvMdePos01_D_Stat 31 "Faulty" 30 "SelDrvMde31" 29 "SelDrvMde30" 28 "SelDrvMde29" 27 "SelDrvMde28" 26 "SelDrvMde27" 25 "SelDrvMde26" 24 "SelDrvMde25" 23 "SelDrvMde24" 22 "SelDrvMde23" 21 "SelDrvMde22" 20 "SelDrvMde21" 19 "SelDrvMde20" 18 "SelDrvMde19" 17 "SelDrvMde18" 16 "SelDrvMde17" 15 "SelDrvMde16" 14 "SelDrvMde15" 13 "SelDrvMde14" 12 "SelDrvMde13" 11 "SelDrvMde12" 10 "SelDrvMde11" 9 "SelDrvMde10" 8 "SelDrvMde09" 7 "SelDrvMde08" 6 "SelDrvMde07" 5 "SelDrvMde06" 4 "SelDrvMde05" 3 "SelDrvMde04" 2 "SelDrvMde03" 1 "SelDrvMde02" 0 "SelDrvMde01" ;
VAL_TABLE_ ImmedFastMediumSlow 3 "Slow" 2 "Medium" 1 "Fast" 0 "Immediately" ;
VAL_TABLE_ AdbHiBeamKeepOff_D_Rq 3 "KeepBothOff" 2 "KeepLeftOff" 1 "KeepRightOff" 0 "BothFreeRunning" ;
VAL_TABLE_ AdbLampOnOff_D_Rq 3 "BothOn" 2 "LeftOnRightOff" 1 "RightOnLeftOff" 0 "BothOff" ;
VAL_TABLE_ Closed_Open_Active_Denied 3 "Denied" 2 "Active" 1 "Open" 0 "Closed" ;
VAL_TABLE_ IaccLamp_D_Rq 3 "NotUsed_2" 2 "NotUsed_1" 1 "DisplayIaccIcon" 0 "DoNotDisplayIaccIcon" ;
VAL_TABLE_ Low_High_Confidence 1 "High_Confidence" 0 "Low_Confidence" ;
VAL_TABLE_ Fault_Occupied_Empty_Un 3 "Unknown" 2 "Empty" 1 "Occupied" 0 "Fault" ;
VAL_TABLE_ Off_On_Flash_Triggered 3 "Triggered" 2 "Flash" 1 "On" 0 "Off" ;
VAL_TABLE_ KeyOffMde_D_Actl 15 "NotUsed_11" 14 "NotUsed_10" 13 "NotUsed_9" 12 "NotUsed_8" 11 "NotUsed_7" 10 "NotUsed_6" 9 "NotUsed_5" 8 "NotUsed_4" 7 "NotUsed_3" 6 "NotUsed_2" 5 "NotUsed_1" 4 "CriticalBattery" 3 "Hibernate" 2 "Transport" 1 "Factory" 0 "Normal" ;
VAL_TABLE_ IaccVLim_D_Rq 252 "NotUsed_2" 250 "LimitSpeed_250" 240 "LimitSpeed_240" 230 "LimitSpeed_230" 220 "LimitSpeed_220" 210 "LimitSpeed_210" 200 "LimitSpeed_200" 190 "LimitSpeed_190" 150 "LimitSpeed_150" 140 "LimitSpeed_140" 130 "LimitSpeed_130" 120 "LimitSpeed_120" 110 "LimitSpeed_110" 100 "LimitSpeed_100" 90 "LimitSpeed_90" 80 "LimitSpeed_80" 70 "LimitSpeed_70" 60 "LimitSpeed_60" 50 "LimitSpeed_50" 40 "LimitSpeed_40" 30 "LimitSpeed_30" 20 "LimtSpeed_20" 251 "NotUsed_1" 255 "Faulty" 254 "NoDataExists" 253 "NotUsed_3" 180 "LimitSpeed_180" 179 "LimitSpeed_179" 178 "LimitSpeed_178" 177 "LimitSpeed_177" 176 "LimitSpeed_176" 175 "LimitSpeed_175" 174 "LimitSpeed_174" 173 "LimitSpeed_173" 172 "LimitSpeed_172" 171 "LimitSpeed_171" 170 "LimitSpeed_170" 169 "LimitSpeed_169" 168 "LimitSpeed_168" 167 "LimitSpeed_167" 166 "LimitSpeed_166" 165 "LimitSpeed_165" 164 "LimitSpeed_164" 163 "LimitSpeed_163" 162 "LimitSpeed_162" 161 "LimitSpeed_161" 160 "LimitSpeed_160" 15 "LimitSpeed_15" 14 "LimitSpeed_14" 13 "LimitSpeed_13" 12 "LimitSpeed_12" 11 "LimitSpeed_11" 10 "LimitSpeed_10" 9 "LimitSpeed_9" 8 "LimitSpeed_8" 7 "LimitSpeed_7" 6 "LimitSpeed_6" 5 "LimitSpeed_5" 4 "LimitSpeed_4" 3 "LimitSpeed_3" 2 "LimitSpeed_2" 1 "LimitSpeed_1" 0 "LimitSpeed_0" ;
VAL_TABLE_ IaccVLimUnit_D_Rq 3 "NoDataExists" 2 "Mph" 1 "Kph" 0 "Null" ;
VAL_TABLE_ SelDrvMdeAwd_D_Rq 31 "Faulty" 30 "NotUsed_17" 29 "NotUsed_16" 28 "NotUsed_15" 27 "NotUsed_14" 26 "NotUsed_13" 25 "NotUsed_12" 24 "NotUsed_11" 23 "NotUsed_10" 22 "NotUsed_9" 21 "NotUsed_8" 20 "CustomMode" 19 "OnePedalDrive" 18 "DragMode" 17 "EvLaterChargeMode" 16 "EvNowMode" 15 "TrackMode" 14 "RoughRoadMode" 13 "NotAvailable" 12 "HighSpeedDesertMode_Baja" 11 "SportAdaptiveMode" 10 "RockCrawlMode" 9 "MudRutsMode" 8 "SandMode" 7 "EconomyMode" 6 "GrassGravelSnow" 5 "TowHaulMode" 4 "SportMode" 3 "Normal_4L" 2 "Normal_4A" 1 "Normal_2H" 0 "NormalMode" ;
VAL_TABLE_ SelDrvMdeAwd_D_Stat 0 "NotAvailable" 1 "Available" 2 "TemporarilyNotAvailable" 3 "Faulty" ;
VAL_TABLE_ SelDrvMdeAwd2_D_Stat 31 "Faulty" 30 "NotUsed_17" 29 "NotUsed_16" 28 "NotUsed_15" 27 "NotUsed_14" 26 "NotUsed_13" 25 "NotUsed_12" 24 "NotUsed_11" 23 "NotUsed_10" 22 "NotUsed_9" 21 "NotUsed_8" 20 "CustomMode" 19 "OnePedalDrive" 18 "DragMode" 17 "EvLaterChargeMode" 16 "EvNowMode" 15 "TrackMode" 14 "RoughRoadMode" 13 "NotAvailable" 12 "HighSpeedDesertMode_Baja" 11 "SportAdaptiveMode" 10 "RockCrawlMode" 9 "MudRutsMode" 8 "SandMode" 7 "EconomyMode" 6 "GrassGravelSnow" 5 "TowHaulMode" 4 "SportMode" 3 "Normal_4L" 2 "Normal_4A" 1 "Normal_2H" 0 "NormalMode" ;
VAL_TABLE_ RearDiffLckMsg2_D_Rq 15 "NotUsed_3" 14 "NotUsed_2" 13 "NotUsed_1" 12 "ElsdReduced" 11 "LockingFeatureNotAvailable" 10 "EsldOff" 9 "ElsdRestored" 8 "ElsdOverheated" 7 "Locker_Disabled" 6 "Locker_Enabled" 5 "LockerSpeed5" 4 "LockerSpeed4" 3 "LockerSpeed3" 2 "LockerSpeed2" 1 "LockerSpeed1" 0 "NormalNoMessage " ;
VAL_TABLE_ Counts_ZeroToSeven 4 "FourCounts" 3 "ThreeCounts" 2 "TwoCounts" 1 "OneCount" 0 "ZeroCounts" 7 "SevenOrMoreCounts" 6 "SixCounts" 5 "FiveCounts" ;
VAL_TABLE_ EmgcyAsstActv_D_Stat 3 "ConfiguredOff" 2 "Active" 1 "Inactive" 0 "Null" ;
VAL_TABLE_ HeadLghtHiPrmsn_D_Stat 3 "CancelAndSuppress" 2 "Cancel" 1 "Hold" 0 "AllowChange" ;
VAL_TABLE_ SelDrvMdeSwtch 3 "Faulty" 2 "SwitchState2" 1 "SwitchState1" 0 "NotPressed" ;
VAL_TABLE_ NotAvail_Temp_Faulty 3 "Faulty" 2 "TemporarilyNotAvailable" 1 "Available" 0 "NotAvailable" ;
VAL_TABLE_ ChrgCompltMsgTxt_D_Rq 3 "NotUsed_1" 2 "ChargeToFull" 1 "ChargeToFastChargeLimit" 0 "DefaultLabel" ;
VAL_TABLE_ AwdDrvMde 7 "Faulty" 6 "NotAvailable" 5 "RockCrawl" 4 "Baja" 3 "MudAndSand" 2 "Weather" 1 "Sport" 0 "Normal" ;
VAL_TABLE_ SelDrvMdePt_D_Rq 31 "Faulty" 30 "NotUsed15" 29 "NotUsed14" 28 "NotUsed13" 27 "NotUsed12" 26 "NotUsed11" 25 "NotUsed10" 24 "NotUsed9" 23 "NotUsed8" 22 "NotUsed7" 21 "CustomMode" 20 "TrackMode" 19 "OnePedalDrive" 18 "EvLaterChargerMode" 17 "EvNowMode" 16 "DragMode" 15 "HighSpeedDesertMode_Baja" 14 "SportAdaptiveMode" 13 "NotAvailable_13" 12 "NotAvailable_12" 11 "NotAvailable_11" 10 "NotAvailable_10" 9 "RockCrawlMode" 8 "MudRutsMode" 7 "SandMode" 6 "EconomyMode" 5 "GrassGravelSnow" 4 "NotAvailable_04" 3 "TowHaulMode" 2 "NotAvailable_02" 1 "SportMode" 0 "NormalMode" ;
VAL_TABLE_ OffLockUnlockFaulty 3 "Faulty" 2 "Unlock" 1 "Lock" 0 "Off" ;
VAL_TABLE_ SelDrvMde_D_Stat 3 "NotUsed" 2 "DriveModeChangeRequest" 1 "DriveModeChangeSelection" 0 "NoDriveModeChangeRequest" ;
VAL_TABLE_ NoMessage_Msg1_15 15 "Message15" 14 "Message14" 13 "Message13" 12 "Message12" 11 "Message11" 10 "Message10" 9 "Message9" 8 "Message8" 7 "Message7" 6 "Message6" 5 "Message5" 4 "Message4" 3 "Message3" 2 "Message2" 1 "Message1" 0 "NoMessage" ;
VAL_TABLE_ SelDrvMdeChassis_D_Rq 31 "Faulty" 30 "NotUsed17" 29 "NotUsed16" 28 "NotUsed15" 27 "NotUsed14" 26 "NotUsed13" 25 "NotUsed12" 24 "NotUsed11" 23 "NotUsed10" 22 "NotUsed9" 21 "NotUsed8" 20 "NotUsed7" 19 "NotUsed6" 18 "NotUsed5" 17 "NotUsed4" 16 "OnePedalDrive" 15 "DragMode" 14 "RoughRoadMode" 13 "TrackMode" 12 "HighSpeedDesertMode" 11 "TowHaulMode" 10 "RockCrawlMode" 9 "SandMode" 8 "MudAndRutsMode" 7 "LowMuMode" 6 "ComfortAdaptiveMode" 5 "ComfortMode" 4 "SportAdaptiveMode" 3 "SportMode" 2 "EconomyMode" 1 "NormalAdaptiveMode" 0 "NormalMode" ;
VAL_TABLE_ NotAvailable_Available 1 "Available" 0 "NotAvailable" ;
VAL_TABLE_ PwStep_D_Stat 3 "PositionNotKnown" 2 "StepsNotStowed" 1 "StepsStowed" 0 "Off" ;
VAL_TABLE_ PwStep_D_DrvInhbt 3 "NotUsed" 2 "DriveInhibitMalfunction" 1 "DriveInhibited" 0 "DriveNotInhibited" ;
VAL_TABLE_ NoMessage_Msg1_31 31 "Message31" 30 "Message30" 29 "Message29" 28 "Message28" 27 "Message27" 26 "Message26" 25 "Message25" 24 "Message24" 23 "Message23" 22 "Message22" 21 "Message21" 20 "Message20" 19 "Message19" 18 "Message18" 17 "Message17" 16 "Message16" 15 "Message15" 14 "Message14" 13 "Message13" 12 "Message12" 11 "Message11" 10 "Message10" 9 "Message9" 8 "Message8" 7 "Message7" 6 "Message6" 5 "Message5" 4 "Message4" 3 "Message3" 2 "Message2" 1 "Message1" 0 "NoMessage" ;
VAL_TABLE_ VehTrvlDir_D_Stat 7 "Faulty" 6 "NoDataExists" 5 "NotUsed2" 4 "NotUsed1" 3 "Reverse" 2 "LikelyReverse" 1 "Forward" 0 "LikelyForward" ;
VAL_TABLE_ SelDrvMdeSusp_D_Stat 3 "Faulty" 2 "TemporarilyNotAvailable" 1 "Available" 0 "NotAvailable" ;
VAL_TABLE_ OffOnNoReqFaulty 3 "Faulty" 2 "NoRequest" 1 "On" 0 "Off" ;
VAL_TABLE_ LatCtlSte_D_Stat 7 "NotUsed3" 6 "NotUsed2" 5 "NotUsed1" 4 "Denied" 3 "RampOut" 2 "ContLatControlInProgress" 1 "Available" 0 "Unavailable" ;
VAL_TABLE_ LatCtlLim_D_Stat 3 "LimitWithDriverActive" 2 "LimitReached" 1 "LimitClose" 0 "LimitNotReached" ;
VAL_TABLE_ FuelLvlWarn_D_ActlEng 7 "DteLevel5Lowest" 6 "DteLevel4" 5 "DteLevel3" 4 "DteLevel2NonMyKey" 3 "DteLevel1MyKey" 2 "VeryLow" 1 "Low" 0 "OK" ;
VAL_TABLE_ AwdMde_D_RqDrv 7 "Faulty" 6 "NotUsed2" 5 "NoRequest" 4 "Neutral" 3 "FourByFourLow" 2 "FourByFourHigh" 1 "FourByFourAuto" 0 "FourByTwo" ;
VAL_TABLE_ ApaBrk_D_Stat 3 "Denied" 2 "Active" 1 "Open" 0 "Closed" ;
VAL_TABLE_ AdptDrvMdePt_D_Rq 7 "Faulty" 6 "NotUsed3" 5 "NotUsed2" 4 "NotUsed1" 3 "Powertrain2Sport" 2 "Powertrain2Normal" 1 "Powertrain2Comfort" 0 "AdaptiveNotActive" ;
VAL_TABLE_ AdptDrvMdeChassis_D_Rq 7 "Faulty" 6 "NotUsed3" 5 "NotUsed2" 4 "NotUsed1" 3 "Chassis2Sport" 2 "Chassis2Normal" 1 "Chassis2Comfort" 0 "AdaptiveNotActive" ;
VAL_TABLE_ AccSetVMde_D_Stat 3 "IaccNotConfigured" 2 "ManualMode" 1 "AutoMode" 0 "Null" ;
VAL_TABLE_ PwStepMsgTxt_D_Rq 1 "DriveInhibited" 0 "NoMessage" 3 "NotUsed" 2 "Malfunction" ;
VAL_TABLE_ OffLowMedHigh 3 "High" 2 "Medium" 1 "Low" 0 "Off" ;
VAL_TABLE_ HeadLghtHiCtrl_D_RqAhb 7 "NotUsed2" 6 "NotUsed1" 5 "Auto_HiBeam" 4 "Auto_LoBeam" 3 "Flash" 2 "Man_HiBeam" 1 "Man_LoBeam" 0 "Null" ;
VAL_TABLE_ AhbHiBeam_D_Rq 3 "NotUsed" 2 "HighBeamRecommended" 1 "LowBeamRecommended" 0 "DeactivatedUnavailable" ;
VAL_TABLE_ AhbStatGfhbFdbk_D_Actl 3 "GfhbHighBeamFullyOn" 2 "GfhbHighBeamPartlyOn" 1 "GfhbHighBeamOff" 0 "GfhbUnavailable" ;
VAL_TABLE_ AhbcRampingV_D_Rq 3 "Slow" 2 "Medium" 1 "Fast" 0 "Immediately" ;
VAL_TABLE_ ApaGearShif_D_RqDrv 7 "NotUSed2" 6 "NotUsed1" 5 "ShiftToP" 4 "ShiftToN" 3 "ShiftToD" 2 "ShiftToR" 1 "NoRequest" 0 "Null" ;
VAL_TABLE_ ApaLongCtl_D_RqDrv 7 "NotUsed3" 6 "NotUsed2" 5 "ReleaseBrake" 4 "DriveBackward" 3 "DriveForward" 2 "Stop" 1 "NoRequest" 0 "Null" ;
VAL_TABLE_ ApaActvSide2_D_Stat 3 "NoSide" 2 "Right" 1 "Left" 0 "Null" ;
VAL_TABLE_ ApaScan_D_Stat 3 "ParkSlotReady" 2 "ParkSlotFound" 1 "NoParkSlot" 0 "Null" ;
VAL_TABLE_ ApaSelSapp_D_Stat 3 "NotConfigured" 2 "NotSelectable" 1 "Selectable" 0 "Null" ;
VAL_TABLE_ ApaSys_D_Stat 7 "Faulty" 6 "Finished" 5 "NotAccessible" 4 "ApaCancelled" 3 "Overspeed" 2 "On" 1 "Off" 0 "Null" ;
VAL_TABLE_ ApaAcsy_D_RqDrv 7 "CloseDoor" 6 "SelectSideRight" 5 "SelectSideLeft" 4 "CheckForObject" 3 "PressApaButton" 2 "SelectSide" 1 "NoRequest" 0 "Null" ;
VAL_TABLE_ ApaSteWhl_D_RqDrv 3 "TakeControl" 2 "RemoveHands" 1 "NoRequest" 0 "Null" ;
VAL_TABLE_ WiprFrontSwtch_D_Stat 15 "NotUsed6" 14 "NotUsed5" 13 "NotUsed4" 12 "NotUsed3" 11 "NotUsed2" 10 "NotUsed1" 9 "PositionNotDetermined" 8 "High" 7 "Low" 6 "Position6" 5 "Position5" 4 "Position4" 3 "Position3" 2 "Position2" 1 "Position1" 0 "Off" ;
VAL_TABLE_ NoDataExists_Off_On 2 "On" 1 "Off" 0 "No_Data_Exists" ;
VAL_TABLE_ ChimeOff_ChimeOn 1 "Chime_On" 0 "Chime_Off" ;
VAL_TABLE_ TrlrTireSens_D_Stat 15 "NotSupported" 14 "NotUsed10" 13 "NotUsed9" 12 "NotUsed8" 11 "NotUsed7" 10 "NotUsed6" 9 "NotUsed5" 8 "NotUsed4" 7 "NotUsed3" 6 "NotUsed2" 5 "NotUsed1" 4 "Alert" 3 "Fault" 2 "Low" 1 "Normal" 0 "Unknown" ;
VAL_TABLE_ InvalidFFFE_NotSupportedFFFF 65534 "Invalid" 65535 "NotSupported" ;
VAL_TABLE_ TrlrTireSys_D_Stat 15 "NotUsed" 14 "TiresNotTrained" 13 "TrainingComplete" 12 "TrainLMTire" 11 "TrainLRTire" 10 "TrainRMTire" 9 "TrainRRTire" 8 "TrainRFTire" 7 "TrainLFTire" 6 "RequestPressureThresh" 5 "RequestTireCount" 4 "SystemActive" 3 "TireLow" 2 "SensorFault" 1 "System Fault" 0 "SystemUnknown" ;
VAL_TABLE_ TrlrTireCnt_D_RqDrv 7 "Faulty" 6 "TwelveTire" 5 "EightTire" 4 "FourTireOneAxle" 3 "Six_Tire" 2 "Four_Tire" 1 "Two_Tire" 0 "Unconfigured" ;
VAL_TABLE_ Chirp_D_RqTrlr 3 "NotUsed" 2 "Chirp_2" 1 "Chirp_1" 0 "NoRequest" ;
VAL_TABLE_ Off_On_Unknown_Invalid 3 "Invalid" 2 "Unknown" 1 "On" 0 "Off" ;
VAL_TABLE_ Unknown_7FFE_Invalid_7FFF 32767 "Invalid" 32766 "Unknown" ;
VAL_TABLE_ OffOnNotUsedFaulty 3 "Faulty" 2 "NotUsed" 1 "On" 0 "Off" ;
VAL_TABLE_ HeadLghtOn_D_Rq 7 "NotUsed2" 6 "NotUsed1" 5 "DrlBoth" 4 "DrlRight" 3 "DrlLeft" 2 "High" 1 "Low" 0 "Off" ;
VAL_TABLE_ BrkBstrVac_D_Stat 3 "NotUsed" 2 "BoosterVacEstimator" 1 "BoosterVacSensor" 0 "NoBoosterVacuumMonitor" ;
VAL_TABLE_ AwdMde_D_RqArb 7 "Faulty" 6 "NotUsed2" 5 "NoRequest" 4 "Neutral" 3 "FourByFourLow" 2 "FourByFourHigh" 1 "FourByFourAuto" 0 "FourByTwo" ;
VAL_TABLE_ SeatPos_D_Stat 7 "NotUsed3" 6 "NotUsed2" 5 "Error" 4 "Drive" 3 "Moving" 2 "Pending" 1 "EasyEntry" 0 "Null" ;
VAL_TABLE_ CtaAlrt2_D_Stat 7 "NotUsed3" 6 "NotUsed2" 5 "NotUsed1" 4 "AlertZone4" 3 "AlertZone3" 2 "AlertZone2" 1 "AlertZone1" 0 "Off" ;
VAL_TABLE_ BttRightLeft_D_Stat 7 "NotUsed" 6 "Disabled" 5 "Off" 4 "OffTemp" 3 "NotConnected" 2 "Pending" 1 "Connected" 0 "NotDetermined" ;
VAL_TABLE_ Null_NoRequest_Request 3 "NotUsed" 2 "Request" 1 "NoRequest" 0 "Null" ;
VAL_TABLE_ PoliceIdlMde_D_Stat 15 "NotUsed_7" 14 "NotUsed_6" 13 "NotUsed_5" 12 "NotUsed_4" 11 "NotUsed_3" 10 "UtilityIdleActive" 9 "PepsActive" 8 "Decommissioned" 7 "ActiveFault" 6 "ArmFault" 5 "PrearmedFault" 4 "OffFault" 3 "Active" 2 "Arm" 1 "Prearmed" 0 "Off" ;
VAL_TABLE_ LghtAmbIntns_D_Sns 3 "Faulty" 2 "High" 1 "Low" 0 "Null" ;
VAL_TABLE_ TripComputerMetricImperial 0 "TripComputer_metric" 1 "TripComputer_imperial" ;
VAL_TABLE_ GrdAsstAllw_D_DsplyPt 3 "NotUsed" 2 "On" 1 "Off" 0 "NoModeSelected" ;
VAL_TABLE_ TextMessage_Rsp 3 "Cancelled" 2 "MessageIgnored" 1 "Listening" 0 "Invalid" ;
VAL_TABLE_ IncCallOption 0 "Inactive" 1 "RejectAll" 2 "AcceptIncomingCall" 3 "Silent" ;
VAL_TABLE_ BTInCallOptions_St 6 "HoldModeoff" 5 "InHoldMode" 4 "InHandsFreeMode" 3 "InPrivacyMode" 2 "Joined" 1 "Switched" 0 "Inactive" ;
VAL_TABLE_ VRM_ComSourceSelect_St 7 "BTAudio" 6 "Con" 0 "Invalid" 1 "CommandNotIssued" 2 "Radio" 3 "SDCard" 4 "SingleDisc" 5 "MultiDisc" ;
VAL_TABLE_ VRM_ComRouteStrategy_St 0 "Invalid" 1 "CommandNotIssued" 2 "Shortesttime" 3 "Shortestdistance" 4 "Majorroadsavoid" 5 "Majorroadsprefer" 6 "TollRoadsaviod" 7 "TollRoadsprefer" 8 "Ferriesavoid" 9 "Ferriesprefer" ;
VAL_TABLE_ VRM_ComStFreqMode_St 0 "Invalid" 1 "CommandNotIssued" 2 "Fm" 3 "Am" 4 "Reserved" ;
VAL_TABLE_ VRM_ComAutostore_St 0 "Invalid" 1 "CommandNotIssued" 2 "PerfomAutostore" ;
VAL_TABLE_ VRM_ComBand_St 0 "Invalid" 1 "CommandNotIssued" 2 "Fm1" 3 "Fm2" 4 "Fmas" 5 "Am" 6 "Amas" 7 "AutostoreMode" ;
VAL_TABLE_ VRM_NewSMS 3 "UnreadSMSMessagesAvailable" 0 "Invalid" 1 "NewSmsAvailable" 2 "NoNewSmsAvailable" ;
VAL_TABLE_ VRM_ComPresetCall_St 0 "Invalid" 1 "CommandNotIssued" 2 "Prescall1" 3 "Prescall2" 4 "Prescall3" 5 "Prescall4" 6 "Prescall5" 7 "Prescall6" ;
VAL_TABLE_ VRM_ComTape_St 0 "Invalid" 1 "CommandNotIssued" 2 "Play" 3 "Rewind" 4 "Forward" 5 "ChangeSide" 6 "AutosearchForward" 7 "AutosearchBackward" ;
VAL_TABLE_ VRM_BTDefaultPhone_St 0 "Invalid" 1 "PhoneIndex1" 2 "PhoneIndex2" 3 "PhoneIndex3" 4 "PhoneIndex4" 5 "PhoneIndex5" 6 "PhoneIndex6" 7 "CradlePhone" 8 "NoPhone" ;
VAL_TABLE_ VRM_DetourUnit_st 0 "Invalid" 1 "Miles" 2 "Kilometer" 3 "Nounitdefined" ;
VAL_TABLE_ Zoom_Option_St 0 "Invalid" 1 "AbsoluteValue" 2 "InrelativeValue" 3 "OutrelativeValue" ;
VAL_TABLE_ VRM_ComBTDTMFTone_St 14 "Dtmfplus" 0 "Invalid" 1 "CommandNotIssued" 2 "Dtmf0" 3 "Dtmf1" 4 "Dtmf2" 5 "Dtmf3" 6 "Dtmf4" 7 "Dtmf5" 8 "Dtmf6" 9 "Dtmf7" 10 "Dtmf8" 11 "Dtmf9" 12 "Dtmfstar" 13 "Dtmfcross" ;
VAL_TABLE_ DSP_ChimeChanState_St 7 "Reserved4" 6 "Reserved3" 5 "Reserved2" 4 "Reserved" 3 "Busy" 2 "Ready" 1 "Muted" 0 "Invalid" ;
VAL_TABLE_ DSP_Alert_Channel3 3 "Reserved" 2 "Muted" 1 "Initialized_for_Prompts" 0 "Inactive" ;
VAL_TABLE_ DSP_AlertChannel 3 "Initialized_for_chimes" 2 "Muted" 1 "Reserved" 0 "Inactive" ;
VAL_TABLE_ VRM_SuggestedRoute_St 0 "Invalid" 1 "CommandNotIssued" 2 "Accept" 3 "Reject" ;
VAL_TABLE_ VRM_ComDelWaypoint_St 0 "Invalid" 1 "CommandNotIssued" 2 "DeleteNextWayptDestination" ;
VAL_TABLE_ VRM_ComSelectDisc_St 0 "Invalid" 1 "CommandNotIssued" 2 "Disc1" 3 "Disc2" 4 "Disc3" 5 "Disc4" 6 "Disc5" 7 "Disc6" ;
VAL_TABLE_ VRM_ComTelService_St 0 "Invalid" 1 "CommandNotIssued" 2 "InformationCall" 3 "TelephonyCall" 4 "RedialLastIncoming" ;
VAL_TABLE_ VRM_ComDestHome_St 0 "Invalid" 1 "CommandNotIssued" 2 "SetDestinationHome" ;
VAL_TABLE_ VRM_ComShowNavInfo_St 0 "Invalid" 1 "CommandNotIssued" 2 "CurrentPos" 3 "Destination" 4 "CompleteRoute" 5 "NorthDirectionToTop" 6 "CarDirectionToTop" 7 "TurnList" ;
VAL_TABLE_ VRM_VoiceRecStatus_St 0 "Invalid" 1 "Idle" 2 "Listening" 3 "Reserved" 4 "CommandNotAllowed" ;
VAL_TABLE_ VRM_ComSelTrackSource_St 0 "Invalid" 1 "CommandNotIssued" 2 "Cd" 3 "CdChanger" ;
VAL_TABLE_ VRM_ComDetour_St 0 "Invalid" 1 "CommandNotIssued" 2 "Detour1" 3 "Detour2" 4 "Detour3" 5 "Detour4" 6 "Detour5" 7 "Detour10" 8 "Detour15" 9 "Detour20" 10 "Detour25" 11 "Detour50" 12 "Detour100" ;
VAL_TABLE_ VRM_ComDisplay_St 0 "Invalid" 1 "CommandNotIssued" 2 "DisplayOn" 3 "DisplayOff" 4 "Day" 5 "Night" 6 "Auto" 7 "Twilight" ;
VAL_TABLE_ VRM_ComSt 0 "Invalid" 1 "CommandNotIssued" 2 "On" 3 "Off" ;
VAL_TABLE_ VRM_ComZoom_St 0 "Invalid" 1 "CommandNotIssued" 2 "Level1" 3 "Level2" 4 "Level3" 5 "Level4" 6 "Level5" 7 "Level6" 8 "Level7" 9 "Level8" 10 "Level9" 11 "Level10" 12 "Level11" 13 "Level12" 14 "Level13" ;
VAL_TABLE_ VRM_ComCallControl_St 0 "Invalid" 1 "CommandNotIssued" 2 "Pickup" 3 "Reject" 4 "EndOngoingCall" ;
VAL_TABLE_ VRM_ComGuidance_St 0 "Invalid" 1 "CommandNotIssued" 2 "VoiceGuidanceOn" 3 "VoiceGuidanceOff" 4 "CancelGuidance" 5 "RepeatLastVoiceGuidance" ;
VAL_TABLE_ VRM_ComTrafficInfDsp_St 0 "Invalid" 1 "CommandNotIssued" 2 "ShowTrafficInfoOnDisplay" 3 "HideTrafficInfoOnDisplay" ;
VAL_TABLE_ PhMicrophoneMute_St 3 "Reserved" 2 "MicrophoneIsUnmuted" 1 "MicrophoneIsMuted" 0 "Invalid" ;
VAL_TABLE_ Aioc_ExtSrcOutpMode_St 8 "NotAllocated" 4 "AllocatedBtAudio" 3 "AllocatedBtNavigation" 2 "AllocatedBtPhone" 1 "AllocatedVr" 0 "Invalid" 7 "AllocatedAUX3" 6 "AllocatediPod" 5 "AllocatedUSB" ;
VAL_TABLE_ VRM_BTPhoneSts_St 16 "Connected_Call_on_hold" 15 "Conference_OtherCallOnHold" 0 "Invalid" 1 "Idle" 2 "Dialing" 3 "Connected" 4 "CradlephNotReady" 5 "NumUnobtainable" 6 "IncomCall" 7 "NoLinkToBt" 8 "InitBtCon" 9 "PhoneBusy" 10 "PhoneVr" 11 "NotSupported" 12 "BtPhPriv" 13 "ConfCall" 14 "Conference_2ndIncCall" ;
VAL_TABLE_ VRM_SubscribeStatus_St 0 "Invalid" 1 "OnSubscribingInfo" 2 "OffNotSubscribingInfo" ;
VAL_TABLE_ Invalid_On_Off 0 "Invalid" 1 "On" 2 "Off" ;
VAL_TABLE_ LangUpdate 2 "Language_Not_Supported" 1 "Language_Updated" 0 "Inactive" ;
VAL_TABLE_ PrkBrkMsgTxt_D_Rq 15 "Message15" 14 "Message14" 13 "Message13" 12 "Message12" 11 "Message11" 10 "Message10" 9 "Message9" 8 "Message8" 7 "Message7" 6 "Message6" 5 "Message5" 4 "Message4" 3 "Message3" 2 "Message2" 1 "Message1" 0 "No_Message" ;
VAL_TABLE_ AutoHoldMsgTxt_D_Rq 15 "Message15" 14 "Message14" 13 "Message13" 12 "Message12" 11 "Message11" 10 "Message10" 9 "Message9" 8 "Message8" 7 "Message7" 6 "Message6" 5 "Message5" 4 "Message4" 3 "Message3" 2 "Message2" 1 "Message1" 0 "NoMessage" ;
VAL_TABLE_ AutoHoldMde_D_Ind 3 "Indication_3" 2 "Indication_2" 1 "Indication_1" 0 "Off" ;
VAL_TABLE_ AutoRgenTxt_B_RqDsply 1 "AutExhFilterCleanOFF" 0 "AutExhFilterCleanON" ;
VAL_TABLE_ TbsLamp_D_RqDsply 3 "Not_Used" 2 "Flash" 1 "On" 0 "Off" ;
VAL_TABLE_ TrnMsgTxt2_D_Rq 7 "NotUsed3" 6 "NotUsed2" 5 "NotUsed1" 4 "TransTooHot_LoudChime" 3 "PressBrake_LoudChime" 2 "PressBrake_SoftChime" 1 "PressBrake_NoChime" 0 "NoText_NoChime" ;
VAL_TABLE_ TrnGearMsgTxt_D_Rq 15 "Message_15" 14 "Message_14" 13 "Message_13" 12 "Message_12" 11 "Message_11" 10 "Message_10" 9 "Message_9" 8 "Message_8" 7 "Message_7" 6 "Message_6" 5 "Message_5" 4 "Message_4" 3 "Message_3" 2 "Message_2" 1 "Message_1" 0 "NoMessage" ;
VAL_TABLE_ ConsUnitAPIM_D_Dsply 15 "Reserved_15" 14 "Reserved_14" 13 "Reserved_13" 12 "Reserved_12" 11 "Reserved_11" 10 "Reserved_10" 9 "Reserved_9" 8 "Liters___100_km" 7 "Miles___Gallon" 6 "Whr___km_" 5 "Whr___mi_" 4 "miles_gallon__UK_" 2 "Liters___100_km" 1 "Miles___Gallon__US_" 0 "Invalid" 3 "km_L" ;
VAL_TABLE_ ConsHistTAPIM_D_Dsply 3 "Display6_MinuteIncrements" 2 "Display2_MinuteIncrements" 1 "Display1_MinuteIncrements" 0 "Invalid" ;
VAL_TABLE_ CPM_MediaPlayerSrc_St 31 "Empty" 30 "Reserved14" 29 "Reserved13" 28 "Reserved12" 27 "Reserved11" 26 "Reserved10" 25 "Reserved9" 24 "Reserved8" 23 "Reserved7" 22 "Reserved6" 21 "Reserved5" 20 "Reserved4" 19 "Reserved3" 18 "Reserved2" 17 "Reserved1" 16 "SourceID16" 15 "SourceID15" 14 "SourceID14" 13 "SourceID13" 12 "SourceID12" 11 "SourceID11" 10 "SourceID10" 9 "SourceID9" 8 "SourceID8" 7 "SourceID7" 6 "SourceID6" 5 "SourceID5" 4 "SourceID4" 3 "SourceID3" 2 "SourceID2" 1 "SourceID1" 0 "NoDataExists" ;
VAL_TABLE_ Audio_Amp_St 3 "On" 2 "Partial_Amp" 1 "Off" 0 "NoDataExists" ;
VAL_TABLE_ ChimeAlertChan 2 "Reserved" 1 "Mute" 0 "Inactive" ;
VAL_TABLE_ AHU_Alert_Channel1 3 "Reserved" 2 "Muted" 1 "Initialize_for_prompt" 0 "Inactive" ;
VAL_TABLE_ Chime 63 "Chime_62" 4 "Chime_3" 3 "Chime_2" 2 "Chime_1" 1 "NoChime" 0 "Inactive" ;
VAL_TABLE_ Chime_NotRecgnizd 0 "Inactive" 1 "Chime_Not_Recognized" ;
VAL_TABLE_ FunctionStatus 7 "RemoveDisc" 0 "Invalid" 1 "Reading" 2 "Loading" 3 "Loaded" 4 "Insert" 5 "PreparingToEject" 6 "Ejecting" ;
VAL_TABLE_ InvalidFF_NoValidPreset 255 "NoValidPreset" 0 "Invalid" ;
VAL_TABLE_ ACU_CurrPreset2_St 31 "NoActivePreset" 0 "Invalid" ;
VAL_TABLE_ ACU_StorePreset_St 31 "NotStoring" 0 "Invalid" ;
VAL_TABLE_ ACU_RadioSeekMode_St 14 "PISeek" 0 "Invalid" 1 "SeekOff" 2 "AutoUp" 3 "AutoDown" 4 "ManSingleStepUp" 5 "ManSingleStepDown" 6 "ContManualUp" 7 "ContManualDown" 8 "ScanUp" 9 "ScanDown" 10 "PtySeekUp" 11 "PtySeekDown" 12 "Autostore" 13 "TpSeek" ;
VAL_TABLE_ ACU_AutoStoreResult_St 2 "No_Station_Found" 1 "Inactive" 0 "Invalid" ;
VAL_TABLE_ ACU_DirectTune_St 2 "Valid_Station" 1 "Invalid_Station" 0 "Invalid" ;
VAL_TABLE_ ACU_RadioSeekMode2_St 16 "ContAutoDown" 15 "ContAutoUp" 14 "PISeek" 13 "TpSeek" 12 "Autostore" 11 "PtySeekDown" 10 "PtySeekUp" 9 "ScanDown" 8 "ScanUp" 7 "ContManualDown" 6 "ContManualUp" 5 "ManSingleStepDown" 4 "ManSingleStepUp" 3 "AutoDown" 2 "AutoUp" 1 "SeekOff" 0 "Invalid" ;
VAL_TABLE_ ACU_CurrTUBand_St 10 "SAT2" 9 "SAT1" 8 "DAB2" 7 "DAB1" 6 "Fm3" 5 "AmAst" 4 "Am" 3 "FmAst" 2 "Fm2" 1 "Fm1" 0 "Invalid" 13 "reserved1" 15 "reserved_last" 12 "DAB3" 11 "SAT3" ;
VAL_TABLE_ ACU_ActServiceLink_St 3 "reserved" 2 "FM2DAB" 1 "DAB2FM" 0 "Invalid" ;
VAL_TABLE_ ACU_CurrTUDRService2_St 7 "last_reserved" 5 "reserved" 4 "DabNotAvailable" 3 "ServiceAvailable" 2 "ServiceNotAvailable" 1 "SyncEnsemble" 0 "Invalid" ;
VAL_TABLE_ ComTUSIDValid 1 "Validation" 0 "Invalid" ;
VAL_TABLE_ ACU_CurrTUDRService_St 3 "ServiceAvailable" 2 "ServiceNotAvailable" 1 "SyncEnsemble" 0 "Invalid" ;
VAL_TABLE_ ACU_CurrTURadioBand_St 12 "reserved" 11 "SAT3" 10 "SAT2" 15 "reserved_last" 9 "SAT1" 8 "DAB2" 7 "DAB1" 6 "Fm3" 5 "AmAst" 4 "Am" 3 "FmAst" 2 "Fm2" 1 "Fm1" 0 "Invalid" ;
VAL_TABLE_ VRM_BondRequest_St 0 "Invalid" 1 "BondRequestExist" 2 "NoBondRequestExist" ;
VAL_TABLE_ VRMMonoOutMode_St 0 "Invalid" 1 "AllocatedVr" 2 "AllocatedBt" 3 "NotAllocated" ;
VAL_TABLE_ BTNetworkStatus_St 0 "Invalid" 1 "NoNetwork" 2 "InNetwork" 3 "Roaming" 4 "NoLinkToBtPhone" 5 "NotSupportedByBtPhone" ;
VAL_TABLE_ VRM_BTSignalStrength_St 0 "Invalid" 1 "SignalStrength0" 2 "SignalStrength1" 3 "SignalStrength2" 4 "SignalStrength3" 5 "SignalStrength4" 6 "SignalStrength5" 7 "NoLinkToBtPhone" 8 "NotSupportedByBtPhone" ;
VAL_TABLE_ VRM_BTBatteryLevel_St 0 "Invalid" 1 "Level0" 2 "Level1" 3 "Level2" 4 "Level3" 5 "Level4" 6 "Level5" 7 "NoLinkToBtPhone" 8 "NotSupportedByBtPhone" ;
VAL_TABLE_ BTFeatGroup 15 "Reserved_last" 8 "Reserved" 7 "Office" 6 "Video" 5 "Voice" 4 "MobileCom" 3 "Nav" 2 "MP" 1 "Radio" 0 "ALL" ;
VAL_TABLE_ VRM_BTActFeatDevInd_Rsp 31 "IntermediateResult" 30 "FailureConEnvOrDevNotReact" 29 "Failure_ItemMissing" 28 "Failure" 15 "BTDeviceIndex15" 14 "BTDeviceIndex14" 13 "BTDeviceIndex13" 12 "BTDeviceIndex12" 11 "BTDeviceIndex11" 10 "BTDeviceIndex10" 9 "BTDeviceIndex9" 8 "BTDeviceIndex8" 7 "BTDeviceIndex7" 6 "BTDeviceIndex6" 5 "BTDeviceIndex5" 4 "BTDeviceIndex4" 3 "BTDeviceIndex3" 2 "BTDeviceIndex2" 1 "BTDeviceIndex1" 0 "Inactive" ;
VAL_TABLE_ TUServiceLink 3 "reserved" 2 "Inactive" 1 "Active" 0 "Invalid" ;
VAL_TABLE_ Invld_1_Vld 1 "Valid" 0 "Invalid" ;
VAL_TABLE_ ACM_StationListScanSt 1 "Scan_Cancelled" ;
VAL_TABLE_ NumofHDMulticastChan_St 7 "Multicast_Available_7" 6 "Multicast_Available_6" 5 "Multicast_Available_5" 4 "Multicast_Available_4" 3 "Multicast_Available_3" 2 "Multicast_Available_2" 1 "Multicast_Available_1" 0 "zero" ;
VAL_TABLE_ ACM_HDChanStatus 4 "Not_Found" 3 "Not_Multicast" 2 "Acquired" 1 "Acquiring" ;
VAL_TABLE_ CurrHDMulticast_St 7 "7" 6 "6" 5 "5" 4 "4" 3 "3" 2 "2" 1 "1" 0 "0" ;
VAL_TABLE_ ChargeProfIDPref_Rq 3 "NotUsed" 2 "Value" 1 "ChargeNow" 0 "Inactive" ;
VAL_TABLE_ EngExhMdeQuiet_D_Stat 3 "Faulty" 2 "QuietExhaust" 1 "LoudExhaust" 0 "Null" ;
VAL_TABLE_ ConsLongTerm_No_Dsply 4095 "Faulty" 4094 "No_Data_Exists" ;
VAL_TABLE_ ConsUnitIPC_D_Dsply 15 "Reserved_15" 14 "Reserved_14" 13 "Reserved_13" 12 "Reserved_12" 11 "MPG_Hi-Res" 10 "miles_gallon__UK_" 9 "km_L_" 8 "Liters___100_km" 7 "Miles___Gallon" 6 "Whr___km_" 5 "Whr___mi_" 4 "miles_gallon__UK_" 2 "Liters___100_km" 1 "Miles___Gallon__US_" 0 "Invalid" 3 "km_L" ;
VAL_TABLE_ ConsAvgTrip_No_Dsply 4095 "Faulty" 4094 "No_Data_Exists" ;
VAL_TABLE_ ElTrip_L_Dsply 65535 "Fault" 65534 "No_Data_Exists" ;
VAL_TABLE_ ElLongTerm_L_Dsply 16777215 "Fault" 16777214 "No_Data_Exists" ;
VAL_TABLE_ VehElSurpStat_L_Dsply 8191 "Faulty" 8190 "Data_Not_Available" ;
VAL_TABLE_ TripSum_E_Dsply 511 "_Faulty" 510 "Data_Not_Available" ;
VAL_TABLE_ TripSum_L_Dsply 65535 "Faulty" 65534 "Data_Not_Available__" ;
VAL_TABLE_ ConsAvg_No_Dsply 1048575 "Faulty" 1048574 "No_Data_Exists" ;
VAL_TABLE_ MyKey_e911Override_St 2 "On" 1 "Off" 0 "No_Data_Exists" ;
VAL_TABLE_ GearSelLck_D_Rq 3 "PreventionBlocker" 2 "Unlock" 1 "Lock" 0 "Null" ;
VAL_TABLE_ BrkPadMsgTxt_D_Rq 3 "Faulty" 2 "PadsOk" 1 "ReplacePads" 0 "Null" ;
VAL_TABLE_ SuspDrvMde_D_Rq 7 "Faulty" 6 "NotUsed2" 5 "NotUsed1" 4 "Drag" 3 "Track" 2 "Snow_Wet" 1 "Sport" 0 "Normal" ;
VAL_TABLE_ NotPressed_PressedNotUsed 3 "NotUsed2" 2 "NotUsed1" 1 "Pressed" 0 "Not_Pressed" ;
VAL_TABLE_ WhlRearDual_D_Stat 3 "NotUsed" 2 "Dual" 1 "Single" 0 "NoDataExists" ;
VAL_TABLE_ TracKeyMde_D_Stat 3 "NotUsed" 2 "NotActive" 1 "Active" 0 "ModeNotDetermined" ;
VAL_TABLE_ HudMde_D_Stat 7 "NotUsed3" 6 "NotUsed2" 5 "NotUsed1" 4 "Manual" 3 "Drag" 2 "RoadCourse" 1 "Tach" 0 "Off" ;
VAL_TABLE_ TrnManShifGear_D_IndDrv 7 "Indicate_Reverse_Gear" 6 "Indicate_Gear6" 5 "Indicate_Gear5" 4 "Indicate_Gear4" 3 "Indicate_Gear3" 2 "Indicate_Gear2" 1 "Indicate_Gear1" 0 "No_Indication" ;
VAL_TABLE_ CnvtTopMsgTxt_D_Rq 3 "NotSecure" 2 "NotAvailable" 1 "RemoveCaps" 0 "NoWarning" ;
VAL_TABLE_ NoModeSelOffOnNotUsed 3 "NotUsed" 2 "On" 1 "Off" 0 "NoModeSelected" ;
VAL_TABLE_ LsmcBrkDecel_D_Stat 7 "NotUsed_3" 6 "NotUsed_2" 5 "NotUsed_1" 4 "Denied" 3 "FaultDegraded" 2 "FaultExt" 1 "On" 0 "Off" ;
VAL_TABLE_ VRM_BTDebondDevice_Rsp 15 "BTDeviceIndex15Debonded" 14 "BTDeviceIndex14Debonded" 13 "BTDeviceIndex13Debonded" 12 "BTDeviceIndex12Debonded" 11 "BTDeviceIndex11Debonded" 10 "BTDeviceIndex10Debonded" 9 "BTDeviceIndex9Debonded" 8 "BTDeviceIndex8Debonded" 7 "BTDeviceIndex7Debonded" 6 "BTDeviceIndex6Debonded" 5 "BTDeviceIndex5Debonded" 4 "BTDeviceIndex4Debonded" 3 "BTDeviceIndex3Debonded" 2 "BTDeviceIndex2Debonded" 1 "BTDeviceIndex1Debonded" 0 "Inactive" ;
VAL_TABLE_ VR_StartPhoneVR_Rsp 3 "NotAllowed" 2 "Recognized" 1 "Idle" 0 "Inactive" ;
VAL_TABLE_ VRM_DebondPhone_Rsp 0 "Inactive" 1 "PhoneIndex1Debonded" 2 "PhoneIndex2Debonded" 3 "PhoneIndex3Debonded" 4 "PhoneIndex4Debonded" 5 "PhoneIndex5Debonded" 6 "PhoneIndex6Debonded" 7 "NoPhoneAssocWithThisIndex" ;
VAL_TABLE_ VRM_BTSendDTMFTone_Rsp 0 "Inactive" 1 "FinalResult" 2 "IntermediateResult" 3 "Error" ;
VAL_TABLE_ SetDefaultPhone_Rsp 0 "Inactive" 1 "PhoneIndex1" 2 "PhoneIndex2" 3 "PhoneIndex3" 4 "PhoneIndex4" 5 "PhoneIndex5" 6 "PhoneIndex6" 7 "NoPhoneAssocWithThisIndex" 8 "NotAbleToCreateLinkToPhone" 9 "IntermediateResult" ;
VAL_TABLE_ PlayNametag_Rsp 0 "Inactive" 1 "NametagUnknown" ;
VAL_TABLE_ BTIncomingCall_Rsp 0 "Inactive" 1 "Accepted" 2 "Declined" 3 "Failed" ;
VAL_TABLE_ BTEndTelService_Rsp 3 "Error" 0 "Inactive" 1 "IntermediateResult" 2 "FinalResult" ;
VAL_TABLE_ OpMode 7 "FastRewindSpeed2" 6 "FastRewindSpeed1" 5 "FastForwardSpeed2" 4 "FastForwardSpeed1" 3 "Pause" 2 "Play" 1 "Stop" 0 "Invalid" ;
VAL_TABLE_ SDARS_Factory_Reset_St 1 "FactorySettingsRestored" 0 "Invalid" ;
VAL_TABLE_ Invalid_Enabled_Disabled 0 "Invalid" 2 "Disabled" 1 "Enabled" ;
VAL_TABLE_ Invalid_Locked_Unlocked 0 "Invalid" 2 "Unlocked" 1 "Locked" ;
VAL_TABLE_ SDARS_Seek_Scan_St 1 "NoChannelsAvailable" 0 "Invalid" ;
VAL_TABLE_ Invld_Inactv_Actv 0 "Invalid" 2 "Active" 1 "Inactive" ;
VAL_TABLE_ Invalid_SDARSOn_Off 0 "Invalid" 2 "SDARS_OFF" 1 "SDARS_ON" ;
VAL_TABLE_ NoMessage_Override_Faulty 3 "NotUsed" 2 "Faulty" 1 "Override" 0 "NoMessage" ;
VAL_TABLE_ TrnIpcDsplyRng2_D_Actl 15 "No_Range_Selected" 14 "Range_14" 13 "Range_13" 12 "Range_12" 11 "Range_11" 10 "Range_10" 9 "Range_9" 8 "Range_8" 7 "Range_7" 6 "Range_6" 5 "Range_5" 4 "Range_4" 3 "Range_3" 2 "Range_2" 1 "Range_1" 0 "NotUsed" ;
VAL_TABLE_ OffOn_RampUpDown 3 "Ramp_Down" 2 "Ramp_Up" 1 "On" 0 "Off" ;
VAL_TABLE_ DieslMsgTxt_D_Rq 3 "NotUsed2" 2 "NotUsed1" 1 "ReducedEnginePower" 0 "NoMessage" ;
VAL_TABLE_ Rr_Btn_Status 31 "NotUsed15" 30 "NotUsed14" 29 "NotUsed13" 28 "NotUsed12" 27 "NotUsed11" 26 "NotUsed10" 25 "NotUsed9" 24 "Third_Synch_Pressed" 23 "Third_Rr_Pwr_Pressed" 22 "Third_Auto_Pressed" 21 "Third_Pnl_Flr_Pressed" 20 "Third_Floor_Pressed" 19 "Third_Panel_Pressed" 18 "Third_Blwr_Dec_Pressed" 17 "Third_Blwr_Inc_Pressed" 16 "Rear_Lock_Pressed" 15 "RHS_Cld_Seat_Pressed" 14 "LHS_Cld_Seat_Pressed" 13 "RHS_Htd_Seat_Pressed" 12 "LHS_Htd_Seat_Pressed" 11 "Rear_Power_Pressed" 10 "AUTO_Pressed" 9 "Blwr_Dec_Pressed" 8 "Blwr_Inc_Pressed" 7 "RHS_Temp_Dec_Pressed" 6 "RHS_Temp_Inc_Pressed" 5 "LHS_Temp_Dec_Pressed" 4 "LHS_Temp_Inc_Pressed" 3 "Floor_Pressed" 2 "Panel_Floor_Pressed" 1 "Panel_Pressed" 0 "None_Pressed" ;
VAL_TABLE_ NoMessage_Msg1_7 7 "Message7" 6 "Message6" 5 "Message5" 4 "Message4" 3 "Message3" 2 "Message2" 1 "Message1" 0 "NoMessage" ;
VAL_TABLE_ LnchCtl 3 "NotUsed2" 2 "NotUsed1" 1 "LC_On" 0 "LC_Off" ;
VAL_TABLE_ BrkLineLck_D_Rq 3 "Off" 2 "Engage" 1 "Initiate" 0 "NoRequest" ;
VAL_TABLE_ BrkLineLck_D_Stat 7 "NotUsed_3" 6 "NotUsed_2" 5 "NotUsed_1" 4 "NotAvailable" 3 "Off" 2 "Engaged" 1 "Initiated" 0 "Available" ;
VAL_TABLE_ LnchCtlSys_D_Stat 7 "NotUsed3" 6 "NotUsed2" 5 "NotUsed1" 4 "On_LC_Unavailable_TC_On" 3 "On_LC_Unavailable" 2 "On_LC_Available" 1 "On_LC_Active" 0 "LC_OFF" ;
VAL_TABLE_ ActvFrontSteLck_D_Stat 3 "Test_passed" 2 "Test_failed" 1 "Test_cannot_run" 0 "Test_incomplete" ;
VAL_TABLE_ Rght_Lefthand_Traffic 1 "Left_Hand_Traffic" 0 "Right_Hand_Traffic" ;
VAL_TABLE_ Faulty_F 15 "Faulty" ;
VAL_TABLE_ NotPressed_Pressed_Faulty 3 "Faulty" 2 "NotUsed" 1 "Pressed" 0 "Not_Pressed" ;
VAL_TABLE_ TrlrTrgtAcquire_D_Rq 7 "NotUsed_2" 6 "NotUsed_1" 5 "ActivateRVCforTBA" 4 "CancelAcquisition" 3 "RetryAcquisition" 2 "AcquisitionSuccessful" 1 "StartAcquisition" 0 "Inactive" ;
VAL_TABLE_ TrlrTrgtAcquire_D_Stat 7 "Faulty" 6 "NotUsed_2" 5 "NotUsed_1" 4 "RVCforTBA_Activated" 3 "Processing" 2 "TargetNotAcquired" 1 "TargetAcquired" 0 "Null" ;
VAL_TABLE_ TrlBrkInitOut 3 "Heavy" 2 "Medium" 1 "Light" 0 "Null" ;
VAL_TABLE_ IsaOffst_D_Stat 15 "Faulty" 14 "Null" 13 "Thirteen" 12 "Twelve" 11 "Eleven" 10 "Ten" 9 "Nine" 8 "Eight" 7 "Seven" 6 "Six" 5 "Five" 4 "Four" 3 "Three" 2 "Two" 1 "One" 0 "Zero" ;
VAL_TABLE_ BeltWarnThres_D_Stat 7 "Faulty" 6 "No_Data_Exists" 5 "NotUsed3" 4 "NotUsed2" 3 "NotUsed1" 2 "Over_Threshold" 1 "Under_Threshold" 0 "NotSupported" ;
VAL_TABLE_ IsaVLimUnit_D_Rq 3 "NoDataExists" 2 "Mph" 1 "Kph" 0 "Null" ;
VAL_TABLE_ ApaChime_D_Rq 7 "NotUsed2" 6 "NotUsed1" 5 "Warning_Chime" 4 "Finish_Chime" 3 "Stop_Now_Chime" 2 "Spot_Ready_Chime" 1 "Spot_Found_Chime" 0 "No_Chime" ;
VAL_TABLE_ SlMde_D_RqDsply 3 "NotUsed" 2 "ManualSpeed_LimiterSymbol" 1 "AutoSpeed_LimiterSymbol" 0 "NoSpeed_LimiterSymbol" ;
VAL_TABLE_ SlMde_D_Rq 3 "IsaNotConfigured" 2 "Manual_Mode" 1 "Auto_Mode" 0 "Null" ;
VAL_TABLE_ OffOn_NotUsed_NoData 3 "No_Data_Present" 2 "NotUsed" 1 "On" 0 "Off" ;
VAL_TABLE_ Faulty_FF 255 "Faulty" ;
VAL_TABLE_ BrkDrvMde_D_Rq 7 "Faulty" 6 "RockCrawl" 5 "Baja" 4 "DragOrMudAndSand" 3 "Track" 2 "Snow_Wet" 1 "Sport" 0 "Normal" ;
VAL_TABLE_ TrnIpcDsplyRng_D_Stat 3 "NotUsed" 2 "Flash" 1 "On" 0 "Blank_No_Display" ;
VAL_TABLE_ NoYesNoDataFaulty 3 "Faulty" 2 "NoDataExists" 1 "Yes" 0 "No" ;
VAL_TABLE_ SidePrkSnsR4_D_Stat 15 "NotUsed" 14 "NotFullyScannedYet" 13 "NoObjectInSector" 12 "Zone12" 11 "Zone11" 10 "Zone10" 9 "Zone9" 8 "Zone8" 7 "Zone7" 6 "Zone6" 5 "Zone5" 4 "Zone4" 3 "Zone3" 2 "Zone2" 1 "Zone1" 0 "Off" ;
VAL_TABLE_ TsrVlPrmntMsgTxt_D_Rq 3 "NotUsed" 2 "ShowPermanentlyWithSupp" 1 "ShowPermanentlyWithoutSupp" 0 "DoNotShowSignPermanent" ;
VAL_TABLE_ TsrVl1RstrcMsgTxt2_D_Rq 7 "NotUsed" 6 "Time" 5 "Trailer" 4 "Snow" 3 "RainWet" 2 "NoRecognizableRestrictn" 1 "NoSpeedLimitRestrictn" 0 "Null" ;
VAL_TABLE_ PtDrvMde_D_Rq 15 "Faulty" 14 "NotUsed11" 13 "NotUsed10" 12 "NotUsed9" 11 "NotUsed8" 10 "NotUsed7" 9 "NotUsed6" 8 "Track" 7 "Drag" 6 "Rock" 5 "Baja" 4 "Sand" 3 "TowHaulGradeAssist" 2 "SnowWet" 1 "Sport" 0 "Normal" ;
VAL_TABLE_ SteEffort_D_Stat 7 "NotUsed_3" 6 "NotUsed_2" 5 "NotUsed_1" 4 "SpecialMode_2" 3 "SpecialMode_1" 2 "Comfort" 1 "Sport" 0 "Normal" ;
VAL_TABLE_ TsrOvtkMsgTxt2_D_Rq 15 "NotUsed5" 14 "NotUsed4" 13 "NotUsed3" 12 "NotUsed2" 11 "NotUsed1" 10 "LimForTrucksCancelled" 9 "LimForTrucksWoQlfdRstrc" 8 "LimForTrucksWithoutRstrc" 7 "LimAllCancelled" 6 "LimAllWithRstrcTime" 5 "LimAllWithRstrcTrailer" 4 "LimAllWithRstrcSnow" 3 "LimAllWithRstrcRain" 2 "LimAllWithoutQlfdRstrc" 1 "LimAllWithoutRestriction" 0 "OvertakingAllowed" ;
VAL_TABLE_ TrlrAnOffstDir 3 "NotUSed" 2 "Right" 1 "Left_or_Center" 0 "Null" ;
VAL_TABLE_ Null_Off_On 3 "NotUsed" 2 "On" 1 "Off" 0 "Null" ;
VAL_TABLE_ TrlrBrkMde_D_Rq 1 "ElectricOverHydraulic" 0 "Electric" ;
VAL_TABLE_ UnitOfLength_St 3 "miles_yards" 2 "miles_feets" 1 "kilometers_meters" 0 "Invalid" ;
VAL_TABLE_ Inactive_Cancelled 1 "Cancelled" 0 "Inactive" ;
VAL_TABLE_ Nav_RemainTTDestDays_St 14 "Exceeding13days" ;
VAL_TABLE_ WaypointsActive_St 3 "Max_Waypoints_Active" 2 "Waypoints_Active" 1 "Waypoints_Inactive" 0 "Invalid" ;
VAL_TABLE_ Nav_DistanToDestUnit_St 3 "Yards_yd" 2 "Miles_mi" 1 "Meters_m" 0 "Kilometers_km" ;
VAL_TABLE_ NavError_Waypoint_St 2 "Navigation_Fault" 1 "No_Error" 0 "Invalid" ;
VAL_TABLE_ Invalid_Off_On 0 "Invalid" 1 "Off" 2 "On" ;
VAL_TABLE_ ACU_RadioError_St 0 "Invalid" 1 "NoError" 2 "PiNotFound" 3 "PtyNotFound" ;
VAL_TABLE_ ACU_HardwareError_St 0 "Invalid" 1 "NoError" 2 "EepromReadError" 3 "KeycodeLocked" 4 "KeycodeLockedForever" 5 "CommunicationError" 6 "OverTemperature" 7 "FocusError" ;
VAL_TABLE_ ACU_CurrentRadioBand_St 6 "Fm3" 0 "Invalid" 1 "Fm1" 2 "Fm2" 3 "FmAst" 4 "Am" 5 "AmAst" ;
VAL_TABLE_ ACU_AFMode_St 0 "Invalid" 1 "AfOn" 2 "AfOff" 3 "Auto" ;
VAL_TABLE_ TrlrAidSetup_D_Stat 7 "Faulty" 6 "NotUsed_3" 5 "NotUsed_2" 4 "NotUsed_1" 3 "EnterParameters" 2 "EndSetup" 1 "BeginSetup" 0 "Null" ;
VAL_TABLE_ TrlrAidMsgTxt_D_Rq 31 "Message31" 30 "Message30" 29 "Message29" 28 "Message28" 27 "Message27" 26 "Message26" 25 "Message25" 24 "Message24" 23 "Message23" 22 "Message22" 21 "Message21" 20 "Message20" 19 "Message19" 18 "Message18" 17 "Message17" 16 "Message16" 15 "Message15" 14 "Message14" 13 "Message13" 12 "Message12" 11 "Message11" 10 "Message10" 9 "Message9" 8 "Message8" 7 "Message7" 6 "Message6" 5 "Message5" 4 "Message4" 3 "Message3" 2 "Message2" 1 "Message1" 0 "NoMessage" ;
VAL_TABLE_ Invalid_7F 127 "Invalid" ;
VAL_TABLE_ Faulty_1FFF 8191 "Faulty" ;
VAL_TABLE_ VehStab_D_Stat 15 "Faulty" 14 "No_Data_Exists" 13 "NotUsed6" 12 "NotUsed5" 11 "NotUsed4" 10 "NotUsed3" 9 "NotUsed2" 8 "Combined_OS_and_US" 7 "High_SSRA_no_OS" 6 "Straight" 5 "Post_Oversteer" 4 "Post_Transition" 3 "Countersteer" 2 "Understeer" 1 "Oversteer" 0 "Linear" ;
VAL_TABLE_ CnvtTopTrgt_D_Rq 7 "NotUsed4" 6 "NotUsed3" 5 "NotUsed2" 4 "NotUsed1" 3 "OpenTarget" 2 "OpenPosition" 1 "ClosePosition" 0 "CloseTarget" ;
VAL_TABLE_ CnvtTopPar_D_Rq 7 "NotUsed" 6 "ForceIncrease3" 5 "ForceIncrease2" 4 "ForceIncrease1" 3 "NoAdapt" 2 "Teach" 1 "NoPwmNoAp" 0 "Normal" ;
VAL_TABLE_ CnvtTop_D_Rq 7 "NotUsed" 6 "ResetErrorFlags" 5 "DiscardNormalization" 4 "SetNormalization" 3 "DirectDriveClose" 2 "DirectDriveOpen" 1 "DirectPosition" 0 "Stop" ;
VAL_TABLE_ NoData_Faulty_1FF_1FE 511 "Faulty" 510 "NoDataExists" ;
VAL_TABLE_ FohEng_D_Rq 3 "AutoEnable_ParkEnable" 2 "AutoDisable_ParkEnable" 1 "AutoEnable_ParkDisable" 0 "Disable_Stop" ;
VAL_TABLE_ Null_Hi_NotUsed_Low 3 "Low" 2 "Not_Used" 1 "High" 0 "Null" ;
VAL_TABLE_ Current_Color 15 "NotUsed7" 14 "NotUsed6" 13 "NotUsed5" 12 "NotUsed4" 11 "NotUsed3" 10 "NotUsed2" 9 "NotUsed1" 8 "Null" 7 "Color7" 6 "Color6" 5 "Color5" 4 "Color4" 3 "Color3" 2 "Color2" 1 "Color1" 0 "Off" ;
VAL_TABLE_ Blended_Color 15 "NotUsed10" 14 "NotUsed9" 13 "NotUsed8" 12 "NotUsed7" 11 "NotUsed6" 10 "NotUsed5" 9 "NotUsed4" 8 "NotUsed3" 7 "NotUsed2" 6 "NotUsed1" 5 "_5" 4 "_4" 3 "_3" 2 "_2" 1 "_1" 0 "Null" ;
VAL_TABLE_ OffOn_Null_NotUsed 3 "NotUsed" 2 "Null" 1 "On" 0 "Off" ;
VAL_TABLE_ DieslPrtc2_D_RqDsply 15 "NotUsed4" 14 "NotUsed3" 13 "NotUsed2" 12 "NotUsed1" 11 "OCR_ExhFilterClean_Stopped" 10 "OCR_ExhFilterCleaned" 9 "RgnOff_AtLimit" 8 "RgnOff_Overloaded" 7 "RgnOff_Loaded" 6 "Exhaust_Filter_Full" 5 "DPF_Overlimit" 4 "DPF_AtLimit" 3 "ExhFilter_Drive_Completed" 2 "Cleaning_Exhaust_Filter" 1 "DPF_Overloaded" 0 "DPF_Normal_Operation" ;
VAL_TABLE_ Null_Pers1_4_Vehicle 7 "Unused_2" 6 "Unused_1" 5 "Vehicle" 4 "PERS_4" 3 "PERS_3" 2 "PERS_2" 1 "PERS_1" 0 "Null" ;
VAL_TABLE_ PrkLckCtlEnbl_D_RqIpc 3 "Rq_Towing" 2 "Rq_Enable" 1 "Rq_Disable" 0 "Null" ;
VAL_TABLE_ PrkLckCtlUnlck_D_Stat 3 "Trans_And_Steer_Unlckd" 2 "Steering_Unlckd" 1 "Transmission_Unlckd" 0 "Null" ;
VAL_TABLE_ VehKeyActv_D_Stat 15 "NotUsed7" 14 "NotUsed6" 13 "NotUsed5" 12 "NotUsed4" 11 "NotUsed3" 10 "NotUsed2" 9 "NotUsed1" 8 "Key8Active" 7 "Key7Active" 6 "Key6Active" 5 "Key5Active" 4 "Key4Active" 3 "Key3Active" 2 "Key2Active" 1 "Key1Active" 0 "NoKeyActive" ;
VAL_TABLE_ VehLckInd_D_Rq 3 "NotUsed" 2 "On_Day" 1 "On_Night" 0 "Off" ;
VAL_TABLE_ PrkBrkDynmc_D_Allw 3 "NotUsed" 2 "EPB_ECD_NotPossible" 1 "EPB_ECD_Possible" 0 "Used_at_Start_Up" ;
VAL_TABLE_ TowBarMsgTxt_D_Rq 7 "NotUsed3" 6 "NotUsed2" 5 "NotUsed1" 4 "TowBar_Ext_No_Trlr" 3 "Error_Dealer_Fix" 2 "Start_Engine_Swivel" 1 "Check_Tow_Bar" 0 "Null" ;
VAL_TABLE_ NoData_Faulty_3E_3F 63 "Faulty" 62 "NoDataExists" ;
VAL_TABLE_ Unknown_Invalid_3E_3F 63 "Invalid" 62 "Unknown" ;
VAL_TABLE_ InactiveIncrementDecrement 3 "NotUsed" 2 "Decrement" 1 "Increment" 0 "Inactive" ;
VAL_TABLE_ Faulty_1FF 511 "Faulty" ;
VAL_TABLE_ NoData_Faulty_1FFF_1FFE 8191 "Faulty" 8190 "NoDataExists" ;
VAL_TABLE_ Invalid_Valid 1 "Valid" 0 "Invalid" ;
VAL_TABLE_ Null_Off_On_Faulty 3 "Faulty" 2 "On" 1 "Off" 0 "Null" ;
VAL_TABLE_ EngOilSrvcMsgTxt_D_Rq 7 "NotUsed_1" 6 "OilMinderNotConfigured" 5 "ResetFailed" 4 "ResetComplete" 3 "ResetInProgress" 2 "ChangeOilNow" 1 "ChangeOilSoon" 0 "NoText" ;
VAL_TABLE_ AirSusp_D_RqDrv 3 "NotUsed" 2 "On" 1 "Off" 0 "NoModeSelected" ;
VAL_TABLE_ AwdSys_D_Stat 3 "Faulty" 2 "NotUsed" 1 "_4x4_L_H_Active" 0 "_4x4_L_H_Inactive" ;
VAL_TABLE_ EmotiveType_D_Dsply 3 "EmotiveDisplay_3" 2 "EmotiveDisplay_2" 1 "EmotiveDisplay_1" 0 "Null" ;
VAL_TABLE_ AutoRgen_D_Rq 3 "NotUsed" 2 "AutExhFilterCleanOFF" 1 "AutExhFilterCleanON" 0 "No_Mode_Selected" ;
VAL_TABLE_ TrnSrvcRqd_B_Rq 1 "On" 0 "Off" ;
VAL_TABLE_ PlgOvrrdStrt_D_Cmd 3 "NotUsed" 2 "Override_Plug_Status" 1 "Dont_Override_Plug_Status" 0 "Null_State" ;
VAL_TABLE_ immoSecureIdleMode 3 "NotUsed2" 2 "NotUsed1" 1 "Active" 0 "Inactive" ;
VAL_TABLE_ SteMdule_D_Stat 7 "NotUsed" 6 "EPAS_Failure3" 5 "EPAS_Failure2" 4 "System_Failure" 3 "EPAS_Shutdown" 2 "Normal_Op_Full_Assist" 1 "Normal_Op_Limited_Assist" 0 "EPAS_Initialization" ;
VAL_TABLE_ Faulty_FFF 4095 "Faulty" ;
VAL_TABLE_ Faulty_3FF 1023 "Faulty" ;
VAL_TABLE_ Invalid_F 15 "Invalid" ;
VAL_TABLE_ Invalid_1F 31 "Invalid" ;
VAL_TABLE_ NoData_Faulty_FFFFFE_FFFFFF 16777215 "Faulty" 16777214 "NoDataExists" ;
VAL_TABLE_ NoData_Faulty_FE_FF 255 "Faulty" 254 "NoDataExists" ;
VAL_TABLE_ PtRmtRprt_D_Rq 15 "NotUsed_4" 14 "NotUsed_3" 13 "NotUsed_2" 12 "PlugInToMaintain12vBattery" 11 "SettingUpdated" 10 "FastChargeComplete" 9 "ChargeNotOccurring" 8 "OneTimeSocReached" 7 "BatteryTemperatureReminder" 6 "ReducedPerformance" 5 "LimitedPerformance" 4 "ChargeFault" 3 "ChargeComplete" 2 "VehiclePreconditioned" 1 "TripDistanceAchieved" 0 "NoReportRequest" ;
VAL_TABLE_ Invalid_NotReq_Req 0 "Invalid" 1 "Not_Requested" 2 "Requested" 3 "NotUsed" ;
VAL_TABLE_ Inactive_NotReq_Req 0 "Inactive" 1 "Not_Requested" 2 "Requested" 3 "NotUsed" ;
VAL_TABLE_ PreCondStat_D_Dsply 7 "Reserved3" 6 "Reserved2" 5 "Reserved1" 4 "Faulted" 3 "Complete" 2 "In_Progress" 1 "Scheduled" 0 "Not_Scheduled" ;
VAL_TABLE_ BattElecPerf_D_Actl 7 "NotUsed" 6 "Hot_Batt_Severe_Lim_Perf" 5 "Hot_Batt_Reduced_Perf" 4 "Hot_Batt_Close_to_lim_Per" 3 "Cold_Batt_Severe_Lim_Perf" 2 "Cold_Batt_Reduced_Perf" 1 "Cold_Batt_Close_to_lim_Pe" 0 "Ok_no_message_displayed" ;
VAL_TABLE_ ChkPlgtoStrt_D_Dsply 3 "NotUsed" 2 "Is_VehicleUnplugged_Prompt" 1 "Check_Plug_to_Start" 0 "No_Message_Display" ;
VAL_TABLE_ PwrFlowTxt_D_Dsply 15 "NotUsed7" 14 "NotUsed6" 13 "NotUsed5" 12 "NotUsed4" 11 "Disply_Rgen_Chrg_Txt" 10 "Disp_Fast_Charge_Txt" 9 "Disp_Fast_Charge_Cmplt_Txt" 8 "Disp_Charge_Cmplt_Txt" 7 "Disp_Remote_Start_Txt" 6 "Disp_Eng_Drv_Txt" 5 "Disp_Elec_Drv_Txt" 4 "Disp_Idle_with_Chrg_Txt" 3 "Disp_Idle_Txt" 2 "Disp_Charg_HV_Batt_Txt" 1 "Disp_Hyb_Drive_Txt" 0 "No_Text" ;
VAL_TABLE_ EngOnMsg_D_Dsply 14 "_0xE_to_1F_NotUsed" 12 "Battery_Temperature" 11 "Hill_Decent_Control" 10 "Fuel_Maintenance" 9 "Oil_Maintenance" 8 "Normal_Operation" 7 "Low_Gear" 6 "Batt_Charging" 5 "Engine_Cold" 4 "Neutral_Gear" 3 "Heater_Setting" 2 "High_Speed" 1 "Acceleration" 0 "No_Display" 13 "Drive_Mode_Selection" ;
VAL_TABLE_ PtDataKeyId_D_Stat 15 "NotUsed5" 14 "NotUsed4" 13 "NotUsed3" 12 "NotUsed2" 11 "NotUsed1" 10 "Tot_Veh_NUT" 9 "Cust_4_NUT" 8 "Cust_3_NUT" 7 "Cust_2_NUT" 6 "Cust_1_NUT" 5 "Tot_Veh_Stat" 4 "Cust_4_Stat" 3 "Cust_3_Stat" 2 "Cust_2_Stat" 1 "Cust_1_Stat" 0 "Null" ;
VAL_TABLE_ ChrgStat_D_Dsply 7 "NotUsed" 6 "Complete" 5 "Scheduled" 4 "In_Progress" 3 "Fault_Outside_Car" 2 "Fault_Inside_Car" 1 "Fault_Unknown_Location" 0 "Not_Ready" ;
VAL_TABLE_ TrnLvrV_D_Rq 3 "Full_Speed" 2 "Aggressive" 1 "Normal" 0 "Quiet" ;
VAL_TABLE_ FuelMaintMde_D_Rq 3 "Feature_Not_Present" 2 "Fuel_Maint_Req_Now" 1 "Fuel_Maint_Req_Soon" 0 "NoRequest" ;
VAL_TABLE_ FuelMaintMde_D_Dsply 3 "Feature_Not_Present" 2 "In_Fuel_Maint_Mode" 1 "Close_to_Fuel_Maint" 0 "OK" ;
VAL_TABLE_ DynoMde_B_Cmd 1 "DynomometerMode" 0 "NormalOperation" ;
VAL_TABLE_ HvacPrecondRecirc_D_Rq 3 "Last_User_Setting" 2 "Auto" 1 "Recirc" 0 "Outside" ;
VAL_TABLE_ HvacPrecondAC_D_Rq 3 "Last_User_Setting" 2 "Auto" 1 "On" 0 "Off" ;
VAL_TABLE_ HybMdeStat_D_Dsply 7 "NotUsed2" 6 "EV_Charge" 5 "EV_Override" 4 "Forced_EV_Mode" 3 "Forced_Charge_Sustain_Mode" 2 "Auto_Charge_Sustain_Mode" 1 "Auto_Charge_Deplete_Mode" 0 "Null_State" ;
VAL_TABLE_ PwFlowPlgBatt_D_Dsply 3 "NotUsed" 2 "Flow_from_Plug_to_Batt" 1 "Flow_from_Batt_to_Plug" 0 "No_Flow" ;
VAL_TABLE_ PwFlowEngMtr_D_Dsply 3 "NotUsed" 2 "Flow_from_Eng_to_Mtr" 1 "Flow_from_Mtr_to_Eng" 0 "No_Flow" ;
VAL_TABLE_ PwFlowEngFuel_D_Dsply 3 "NotUsed" 2 "Flow_from_Eng_to_Fuel" 1 "Flow_from_Fuel_to_Eng" 0 "No_Flow" ;
VAL_TABLE_ PwFlowMtrDrv_D_Dsply 3 "NotUsed" 2 "Flow_from_Mtr_to_Axle" 1 "Flow_from_Axle_to_Mtr" 0 "No_FLow" ;
VAL_TABLE_ PwFlowEngDrv_D_Dsply 3 "NotUsed" 2 "Flow_from_Eng_to_Axle" 1 "Flow_from_Axle_to_Eng" 0 "No_Flow" ;
VAL_TABLE_ PwFlowBattMtr_D_Dsply 3 "NotUsed" 2 "Flow_from_Batt_to_Mtr" 1 "Flow_from_Mtr_to_Batt" 0 "No_Flow" ;
VAL_TABLE_ Null_Override_Invalid 3 "NotUsed" 2 "Invalid" 1 "Override" 0 "Null" ;
VAL_TABLE_ HybMdeLimMsgTxt_D_Rq 3 "Limited_Req_Full_Defrost" 2 "Limited_Climate_Defrost" 1 "Limited_System_Performance" 0 "Null" ;
VAL_TABLE_ CenterStackRing_D_Actl 3 "LimitedOn" 2 "On" 1 "Off" 0 "Null" ;
VAL_TABLE_ ConsTipUnitPt_D_Dsply 3 "NotUsed" 2 "FuelEconomy" 1 "Distance" 0 "Percentage" ;
VAL_TABLE_ ConsTipMsg1_D_Dsply 15 "NotUsed10" 14 "NotUsed9" 13 "NotUsed8" 12 "NotUsed7" 11 "NotUsed6" 10 "NotUsed5" 9 "NotUsed4" 8 "NotUsed3" 7 "NotUsed2" 6 "NotUsed1" 5 "ReduceIdleTime" 4 "ClimateUsage" 3 "VehicleSpeed" 2 "Deceleration" 1 "Acceleration" 0 "NoDisplay" ;
VAL_TABLE_ NoData_Faulty_FFFE_FFFF 65535 "Faulty" 65534 "NoDataExists" ;
VAL_TABLE_ NoData_Faulty_FFE_FFF 4095 "Faulty" 4094 "NoDataExists" ;
VAL_TABLE_ NoData_Faulty_7FFE_7FFF 32767 "Faulty" 32766 "NoDataExists" ;
VAL_TABLE_ NoData_Faulty_3FE_3FF 1023 "Faulty" 1022 "NoDataExists" ;
VAL_TABLE_ ReFuelSysStat_D_Dsply 7 "NotUsed3" 6 "NotUsed2" 5 "NotUsed1" 4 "Refuel_Err" 3 "Close_Fuel_Door" 2 "Refuel_Ready" 1 "Wait_To_Fuel" 0 "Null" ;
VAL_TABLE_ OffOn_NotUsed 3 "NotUsed2" 2 "NotUsed1" 1 "On" 0 "Off" ;
VAL_TABLE_ DrQltyDrv_D_StatGsm 7 "Faulty" 6 "NoDataExists" 5 "NotUsed2" 4 "NotUsed1" 3 "ClosedDegraded" 2 "OpenDegraded" 1 "ClosedOkay" 0 "OpenOkay" ;
VAL_TABLE_ PepsKeyActv_D_Stat 15 "NotUsed11" 14 "NotUsed10" 13 "NotUsed9" 12 "NotUsed8" 11 "NotUsed7" 10 "NotUsed6" 9 "NotUsed5" 8 "Key4Active" 7 "NotUsed4" 6 "NotUsed3" 5 "NotUsed2" 4 "Key3Active" 3 "NotUsed1" 2 "Key2Active" 1 "Key1Active" 0 "NoKeyActive" ;
VAL_TABLE_ OffOnSuspendedFaulty 3 "Faulty" 2 "Suspended" 1 "On" 0 "Off" ;
VAL_TABLE_ PwPckTqRdyChime_B_Rq 3 "NotUsed" 2 "Shutdown" 1 "Startup" 0 "Null" ;
VAL_TABLE_ BattTracLoThres_D_Stat 7 "NotUsed" 6 "Thres80km_50mi" 5 "Thres50km_31mi" 4 "Thres30km_18mi" 3 "Thres50mi_80km" 2 "Thres30mi_48km" 1 "Thres20mi_32km" 0 "Null" ;
VAL_TABLE_ BattTracLoMsgTxt_D_Rq 7 "NotUsed_2" 6 "NotUsed_1" 5 "ZeroDteBatteryDepleted" 4 "ClimateLowDteSecondAlert" 3 "ClimateLowDteFirstAlert" 2 "LowDteSecondAlert" 1 "LowDteFirstAlert" 0 "Null" ;
VAL_TABLE_ BattTracLoSoc_D_Dsply 3 "NotUsed" 2 "ZeroDteDepletedBattery" 1 "LoDte" 0 "Null" ;
VAL_TABLE_ LBC_OpCode 3 "NotUsed" 2 "SetItemIfno_Rq" 1 "GetItemInfo_Rq" 0 "Inactive" ;
VAL_TABLE_ KeyPadCodeDgt1_D_Stat 15 "NotUsed_4" 14 "NotUsed_3" 13 "NotUsed_2" 12 "NotUsed_1" 11 "Button7_8and9_0" 10 "Button0" 9 "Button9_0or9" 8 "Button8" 7 "Button7_8or7" 6 "Button6" 5 "Button5_6or5" 4 "Button4" 3 "Button3_4or3" 2 "Button2" 1 "Button1_2or1" 0 "EndofString" ;
VAL_TABLE_ BattTracHazrd_D_Stat 3 "Disabled" 2 "HazardConfirmed" 1 "ExternalMonitoringRequired" 0 "NoHazardDetected" ;
VAL_TABLE_ RoadsideAsstAvail_D_St 3 "AvailableFord" 2 "AvailableLincoln" 1 "NotAvailable" 0 "Null" ;
VAL_TABLE_ OrtaMde_D_Ind 2 "StandbyRight" 1 "StandbyLeft" 0 "Off" 7 "Faulty" 6 "NotUsed_2" 5 "NotUsed_1" 4 "ActiveRight" 3 "ActiveLeft" ;
VAL_TABLE_ ConsInstUnit_D_Stat 3 "NotUsed" 2 "LiterPerHour" 1 "GallonPerHour" 0 "Inactive" ;
VAL_TABLE_ SelDrvMde_1_31 31 "Faulty" 30 "SelDrvMde31" 29 "SelDrvMde30" 28 "SelDrvMde29" 27 "SelDrvMde28" 26 "SelDrvMde27" 25 "SelDrvMde26" 24 "SelDrvMde25" 23 "SelDrvMde24" 22 "SelDrvMde23" 21 "SelDrvMde22" 20 "SelDrvMde21" 19 "SelDrvMde20" 18 "SelDrvMde19" 17 "SelDrvMde18" 16 "SelDrvMde17" 15 "SelDrvMde16" 14 "SelDrvMde15" 13 "SelDrvMde14" 12 "SelDrvMde13" 11 "SelDrvMde12" 10 "SelDrvMde11" 9 "SelDrvMde10" 8 "SelDrvMde09" 7 "SelDrvMde08" 6 "SelDrvMde07" 5 "SelDrvMde06" 4 "SelDrvMde05" 3 "SelDrvMde04" 2 "SelDrvMde03" 1 "SelDrvMde02" 0 "SelDrvMde01" ;
VAL_TABLE_ PwRnngBoardT_D_Rq 3 "NotUsed" 2 "Timer2" 1 "Timer1" 0 "Inactive" ;
VAL_TABLE_ ApaSteScanMde_D_Stat 0 "Null" 1 "NotScanning" 2 "Scanning" 3 "Steering" ;
VAL_TABLE_ PwRnngBoardT_D_Stat 3 "NotUsed" 2 "Timer2" 1 "Timer1" 0 "Inactive" ;
VAL_TABLE_ InactiveKilometersMiles 3 "NotUsed" 2 "Miles" 1 "Kilometers" 0 "Inactive" ;
VAL_TABLE_ AvgFeTripUnit_D_Stat 15 "NotUsed_12" 14 "NotUsed_11" 13 "NotUsed_10" 12 "NotUsed_9" 11 "NotUsed_8" 10 "NotUsed_7" 9 "NotUsed_6" 8 "NotUsed_5" 7 "NotUsed_4" 6 "NotUsed_3" 5 "NotUsed_2" 4 "NotUsed_1" 3 "LiterPer100kilometer" 2 "KilometerPerLiter" 1 "MilePerGallon" 0 "Inactive" ;
VAL_TABLE_ OffLowHighNotUsed 3 "NotUsed" 2 "High" 1 "Low" 0 "Off" ;
VAL_TABLE_ Null_Off_On_NoControl 3 "NoControl" 2 "On" 1 "Off" 0 "Null" ;
VAL_TABLE_ NotDeterminedNotPresentFaulty 3 "Faulty" 2 "Present" 1 "NotPresent" 0 "NotDetermined" ;
VAL_TABLE_ VehStrtInhbt_D_Dsply 15 "NotUsed_12" 14 "NotUsed_11" 13 "NotUsed_10" 12 "NotUsed_9" 11 "NotUsed_8" 10 "NotUsed_7" 9 "NotUsed_6" 8 "NotUsed_5" 7 "NotUsed_4" 6 "FleetPhoneNumber" 5 "FleetGeneral" 4 "OtaSuccess" 3 "PostOtaActivatePermFail" 2 "PostOtaActivateWarning" 1 "DuringOtaActivate" 0 "NoMessage" ;
VAL_TABLE_ VehOnRqstr_D_Stat 11 "NotUsed_8" 10 "NotUsed_7" 9 "NotUsed_6" 8 "NotUsed_5" 7 "NotUsed_4" 6 "NotUsed_3" 5 "NotUsed_2" 4 "NotUsed_1" 3 "FleetVehInhbt" 2 "StolenVehInhbt" 1 "OverTheAir" 0 "NoRequestor" 15 "NotUsed_12" 14 "NotUsed_11" 13 "NotUsed_10" 12 "NotUsed_9" ;
VAL_TABLE_ OtaActv_D_Stat 15 "NotUsed_10" 14 "NotUsed_9" 13 "NotUsed_8" 12 "NotUsed_7" 11 "NotUsed_6" 10 "NotUsed_5" 9 "NotUsed_4" 8 "NotUsed_3" 7 "NotUsed_2" 6 "NotUsed_1" 5 "NonInterruptible_Pending" 4 "NonInterruptible_Config" 3 "NonInterruptible_ER" 2 "NonInterruptible_AB" 1 "Interruptible_AB" 0 "NoInVehicleOta" ;
VAL_TABLE_ ULoBattTransfer_D_Stat 7 "NotUsed_2" 6 "NotUsed_1" 5 "TransferError" 4 "TransferComplete" 3 "TransferThroughGridEnergy" 2 "InsufficientEnergyToXfer" 1 "TransferInProgress" 0 "NoTransfer" ;
VAL_TABLE_ PwRnngBoardPoll_D_Stat 3 "NotUsed" 2 "PkPresent" 1 "PkNotPresent" 0 "NotPolling" ;
VAL_TABLE_ InactiveOffOutAuto 0 "Inactive" 1 "Off" 2 "Out" 3 "Auto" ;
VAL_TABLE_ PwRnngBoardSwtch_D_Rq 3 "NotUsed" 2 "DeployUnlocked" 1 "AlwaysActive" 0 "Inactive" ;
VAL_TABLE_ LongCtrlEnbl_D_Rq 7 "Faulty" 6 "NotUsed_3" 5 "NotUsed_2" 4 "NotUsed_1" 3 "RemoteParking" 2 "Autohitch" 1 "AutomaticParking" 0 "None" ;
VAL_TABLE_ BrkHold_D_Stat 7 "NotUsed_3" 6 "NotUsed_2" 5 "NotUsed_1" 4 "HeldSecondary" 3 "HeldSecure" 2 "Held" 1 "Inactive" 0 "Off" ;
VAL_TABLE_ NotSupNormalHiTempFaulty 3 "Faulty" 2 "HighTempWarning" 1 "Normal" 0 "NotSupported" ;
VAL_TABLE_ NotAvailNormalHiTempFaulty 3 "Faulty" 2 "HighTempWarning" 1 "Normal" 0 "NotAvailable" ;
VAL_TABLE_ AccStopStat_D_Dsply 3 "PressResume" 2 "Stopped" 1 "ResumeReady" 0 "NoDisplay" ;
VAL_TABLE_ TrlrHitch_D_RqMnu 15 "NotUsed_10" 14 "NotUsed_9" 13 "NotUsed_8" 12 "NotUsed_7" 11 "NotUsed_6" 10 "NotUsed_5" 9 "NotUsed_4" 8 "NotUsed_3" 7 "NotUsed_2" 6 "NotUsed_1" 5 "GoToTraileringDomain" 4 "Confirm" 3 "TurnOnTba" 2 "TurnOnAutohitch" 1 "CancelAutohitch" 0 "NoRequest" ;
VAL_TABLE_ NotFaulted_Faulted 1 "Faulted" 0 "NotFaulted" ;
VAL_TABLE_ _S_Speed 31 "mph90" 30 "mph85" 29 "mph80" 28 "mph75" 27 "mph70" 26 "mph65" 25 "mph60" 24 "mph55" 23 "mph50" 22 "mph45" 21 "mph40" 20 "Kmh165" 19 "Kmh160" 18 "Kmh155" 17 "Kmh150" 16 "Kmh145" 15 "Kmh140" 14 "Kmh135" 13 "Kmh130" 12 "Kmh125" 11 "Kmh120" 10 "Kmh115" 9 "Kmh110" 8 "Kmh105" 7 "Kmh100" 6 "kmh95" 5 "kmh90" 4 "kmh85" 3 "kmh80" 2 "kmh75" 1 "kmh70" 0 "Off" ;
VAL_TABLE_ Null_NotAccepted_Accepted 3 "NotUsed" 2 "Accepted" 1 "NotAccepted" 0 "Null" ;
VAL_TABLE_ NotAvailable_Available_GreyedOut 3 "NotUsed" 2 "GreyedOut" 1 "Available" 0 "NotAvailable" ;
VAL_TABLE_ BattULoChrgHyb_D_Stat 7 "NotUsed_4" 6 "NotUsed_3" 5 "NotUsed_2" 4 "NotUsed_1" 3 "VehicleServiceRequired" 2 "EvRangeLossDueToLoadActive" 1 "BatteryServiceRequired" 0 "Null" ;
VAL_TABLE_ DrvEngageLevel_D_Stat 7 "Faulty" 6 "NotUsed_2" 5 "NotUsed_1" 4 "Disengaged" 3 "Distracted" 2 "Attentive" 1 "Invalid" 0 "NotDetermined" ;
VAL_TABLE_ DrvImpairLvl_D_Stat 15 "Faulty" 14 "NotUsed_5" 13 "NotUsed_4" 12 "NotUsed_3" 11 "NotUsed_2" 10 "NotUsed_1" 9 "Incapacitated" 8 "Asleep" 7 "Microsleep" 6 "MostDrowsy" 5 "Drowsy_4" 4 "Drowsy_3" 3 "Drowsy_2" 2 "LeastDrowsy" 1 "Alert" 0 "NotDetermined" ;
VAL_TABLE_ DrvAttentZone_D_Stat 15 "Faulty" 14 "NotUsed_5" 13 "NotUsed_4" 12 "NotUsed_3" 11 "NotConfigured" 10 "DriverLap" 9 "PassengerSideWindow" 8 "DriverSideWindow" 7 "DriverSideMirror" 6 "RearviewMirror" 5 "PassengerSideMirror" 4 "Infotainment" 3 "Cluster" 2 "FrontWindshield" 1 "Other" 0 "NotDetermined" ;
VAL_TABLE_ DrvAlertSt_D_Stat 3 "Faulty" 2 "EyesOffRoad" 1 "EyesOnRoad" 0 "NotDetermined" ;
VAL_TABLE_ DrvEngLvlConfid_D_Stat 7 "Faulty" 6 "NotUsed" 5 "High" 4 "MediumHigh" 3 "Medium" 2 "LowMedium" 1 "Low" 0 "NotDetermined" ;
VAL_TABLE_ DrvCamIR_D_Stat 3 "Faulty" 2 "Blocked" 1 "Ok" 0 "TemporaryUnavailable" ;
VAL_TABLE_ FrontDiffFalt_D_Stat 3 "Diff_Failed_Closed" 2 "Diff_Failed_Open" 1 "Fault_Non_Specific" 0 "No_Fault" ;
VAL_TABLE_ FrontDiffLckMsg_D_Rq 7 "LockerDisabled" 6 "LockerEnabled" 5 "LockerAccelPedal" 4 "Speed4" 3 "Speed3" 2 "Speed2" 1 "Speed1" 0 "NormalNoMessage" ;
VAL_TABLE_ _S_InfotainmentVer_B 1 "B299" 0 "invalid" ;
VAL_TABLE_ _S_Repeat 7 "Reserved2" 6 "Reserved1" 5 "Reserved" 4 "RepeatOnDevice" 3 "RepeatOnFolder" 2 "RepeatOnTrack" 1 "Off" 0 "Invalid" ;
VAL_TABLE_ _S_IntScan_Shuffle 3 "OnTheFolderSelGroup" 2 "OnTheDevice" 1 "Off" 0 "Invalid" ;
VAL_TABLE_ _S_ErrorSt 8 "NoDataInFolder" 7 "NoRespFromDevice" 6 "UnableToRead" 5 "NoDataOnDevice" 4 "FileSysNotSupported" 3 "DeviceNotSupported" 2 "InvalidFile" 1 "NoError" 0 "Invalid" ;
VAL_TABLE_ _S_FunctStatus 7 "Reserved2" 6 "Reserved1" 5 "Reserved" 4 "Reading" 3 "Ready" 2 "Initilization" 1 "Free" 0 "Invalid" ;
VAL_TABLE_ _S_OpMode_0_Invld 7 "FastRewind20" 6 "FastRewind10" 5 "FastForward20" 4 "FastForward10" 3 "Pause" 2 "Play" 1 "Stop" 0 "Invalid" ;
VAL_TABLE_ PoliceDmngLvl_D_Stat 7 "NotUsed" 6 "Off_Night" 5 "Off_Day" 4 "Low1Night" 3 "Low1Day" 2 "Inactive" 1 "Decommissioned" 0 "Null" ;
VAL_TABLE_ NoRequest_Up 1 "Up" 0 "NoRequest" ;
VAL_TABLE_ VehWlcmFrwl_D_Stat 3 "RunStart" 2 "Farewell" 1 "Welcome" 0 "Null" ;
VAL_TABLE_ VehWlcmFrwlMde_D_Stat 7 "IlluminatedExit" 6 "CourtesyLightingDelayExt" 5 "CourtesyLightingExtended" 4 "CourtesyLightingDelayAll" 3 "CourtesyLightingAll" 2 "IlluminatedEntry" 1 "Approach" 0 "Null" ;
VAL_TABLE_ LatCtlCpblty_D_Stat 3 "Faulty" 2 "ExtendedModeAvailable" 1 "LimitedModeAvailable" 0 "NoModeAvailable" ;
VAL_TABLE_ HybMdeMsgTxt_D2_Rq 15 "NotUsed_4" 14 "NotUsed_3" 13 "NotUsed_2" 12 "NotUsed_1" 11 "EvOverride_Avail" 10 "EvLaterActv_EvAuto_NowAvai" 9 "EvNowActv_EvAuto_LaterAvai" 8 "EvAutoActv_EvNow_LaterAvai" 7 "EvAutoActv_NoOtherMdeAvail" 6 "EvChrgActv_EvAutoMdeAvail" 5 "EvAutoActv_EvChrgMdeAvail" 4 "EvChrgActv_AllPhevMdeAvail" 3 "EvLaterActv_AllPhevMdeAvai" 2 "EvNowActv_AllPhevMdeAvail" 1 "EvAutoActv_AllPhevMdeAvail" 0 "Null" ;
VAL_TABLE_ TsrRegionTxt_D_Stat 31 "Faulty" 30 "NotUsed_8" 29 "NotUsed_7" 28 "NotUsed_6" 27 "NotUsed_5" 26 "NotUsed_4" 25 "NotUsed_3" 24 "NotUsed_2" 23 "NotUsed_1" 22 "Region_22" 21 "Region_21" 20 "Region_20" 19 "Region_19" 18 "Region_18" 17 "Region_17" 16 "Region_16" 15 "Region_15" 14 "Region_14" 13 "Region_13" 12 "Region_12" 11 "Region_11" 10 "Region_10" 9 "Region_09" 8 "Region_08" 7 "Region_07" 6 "Region_06" 5 "Region_05" 4 "Region_04" 3 "Region_03" 2 "Region_02" 1 "Region_01" 0 "NotDetermined" ;
VAL_TABLE_ TrlrAidEnbl_D_RqAdas 7 "NotUsed_4" 6 "NotUsed_3" 5 "NotUsed_2" 4 "NotUsed_1" 3 "Deactivate" 2 "NotAvailable" 1 "ActiveTba" 0 "Inactive" ;
VAL_TABLE_ TrlrHitchIcon_D_Rq 15 "Icon15" 14 "Icon14" 13 "Icon13" 12 "Icon12" 11 "Icon11" 10 "Icon10" 9 "Icon9" 8 "Icon8" 7 "Icon7" 6 "Icon6" 5 "Icon5" 4 "Icon4" 3 "Icon3" 2 "Icon2" 1 "Icon1" 0 "NoIcon" ;
VAL_TABLE_ Inactive_On_NotUsed 7 "NotUsed_6" 6 "NotUsed_5" 5 "NotUsed_4" 4 "NotUsed_3" 0 "Inactive" 1 "On" 2 "NotUsed_1" 3 "NotUsed_2" ;
VAL_TABLE_ TrlrHitchChime_D_Rq 7 "NotUsed_1" 6 "NotUsed_1" 5 "WarningChime" 4 "NonCriticalAlertChime" 3 "StopNowChime" 2 "ManeuveringReadyChime" 1 "TrailerFoundChime" 0 "NoChime" ;
VAL_TABLE_ _S_NoMsg_Msg1To7 7 "Message7" 6 "Message6" 5 "Message5" 4 "Message4" 3 "Message3" 2 "Message2" 1 "Message1" 0 "NoMessage" ;
VAL_TABLE_ _S_No_Yes 1 "Yes" 0 "No" ;
VAL_TABLE_ _S_TextMessage 3 "Cancel" 2 "Ignore" 1 "Listen" 0 "Invalid" ;
VAL_TABLE_ _S_IncomingCall 2 "DeclineIncomingCall" 1 "AcceptIncomingCall" 0 "Inactive" ;
VAL_TABLE_ _S_BTInCallOptions 6 "EndHoldCall" 5 "HoldCall" 4 "GotoHandsfreeMode" 3 "GotoPrivacyMode" 2 "JoinCalls" 1 "SwitchCalls" 0 "Inactive" ;
VAL_TABLE_ _S_EndTelService 1 "EndOngoingTelephonyCall" 0 "Inactive" ;
VAL_TABLE_ UpDownNotUsedFaulty 3 "Faulty" 2 "NotUsed" 1 "Down" 0 "Up" ;
VAL_TABLE_ PtWakeReas_D_Stat 15 "NotUsed_9" 14 "NotUsed_8" 13 "NotUsed_7" 12 "NotUsed_6" 11 "NotUsed_5" 10 "NotUsed_4" 9 "NotUsed_3" 8 "NotUsed_2" 7 "NotUsed_1" 6 "ElapsedTime" 5 "ThirdPartyWakeup" 4 "DoorAjar" 3 "EarlyWake" 2 "NonMotiveStart" 1 "MotiveStart" 0 "Null" ;
VAL_TABLE_ ExtLghtLeft_D_RqMnu 7 "NotUsed" 6 "PressToOn3" 5 "PressToOff3" 4 "PressToOn2" 3 "PressToOff2" 2 "PressToOn1" 1 "PressToOff1" 0 "Reset" ;
VAL_TABLE_ ExtLght_D_Falt 3 "Error" 2 "NoStationary" 1 "StartEngine" 0 "Null" ;
VAL_TABLE_ MemStoreMsgTxt_D_Rq 10 "NotUsed_2" 9 "NotUsed_1" 8 "Mem4Saved_ShowLinkMsg" 7 "Mem3Saved_ShowLinkMsg" 6 "Mem2Saved_ShowLinkMsg" 5 "Mem1Saved_ShowLinkMsg" 4 "Mem4Saved_DoNotShowLinkMsg" 3 "Mem3Saved_DoNotShowLinkMsg" 2 "Mem2Saved_DoNotShowLinkMsg" 1 "Mem1Saved_DoNotShowLinkMsg" 0 "Null" ;
VAL_TABLE_ MemSetButtnMsgTxt_D_Rq 3 "NotUsed" 2 "Press1or2or3" 1 "Press1or2" 0 "Null" ;
VAL_TABLE_ MildHybStat_D_Dsply 7 "NotUsed" 6 "Recovery" 5 "Charge" 4 "Assist" 3 "Boost" 2 "SystemInhibited" 1 "SystemError" 0 "Off" ;
VAL_TABLE_ ChrgCrdLck_D_Falt 3 "NotUsed" 2 "HardwareFault" 1 "CsiFault" 0 "NoFault" ;
VAL_TABLE_ DrvHazrd_D_St 7 "NotUsed_1" 6 "Suspended" 5 "Available" 4 "NoService" 3 "NoSession" 2 "bAllowOff" 1 "bSAllowOff" 0 "NoStatus" ;
VAL_TABLE_ DrvHazrdModel_D_St 15 "NotUsed_13" 14 "NotUsed_12" 13 "NotUsed_11" 12 "NotUsed_10" 11 "NotUsed_9" 10 "NotUsed_8" 9 "NotUsed_7" 8 "NotUsed_6" 7 "NotUsed_5" 6 "NotUsed_4" 5 "NotUsed_3" 4 "NotUsed_2" 3 "NotUsed_1" 2 "TpegTec" 1 "DenmEm" 0 "None" ;
VAL_TABLE_ Null_Band1_2 3 "NotUsed_1" 2 "Band_2" 1 "Band_1" 0 "Null" ;
VAL_TABLE_ Null_Error1_15 15 "Error15" 14 "Error14" 13 "Error13" 12 "Error12" 11 "Error11" 10 "Error10" 9 "Error9" 8 "Error8" 7 "Error7" 6 "Error6" 5 "Error5" 4 "Error4" 3 "Error3" 2 "Error2" 1 "Error1" 0 "Null" ;
VAL_TABLE_ WifiHtsptFq_D_Avail 7 "NotUsed_3" 6 "NotUsed_2" 5 "NotUsed_1" 4 "AllAvailable" 3 "Band_2_Only" 2 "Band_1_Only" 1 "AllRestricted" 0 "Null" ;
VAL_TABLE_ _S_MCChannel 7 "MCChannel7" 6 "MCChannel6" 5 "MCChannel5" 4 "MCChannel4" 3 "MCChannel3" 2 "MCChannel2" 1 "MCChannel1" 0 "Inactive" ;
VAL_TABLE_ _S_OpMode 7 "FastRewindSpeed2" 6 "FastRewindSpeed1" 5 "FastForwardSpeed2" 4 "FastForwardSpeed1" 3 "Pause" 2 "Play" 1 "Stop" 0 "Invalid" ;
VAL_TABLE_ Inactive_1F 31 "Inactive" ;
VAL_TABLE_ _S_CDSetRepeat 0 "Inactive" 1 "RepeatOnTrack" 2 "Off" 3 "OnFolder" ;
VAL_TABLE_ _S_0_Inactive_1On_2Off_3OnFldr 0 "Inactive" 1 "On" 2 "Off" 3 "OnFolder" ;
VAL_TABLE_ _S_SetCurrentStatOp 0 "Inactive" 1 "SetCurrentFrequency" 2 "SetCurrentPiCode" 3 "SetCurrentStation" ;
VAL_TABLE_ _S_TUServiceLink 3 "reserved" 2 "Inactive" 1 "Active" 0 "Invalid" ;
VAL_TABLE_ MFD_GetTagInfo 1 "TagInformation" 0 "Inactive" ;
VAL_TABLE_ InfotainmentAudio_St 3 "NotUsed" 2 "ErrorState_NoAudio" 1 "NormalOperation" 0 "Null" ;
VAL_TABLE_ Inactive_Valid_Updating 0 "Inactive" 1 "Valid" 2 "Updating" 3 "Reserved" ;
VAL_TABLE_ _S_Preset1_to_30 31 "Reserved" 30 "Preset30" 29 "Preset29" 28 "Preset28" 27 "Preset27" 26 "Preset26" 25 "Preset25" 24 "Preset24" 23 "Preset23" 22 "Preset22" 21 "Preset21" 20 "Preset20" 19 "Preset19" 18 "Preset18" 17 "Preset17" 16 "Preset16" 15 "Preset15" 14 "Preset14" 13 "Preset13" 12 "Preset12" 11 "Preset11" 10 "Preset10" 9 "Preset9" 8 "Preset8" 7 "Preset7" 6 "Preset6" 5 "Preset5" 4 "Preset4" 3 "Preset3" 2 "Preset2" 1 "Preset1" 0 "Inactive" ;
VAL_TABLE_ _S_TUPresetArea_Rq 13 "reserved" 12 "GetSAT3PresetData" 11 "GetSAT2PresetData" 15 "reserved_last" 10 "GetSAT1PresetData" 9 "GetDAB2PresetData" 8 "GetDAB1PresetData" 7 "GetDAB3PresetData" 6 "GetAmPresetData" 5 "GetAmAstPresetData" 4 "GetFmAstPresetData" 3 "GetFm3PresetData" 2 "GetFm2PresetData" 1 "GetFm1PresetData" 0 "Inactive" ;
VAL_TABLE_ _S_0_Inactive_1_Cancel 1 "Cancel" 0 "Inactive" ;
VAL_TABLE_ _S_SetCurrTUBand 13 "reserved1" 12 "DAB3" 11 "SAT3" 10 "SAT2" 15 "reserved_last" 9 "SAT1" 8 "DAB2" 7 "DAB1" 6 "AmAst" 5 "Am" 4 "FmAst" 3 "Fm3" 2 "Fm2" 1 "Fm1" 0 "Inactive" ;
VAL_TABLE_ _S_False_True 1 "True" 0 "False" ;
VAL_TABLE_ _S_0_Inactive_1_Off_2_On 2 "On" 1 "Off" 0 "Inactive" ;
VAL_TABLE_ _S_FolderContent 2 "Inactive" 1 "RequestContentFromParentF" 0 "RequestContentFromParamet" ;
VAL_TABLE_ _S_DB1Filter_10Bit 1023 "All" 1022 "SIIndex_1022" 1 "SIIndex_1" 0 "NotEngaged" ;
VAL_TABLE_ _S_DB1Filter_16Bit 65535 "All" 65534 "SIIndex_65534" 1 "SIIndex_1" 0 "NotEngaged" ;
VAL_TABLE_ _S_CutItem_Inactive 3 "Inactive" 2 "ThreeQuarterFromTheBeginn" 1 "End" 0 "Beginning" ;
VAL_TABLE_ _S_OpMode_0_Inactv 7 "FastRewind20" 6 "FastRewind10" 5 "FastForward20" 4 "FastForward10" 3 "Pause" 2 "Play" 1 "Stop" 0 "Inactive" ;
VAL_TABLE_ _S_AudioSource2 5 "SDCard" 4 "Reserved" 3 "USB" 2 "BTAudio" 1 "CD" 0 "Inactive" ;
VAL_TABLE_ _S_SDARS_SampleRate 3 "NotUsed_1" 2 "SampleRate_48000Hz" 1 "SampleRate_44100Hz" 0 "Null" ;
VAL_TABLE_ DSP_AHU_ChmTstT 31 "NotUsed_22" 30 "NotUsed_21" 29 "NotUsed_20" 28 "NotUsed_19" 27 "NotUsed_18" 26 "NotUsed_17" 25 "NotUsed_16" 24 "NotUsed_15" 23 "NotUsed_14" 22 "NotUsed_13" 21 "NotUsed_12" 20 "NotUsed_11" 19 "NotUsed_10" 18 "NotUsed_9" 17 "NotUsed_8" 16 "NotUsed_7" 15 "NotUsed_6" 14 "NotUsed_5" 13 "NotUsed_4" 12 "NotUsed_3" 11 "NotUsed_2" 10 "NotUsed_1" 9 "Crank_3" 8 "NotUsed" 7 "Running_2" 6 "IgnitionOn_2" 5 "PostIgnition_1" 4 "Accessory_1" 3 "PostAccessory_0" 2 "KeyApproved_0" 1 "KeyRecentlyOut" 0 "KeyOut" ;
VAL_TABLE_ DSP_Bezel_Diag_St 15 "NotUsed_11" 14 "NotUsed_10" 13 "NotUsed_9" 12 "NotUsed_8" 11 "NotUsed_7" 10 "NotUsed_6" 9 "NotUsed_5" 8 "NotUsed_4" 7 "NotUsed_3" 6 "NotUsed_2" 5 "NotUsed_1" 4 "SpeakerWalkAround" 3 "CalibrationPartNumber" 2 "HardwarePartNumber" 1 "SoftwarePartNumber" 0 "Inactive_NOP" ;
VAL_TABLE_ Inactive_False_True 3 "NotUsed" 2 "True" 1 "False" 0 "Inactive" ;
VAL_TABLE_ Inactive_Preset1_30 31 "Reserved" 30 "Preset30" 29 "Preset29" 28 "Preset28" 27 "Preset27" 26 "Preset26" 25 "Preset25" 24 "Preset24" 23 "Preset23" 22 "Preset22" 21 "Preset21" 20 "Preset20" 19 "Preset19" 18 "Preset18" 17 "Preset17" 16 "Preset16" 15 "Preset15" 14 "Preset14" 13 "Preset13" 12 "Preset12" 11 "Preset11" 10 "Preset10" 9 "Preset9" 8 "Preset8" 7 "Preset7" 6 "Preset6" 5 "Preset5" 4 "Preset4" 3 "Preset3" 2 "Preset2" 1 "Preset1" 0 "Inactive" ;
VAL_TABLE_ ChrgStat_D2_Dsply 15 "ChargeStopCommanded" 14 "ChargeStartCommanded" 13 "ChargeTargetReached" 12 "DriveConditioning" 11 "CabinPreconditioning" 10 "ChargingSystemMaintain" 9 "ChargingInductive" 8 "ChargingDCFastCharge" 7 "ChargingAC" 6 "ChargeScheduled" 5 "EvsePaused" 4 "EvseNotDetected" 3 "EvseNotCompatible" 2 "FaultOutsideCar" 1 "FaultInsideCar" 0 "NotReady" ;
VAL_TABLE_ EngMdeMsgTxt_D_Rq 7 "NotUsed_3" 6 "NotUsed_2" 5 "NotUsed_1" 4 "Charge" 3 "GlowingCharge" 2 "Hybrid" 1 "Ev" 0 "NoMessage" ;
VAL_TABLE_ _S_Attenuation 7 "Unknown" 6 "Attenuation_6" 5 "Attenuation_5" 4 "Attenuation_4" 3 "Attenuation_3" 2 "Attenuation_2" 1 "Attenuation_1" 0 "Inactive" ;
VAL_TABLE_ NoReqHiDecelLowDecel 3 "NotUsed" 2 "LowDecel" 1 "HighDecel" 0 "NoRequest" ;
VAL_TABLE_ OpenClosedRetainDisable 3 "Disable" 2 "Retain" 1 "Closed" 0 "Open" ;
VAL_TABLE_ OpenClosedRetainDoNotCare 3 "DoNotCare" 2 "Retain" 1 "Closed" 0 "Open" ;
VAL_TABLE_ SdarsSampleRate_D_Rq 3 "NotUsed" 2 "SampleRate_48000Hz" 1 "SampleRate_44100Hz" 0 "Null" ;
VAL_TABLE_ _S_Directionality 3 "RearSpeakers" 2 "FrontSpeakers" 1 "ALL" 0 "Inactive" ;
VAL_TABLE_ _S_ARReqstrSystem 0 "FrontRequester" 1 "RearRequester" ;
VAL_TABLE_ _S_AR_RURquesterPriority 0 "EmergencyServ" 1 "TelService" 2 "AutoAnswer" 3 "Ta" 4 "PttMutevoice" 5 "NavUserVoiceCmd" 6 "NavSysVoiceCmd" 7 "Radio" 8 "Disc" 9 "Alarm" 10 "Ptynews" 11 "Aux_ExtSource" 12 "BT_BTNavAndTelMute" 13 "ManualAudioMute" 14 "NotReq" ;
VAL_TABLE_ _S_AROperationType 0 "Inactive" 1 "Requestaudioresource" 2 "Releaseaudioresource" 3 "Releaseallaudioresouces" 4 "Getresourceupdate" 5 "Getallresourceupdates" ;
VAL_TABLE_ _S_AR_RUAudioSource_NA 15 "iPod" 14 "USB" 13 "BTAudio" 0 "AmfmRadio" 1 "FrontDisc" 2 "SDARS_DAB" 3 "InDashCdChanger" 4 "VoiceRecogniser" 5 "TelematicUnit" 6 "BluetoothPhone" 7 "RearDisc" 8 "APIM" 9 "FrontAuxInput" 10 "Navigation" 11 "RearAux" 12 "NotReq" ;
VAL_TABLE_ _S_Inactive_1_Off_2_On 2 "On" 1 "Off" 0 "Inactive" ;
VAL_TABLE_ _S_SurndSndUpmix 4 "Audience" 3 "On_Stage" 2 "Surround" 1 "Stereo" 0 "Inactive" ;
VAL_TABLE_ _S_Level1_to_127_8Bit 255 "NotUsed_127" 254 "NotUsed_126" 253 "NotUsed_125" 252 "NotUsed_124" 251 "NotUsed_123" 250 "NotUsed_122" 249 "NotUsed_121" 248 "NotUsed_120" 247 "NotUsed_119" 246 "NotUsed_118" 245 "NotUsed_117" 244 "NotUsed_116" 243 "NotUsed_115" 242 "NotUsed_114" 241 "NotUsed_113" 240 "NotUsed_112" 239 "NotUsed_111" 238 "NotUsed_110" 237 "NotUsed_109" 236 "NotUsed_108" 235 "NotUsed_107" 234 "NotUsed_106" 233 "NotUsed_105" 232 "NotUsed_104" 231 "NotUsed_103" 230 "NotUsed_102" 229 "NotUsed_101" 228 "NotUsed_100" 227 "NotUsed_99" 226 "NotUsed_98" 225 "NotUsed_97" 224 "NotUsed_96" 223 "NotUsed_95" 222 "NotUsed_94" 221 "NotUsed_93" 220 "NotUsed_92" 219 "NotUsed_91" 218 "NotUsed_90" 217 "NotUsed_89" 216 "NotUsed_88" 215 "NotUsed_87" 214 "NotUsed_86" 213 "NotUsed_85" 212 "NotUsed_84" 211 "NotUsed_83" 210 "NotUsed_82" 209 "NotUsed_81" 208 "NotUsed_80" 207 "NotUsed_79" 206 "NotUsed_78" 205 "NotUsed_77" 204 "NotUsed_76" 203 "NotUsed_75" 202 "NotUsed_74" 201 "NotUsed_73" 200 "NotUsed_72" 199 "NotUsed_71" 198 "NotUsed_70" 197 "NotUsed_69" 196 "NotUsed_68" 195 "NotUsed_67" 194 "NotUsed_66" 193 "NotUsed_65" 192 "NotUsed_64" 191 "NotUsed_63" 190 "NotUsed_62" 189 "NotUsed_61" 188 "NotUsed_60" 187 "NotUsed_59" 186 "NotUsed_58" 185 "NotUsed_57" 184 "NotUsed_56" 183 "NotUsed_55" 182 "NotUsed_54" 181 "NotUsed_53" 180 "NotUsed_52" 179 "NotUsed_51" 178 "NotUsed_50" 177 "NotUsed_49" 176 "NotUsed_48" 175 "NotUsed_47" 174 "NotUsed_46" 173 "NotUsed_45" 172 "NotUsed_44" 171 "NotUsed_43" 170 "NotUsed_42" 169 "NotUsed_41" 168 "NotUsed_40" 167 "NotUsed_39" 166 "NotUsed_38" 165 "NotUsed_37" 164 "NotUsed_36" 163 "NotUsed_35" 162 "NotUsed_34" 161 "NotUsed_33" 160 "NotUsed_32" 159 "NotUsed_31" 158 "NotUsed_30" 157 "NotUsed_29" 156 "NotUsed_28" 155 "NotUsed_27" 154 "NotUsed_26" 153 "NotUsed_25" 152 "NotUsed_24" 151 "NotUsed_23" 150 "NotUsed_22" 149 "NotUsed_21" 148 "NotUsed_20" 147 "NotUsed_19" 146 "NotUsed_18" 145 "NotUsed_17" 144 "NotUsed_16" 143 "NotUsed_15" 142 "NotUsed_14" 141 "NotUsed_13" 140 "NotUsed_12" 139 "NotUsed_11" 138 "NotUsed_10" 137 "NotUsed_9" 136 "NotUsed_8" 135 "NotUsed_7" 134 "NotUsed_6" 133 "NotUsed_5" 132 "NotUsed_4" 131 "NotUsed_3" 130 "NotUsed_2" 129 "NotUsed_1" 128 "Level127" 127 "Level126" 126 "Level125" 125 "Level124" 124 "Level123" 123 "Level122" 122 "Level121" 121 "Level120" 120 "Level119" 119 "Level118" 118 "Level117" 117 "Level116" 116 "Level115" 115 "Level114" 114 "Level113" 113 "Level112" 112 "Level111" 111 "Level110" 110 "Level109" 109 "Level108" 108 "Level107" 107 "Level106" 106 "Level105" 105 "Level104" 104 "Level103" 103 "Level102" 102 "Level101" 101 "Level100" 100 "Level99" 99 "Level98" 98 "Level97" 97 "Level96" 96 "Level95" 95 "Level94" 94 "Level93" 93 "Level92" 92 "Level91" 91 "Level90" 90 "Level89" 89 "Level88" 88 "Level87" 87 "Level86" 86 "Level85" 85 "Level84" 84 "Level83" 83 "Level82" 82 "Level81" 81 "Level80" 80 "Level79" 79 "Level78" 78 "Level77" 77 "Level76" 76 "Level75" 75 "Level74" 74 "Level73" 73 "Level72" 72 "Level71" 71 "Level70" 70 "Level69" 69 "Level68" 68 "Level67" 67 "Level66" 66 "Level65" 65 "Level64" 64 "Level63" 63 "Level62" 62 "Level61" 61 "Level60" 60 "Level59" 59 "Level58" 58 "Level57" 57 "Level56" 56 "Level55" 55 "Level54" 54 "Level53" 53 "Level52" 52 "Level51" 51 "Level50" 50 "Level49" 49 "Level48" 48 "Level47" 47 "Level46" 46 "Level45" 45 "Level44" 44 "Level43" 43 "Level42" 42 "Level41" 41 "Level40" 40 "Level39" 39 "Level38" 38 "Level37" 37 "Level36" 36 "Level35" 35 "Level34" 34 "Level33" 33 "Level32" 32 "Level31" 31 "Level30" 30 "Level29" 29 "Level28" 28 "Level27" 27 "Level26" 26 "Level25" 25 "Level24" 24 "Level23" 23 "Level22" 22 "Level21" 21 "Level20" 20 "Level19" 19 "Level18" 18 "Level17" 17 "Level16" 16 "Level15" 15 "Level14" 14 "Level13" 13 "Level12" 12 "Level11" 11 "Level10" 10 "Level9" 9 "Level8" 8 "Level7" 7 "Level6" 6 "Level5" 5 "Level4" 4 "Level3" 3 "Level2" 2 "Level1" 1 "Level0" 0 "Inactive" ;
VAL_TABLE_ _S_Sound 2 "Surround" 1 "Stereo" 0 "Inactive" ;
VAL_TABLE_ _S_AdjChimeVol 15 "NotUsed_3" 14 "NotUsed_2" 13 "NotUsed_1" 12 "LevelPlus6" 11 "LevelPlus5" 10 "LevelPlus4" 9 "LevelPlus3" 8 "LevelPlus2" 7 "LevelPlus1" 6 "LevelMinus1" 5 "LevelMinus2" 4 "LevelMinus3" 3 "LevelMinus4" 2 "LevelMinus5" 1 "LevelMinus6" 0 "DefaultVolume" ;
VAL_TABLE_ _S_MyKeyVolUp 2 "NotUpdated" 1 "Updated" 0 "Invalid" ;
VAL_TABLE_ NoData_Faulty_7FE_7FF 2047 "Faulty" 2046 "NoDataExists" ;
VAL_TABLE_ DrTgateChime2_D_Rq 7 "NotUsed3" 6 "NotUsed2" 5 "NotUsed1" 4 "Long_Repeated" 3 "Fast" 2 "Short" 1 "Long" 0 "Off" ;
VAL_TABLE_ EngIdlShutDwnTxt_D_Rq 3 "NotUsed" 2 "EngineShutdownOnPrevDrive" 1 "FeatureDisabledDueToFault" 0 "NoMessage" ;
VAL_TABLE_ DrvPerfMde 3 "Sport" 2 "Normal" 1 "NotUsed" 0 "NoModeSelected" ;
VAL_TABLE_ NoData_Fault_1FF_1FE 511 "Fault" 510 "NoDataExists" ;
VAL_TABLE_ NoData_Fault_FFE_FFF 4095 "Fault" 4094 "NoDataExists" ;
VAL_TABLE_ EngIdlShutDown_D_Stat 3 "Not_used" 2 "Engine_Shutdown" 1 "Initiated_Countdown" 0 "Normal_Operation" ;
VAL_TABLE_ StopStrtDrvMde_D_Indic 3 "NotUsed" 2 "StartStop_IndirectDeselect" 1 "StopStart_Deselected" 0 "StopStart_Selected" ;
VAL_TABLE_ StopStrtDrvMde_D_RqMnu 3 "NotUsed2" 2 "NotUsed1" 1 "StopStart_Deselected" 0 "StopStart_Selected" ;
VAL_TABLE_ StopStrtStdby_D_Indic 6 "Telltale_On_Grey" 5 "Telltale_Struck_Out" 4 "Telltale_Flashing_Amber" 3 "Telltale_On_Amber" 2 "Telltale_Flashing_Green" 1 "Telltale_On_Green" 0 "Telltale_Off" 7 "NotUsed3" ;
VAL_TABLE_ Quality_Faulty 3 "OK" 2 "Degraded" 1 "No_Data_Exists" 0 "Faulty" ;
VAL_TABLE_ TrnDtpCmd_D_Actl 7 "NotUsed4" 6 "NotUsed3" 5 "NotUsed2" 4 "Relatch" 3 "Deploy" 2 "Self_Test" 1 "No_Command" 0 "NotUsed1" ;
VAL_TABLE_ TrnGsmNtmState_D_Actl 3 "Faulty" 2 "Neutral_Tow_Mode" 1 "Car_Wash_Mode" 0 "None" ;
VAL_TABLE_ TrnTrcmPwmSig_D_Actl 15 "Faulty" 14 "NoDataExists" 13 "NotUsed5" 12 "NotUsed4" 11 "NotUsed3" 10 "NotUsed2" 9 "NotUsed1" 8 "Default_To_Park" 7 "Neutral_Tow" 6 "Car_Wash_Mode" 5 "Manual" 4 "Drive" 3 "Neutral" 2 "Reverse" 1 "Park" 0 "No_Gear" ;
VAL_TABLE_ Fault_3FFF 16383 "Fault" ;
VAL_TABLE_ CtaInnr_D_Stat 3 "Reporting" 2 "Not_Reporting" 1 "System_Standby" 0 "Initialization" ;
VAL_TABLE_ FohMsgTxt_D_Rq 4 "BatteryNotFullyCharged" 3 "Exceed7DaysFromLastEngRun" 2 "AmbientTemperatureTooHigh" 1 "LowFuel" 0 "NoMessage" ;
VAL_TABLE_ FohStrtDay_T_Rq 7 "Sunday" 6 "Saturday" 5 "Friday" 4 "Thursday" 3 "Wednesday" 2 "Tuesday" 1 "Monday" 0 "NotUsed" ;
VAL_TABLE_ DisableEnableNotUsedUnknown 3 "Unknown" 2 "NotUsed" 1 "Enable" 0 "Disable" ;
VAL_TABLE_ PrkBrkActv_D_RqTrnGear 3 "NotUsed2" 2 "RequestParkBrakeEngage" 1 "NoRequest" 0 "NotUsed1" ;
VAL_TABLE_ NoRequest_Request 1 "Request" 0 "NoRequest" ;
VAL_TABLE_ Fault_FFF_NoData 4094 "NoDataExists" 4095 "Fault" ;
VAL_TABLE_ Fault_3FF_NoData 1022 "NoDataExists" 1023 "Fault" ;
VAL_TABLE_ ICI_Coding_BtnID_A 15 "Idle" 5 "Stuck" 4 "LongEvent" 3 "ShortElapsed" 2 "ShortEvent" 1 "Active" 0 "Inactive" ;
VAL_TABLE_ Foh_D_Stat 7 "Unused3" 6 "Unused2" 5 "Unused1" 4 "Stopping" 3 "Running" 2 "Starting" 1 "Prestart" 0 "Off" ;
VAL_TABLE_ ActiveStoragePassenger 7 "Unused3" 6 "Unused2" 5 "Unused1" 4 "StoreDipMemoryButton4" 3 "StoreDipMemoryButton3" 2 "StoreDipMemoryButton2" 1 "StoreDipMemoryButton1" 0 "Off" ;
VAL_TABLE_ DipMirror 1 "Dipped" 0 "Off" ;
VAL_TABLE_ WindowCmd 7 "Unused2" 6 "Unused1" 5 "NotDefined" 4 "Audo_Down" 3 "Manual_Down" 2 "Auto_Up" 1 "Manual_Up" 0 "Idle" ;
VAL_TABLE_ MirrorCmd 7 "Unused" 6 "Unfold" 5 "Fold" 4 "Right" 3 "Left" 2 "Down" 1 "Up" 0 "Idle" ;
VAL_TABLE_ WindowPosition 7 "Unused2" 6 "Unused1" 5 "Fully_Open" 4 "Bet60Percent_FullyOpen" 3 "Bet10Percent_60Percent" 2 "BetFully_10PercentOpen" 1 "Fully_Closed" 0 "Undefined" ;
VAL_TABLE_ OffOnNoDataUnused 3 "Unused" 2 "NoDataExists" 1 "On" 0 "Off" ;
VAL_TABLE_ FohFalt_D_Stat 15 "NotUsed4" 14 "NotUsed3" 13 "NotUsed2" 12 "NotUsed1" 11 "FuelTypeDoesNotMatchFOH" 10 "Lifecycle_ModeNotSet" 9 "AuxElectricCoolantPumpInop" 8 "TimeDelayAvoidExcessCycl" 7 "Fuel_Level_OutofRange" 6 "External_Fault" 5 "Internal_Fault" 4 "Voltage_limitation" 3 "Impact_Event" 2 "CoolantTemp_OutofRange" 1 "AmbientTemp_OutofRange" 0 "No_Disable" ;
VAL_TABLE_ FohRqRun_B_Rq 1 "SubmitRequest_toRun" 0 "DoesNotSubmitRequest_toRun" ;
VAL_TABLE_ OKLowVeryLow 3 "NotUsed" 2 "VeryLow" 1 "Low" 0 "OK" ;
VAL_TABLE_ SteWhlHeat 15 "NotUsed6" 14 "NotUsed5" 13 "NotUsed4" 12 "NotUsed3" 11 "NotUsed2" 10 "NotUsed1" 9 "Reserved_3" 8 "Reserved_2" 7 "Reserved_1" 6 "Level_3_Heating" 5 "Level_3_Heating_LS" 4 "Level_2_Heating" 3 "Level_2_Heating_LS" 2 "Level_1_Heating" 1 "Level_1_Heating_LS" 0 "Off" ;
VAL_TABLE_ OffOnUnusedFault 3 "Fault" 2 "Unused" 1 "On" 0 "Off" ;
VAL_TABLE_ NullKphMph 3 "NoDataExists" 2 "Mph" 1 "Kph" 0 "Null" ;
VAL_TABLE_ TsrVLim1MsgTxt_D_Rq 255 "NoLimit" 254 "NotUsed2" 253 "NotUsed1" 252 "NotToBeDisplayed" 251 "LimitCancelled" 31 "1F_FA_Message31_250" 30 "Message30" 29 "Message29" 28 "Message28" 27 "Message27" 26 "Message26" 25 "Message25" 24 "Message24" 23 "Message23" 22 "Message22" 21 "Message21" 20 "Message20" 19 "Message19" 18 "Message18" 17 "Message17" 16 "Message16" 15 "Message15" 14 "Message14" 13 "Message13" 12 "Message12" 11 "Message11" 10 "Message10" 9 "Message9" 8 "Message8" 7 "Message7" 6 "Message6" 5 "Message5" 4 "Message4" 3 "Message3" 2 "Message2" 1 "Message1" 0 "Null" ;
VAL_TABLE_ TsrVl1RstrcMsgTxt_D_Rq 3 "NotUsed" 2 "NoRecognizableRestriction" 1 "NoSpeedLimitRestriction" 0 "Null" ;
VAL_TABLE_ TsrMsgTxt_D_Rq 15 "NotUsed6" 14 "NotUsed5" 13 "NotUsed4" 12 "NotUsed3" 11 "NotUsed2" 10 "NotUsed1" 9 "RecgnzdSignNotUsblForDsply" 8 "LimitedSystemPerformance" 7 "OffRoad" 6 "RegionNotSupported" 5 "CountryNotSupported" 4 "WrngNavDatIncompDatCarrier" 3 "NoNavDataAvailable" 2 "NoNavAvailableSwitchedOff" 1 "NoInformationAllOK" 0 "Null" ;
VAL_TABLE_ TsrOvtkStatMsgTxt_D_Rq 3 "LimitOutdated" 2 "LimitReiable" 1 "LimitChanged" 0 "Null" ;
VAL_TABLE_ TsrOvtkMsgTxt_D_Rq 7 "LimForTrucksCancelled" 6 "LimForTrucksWoQlfdRstrc" 5 "LimForTrucksWithoutRstrc" 4 "LimAllCancelled" 3 "LimAllWithoutQlfdRstrc" 2 "LimAllWithoutRestriction" 1 "OvertakingAllowed" 0 "Null" ;
VAL_TABLE_ Null_False_True 3 "NotUsed" 2 "True" 1 "False" 0 "Null" ;
VAL_TABLE_ TsrStatMsgTxt_D_Rq 7 "NotUsed" 6 "NoDataExists" 5 "TSR_Error" 4 "Available_NavigationOnly" 3 "Available_CameraOnly" 2 "Available_FusionMode" 1 "TSR_Off" 0 "Null" ;
VAL_TABLE_ NoMessage_DisplayMessage 1 "DisplayMessage" 0 "NoMessage" ;
VAL_TABLE_ EngineBrakeOff_Active 1 "Engine_Braking_Activated" 0 "Engine_Braking_Off" ;
VAL_TABLE_ EngSrvcRqd_B_Rq 1 "Engine_Service_Required" 0 "No_engine_service_required" ;
VAL_TABLE_ Allowed_Denied 1 "Denied" 0 "Allowed" ;
VAL_TABLE_ PrkAidMsgTxt_D_Rq 15 "All_Sns_Blk" 14 "R_Sns_ON_F_Sns_Blk" 13 "R_Sns_Blk_F_Sns_ON" 12 "R_Sns_Inactive_Trlr_atch" 11 "Not_Avail_Trlr_attchd" 10 "Fail_Mode_no_Chime" 9 "Fail_Mode_with_Chime" 8 "R_Sns_Trlr_F_Sns_Blk" 7 "NotUsed3" 6 "Park_Sys_Alternate_Mode" 5 "R_Snsrs_On_F_Snsrs_On" 4 "NotUsed2" 3 "Reset_Message_Warn" 2 "R_Snsrs_Off_F_Snsrs_On" 1 "R_Snsrs_On_F_Snsrs_Off" 0 "All_Park_Sensors_Off" ;
VAL_TABLE_ PrkAidSns_D_Stat 15 "Zone_15" 14 "Zone_14" 13 "Zone_13" 12 "Zone_12" 11 "Zone_11" 10 "Zone_10" 9 "Zone_9" 8 "Zone_8" 7 "Zone_7" 6 "Zone_6" 5 "Zone_5" 4 "Zone_4" 3 "Zone_3" 2 "Zone_2" 1 "Zone_1" 0 "Off" ;
VAL_TABLE_ PrkAid_D_Falt 7 "NotUsed2" 6 "NotUsed1" 5 "Failure_Front_PSM_Sensors" 4 "No_Data_Exists" 3 "Failure_Rear_Sensors" 2 "Speaker_Fault" 1 "ECU_Fault" 0 "No_Fault" ;
VAL_TABLE_ OffOnNoDataFault 3 "Fault" 2 "No_Data_Exists" 1 "On" 0 "Off" ;
VAL_TABLE_ ApaActvSd_D_Actl 3 "Dirver_Side" 2 "Passenger_Side" 1 "No_Side" 0 "Null" ;
VAL_TABLE_ ApaMdeStat_D_RqDrv 7 "Faulty" 6 "Off" 5 "NotUsed2" 4 "NotUsed1" 3 "POA" 2 "PPA" 1 "SAPP" 0 "Inactive" ;
VAL_TABLE_ ApaMde_D_Avail 15 "NotUsed7" 14 "NotUsed6" 13 "NotUsed5" 12 "NotUsed4" 11 "NotUsed3" 10 "NotUsed2" 9 "NotUsed1" 8 "PPA_POA" 7 "SAPP_POA" 6 "POA" 5 "PPA" 4 "SAPP" 3 "SAPP_PPA_POA" 2 "SAPP_PPA" 1 "None" 0 "Null" ;
VAL_TABLE_ ApaMde_D_Stat 7 "NotUsed" 6 "RePA" 5 "ParkIn" 4 "POA" 3 "PPA" 2 "SAPP" 1 "Off" 0 "Null" ;
VAL_TABLE_ FrostWarn_D_Stat 3 "NotUsed" 2 "On_Amber" 1 "On_Red" 0 "Off" ;
VAL_TABLE_ SteWhlLckMsgTxt_D_Rq 3 "Message_3" 2 "Message_2" 1 "Message_1" 0 "No_Message" ;
VAL_TABLE_ _7F_Null 127 "Null" ;
VAL_TABLE_ SeatFnDrv_D_Rq 7 "CushionMassage" 6 "LumbarMassage" 5 "UpperBolster" 4 "LowerBolster" 3 "UpperLumbar" 2 "MiddleLumbar" 1 "LowerLumbar" 0 "Inactive" ;
VAL_TABLE_ Inactive_IncreaseDecrease 2 "Decrease" 1 "Increase" 0 "Inactive" ;
VAL_TABLE_ MemFeedback 8 "Recall_4" 7 "Recall_3" 6 "Recall_2" 5 "Recall_1" 4 "Store_4" 3 "Store_3" 2 "Store_2" 1 "Store_1" 0 "Inactive" ;
VAL_TABLE_ Null_Off_LowHigh 3 "High" 2 "Low" 1 "Off" 0 "Null" ;
VAL_TABLE_ NotUpdate_Update 1 "Updating" 0 "NotUpdating" ;
VAL_TABLE_ SeatFnDrv_D_Stat 7 "CushionMassage" 6 "LumbarMassage" 5 "UpperBolster" 4 "LowerBolster" 3 "UpperLumbar" 2 "MiddleLumbar" 1 "LowerLumbar" 0 "Null" ;
VAL_TABLE_ GearRvrse_D_Actl 7 "Fault" 6 "NotUsed_3" 5 "NotUsed_2" 4 "NotUsed_1" 3 "Active_confirmed" 2 "Active_not_confirmed" 1 "Inactive_confirmed" 0 "Inactive_not_confirmed" ;
VAL_TABLE_ SideDetect_SnStat_Invalid 3 "Invalid" 2 "System_Failure" 1 "Blocked" 0 "Clear" ;
VAL_TABLE_ SideDetect_OpStat 7 "NotUsed_3" 6 "NotUsed_2" 5 "NotUsed_1" 4 "Invalid" 3 "Disabled" 2 "On" 1 "Trailer_Tow_Off" 0 "Off" ;
VAL_TABLE_ SideDetect_Present 4 "Sensor_Blocked" 3 "Sensor_Fault" 2 "Flash_On" 1 "Alert_On" 0 "AlertOff_FlashOff_SensrClr" ;
VAL_TABLE_ Off_On_Flash_BulbProveout 3 "Bulb_Proveout" 2 "Flash" 1 "On" 0 "Off" ;
VAL_TABLE_ SideDetect_BLIS_Off_On 2 "BLIS_On_Second_Warning_ON" 1 "BLIS_On_Second_Warning_OFF" 0 "Off" ;
VAL_TABLE_ SideDetect_report 3 "Reporting" 2 "Not_Reporting" 1 "System_Standby" 0 "Initialization" ;
VAL_TABLE_ DrTGate_D_Rq 3 "NotUsed" 2 "Closing" 1 "Opening" 0 "Not_Moving" ;
VAL_TABLE_ WndwSide_D_Stat 3 "BothWindow_Operating" 2 "RearWindow_Operating" 1 "FrontWindow_Operating" 0 "NoWindows_Operating" ;
VAL_TABLE_ DcacElPw_D_Rq 3 "NotUsed" 2 "AC_HighPower_Requested" 1 "AC_LowPower_Requested" 0 "AC_Power_NotRequested" ;
VAL_TABLE_ False_True 1 "True" 0 "False" ;
VAL_TABLE_ Null_Up_Down 3 "Unused" 2 "Down" 1 "Up" 0 "Null" ;
VAL_TABLE_ Null_Fwd_Rwd 3 "Unused" 2 "Rearward" 1 "Forward" 0 "Null" ;
VAL_TABLE_ Null_Ack_Nack_NotUsed 3 "Not_Used" 2 "Nack" 1 "Ack" 0 "Null" ;
VAL_TABLE_ Null_Reset 1 "Reset" 0 "Null" ;
VAL_TABLE_ Unknown_FFFD_Invalid_NotSup 65535 "Not_Supported" 65534 "Invalid" 65533 "Unknown" ;
VAL_TABLE_ HvacBlwrFront_D_Stat 31 "Not_Used" 20 "Full_On" 19 "95_Percent" 18 "90_Percent" 17 "85_Percent" 16 "80_Percent" 15 "75_Percent" 14 "70_Percent" 13 "65_Percent" 12 "60_Percent" 11 "55_Percent" 10 "50_Percent" 9 "45_Percent" 8 "40_Percent" 7 "35_Percent" 6 "30_Percent" 5 "25_Percent" 4 "20_Percent" 3 "15_Percent" 2 "10_Percent" 1 "5_Percent" 0 "Off" ;
VAL_TABLE_ immoMsgTxt_D_Rq 15 "Immo_Msg_15" 14 "Immo_Msg_14" 13 "Immo_Msg_13" 12 "Immo_Msg_12" 11 "Immo_Msg_11" 10 "Immo_Msg_10" 9 "Immo_Msg_9" 8 "Immo_Msg_8" 7 "Immo_Msg_7" 6 "Immo_Msg_6" 5 "Immo_Msg_5" 4 "Immo_Msg_4" 3 "Immo_Msg_3" 2 "Immo_Msg_2" 1 "Immo_Msg_1" 0 "Immo_Msg_0_Null" ;
VAL_TABLE_ ACU_ARAudioSource_Rsp 15 "iPod" 14 "USB" 13 "BTAudio" 0 "AmfmRadio" 1 "FrontDisc" 2 "SDARS_DAB" 3 "InDashCdChanger" 4 "VoiceRecogniser" 5 "TelematicUnit" 6 "BluetoothPhone" 7 "RearDisc" 8 "APIM" 9 "FrontAuxInput" 10 "Navigation" 11 "RearAux" 12 "NotReq" ;
VAL_TABLE_ ACU_AROperationType_Rsp 0 "Inactive" 1 "Requestaudioresource" 2 "Releaseaudioresource" 3 "Releaseallaudioresouces" 4 "Getresourceupdate" 5 "Getallresourceupdates" ;
VAL_TABLE_ ACU_ARResponse_Rsp 0 "Inactive" 1 "RequestAccepted" 2 "RequestAcceptedWoCtrl" 3 "RequestDenied" 4 "RessourceUpdateStatus" ;
VAL_TABLE_ ACU_ARReqstrPriority_Rp 0 "EmergencyServ" 1 "TelService" 2 "AutoAnswer" 3 "Ta" 4 "PttMutevoice" 5 "NavUserVoiceCmd" 6 "NavSysVoiceCmd" 7 "Radio" 8 "Disc" 9 "Alarm" 10 "Ptynews" 11 "Aux_ExtSource" 12 "MobileNavAndTelMute" 13 "ManualAudioMute" 14 "NotReq" ;
VAL_TABLE_ ACU_RUAudioSource_St 15 "iPod" 14 "USB" 13 "BTAudio" 0 "AmfmRadio" 1 "FrontDisc" 2 "SDARS_DAB" 3 "InDashCdChanger" 4 "VoiceRecogniser" 5 "TelematicUnit" 6 "BluetoothPhone" 7 "RearDisc" 8 "APIM" 9 "FrontAuxInput" 10 "Navigation" 11 "RearAux" 12 "NotReq" ;
VAL_TABLE_ FrontRequest_RearRequest 0 "FrontRequester" 1 "RearRequester" ;
VAL_TABLE_ ACU_RUResReqstStatus_St 0 "NoResourceupdate" 1 "Deallocated" 2 "Allocated" 3 "Stacked" 4 "Granted" 5 "GrantedNoControlOfAudioSrc" ;
VAL_TABLE_ ACU_RUReqstrPriority_St 0 "EmergencyServ" 1 "TelService" 2 "AutoAnswer" 3 "Ta" 4 "PttMutevoice" 5 "NavUserVoiceCmd" 6 "NavSysVoiceCmd" 7 "Radio" 8 "Disc" 9 "Alarm" 10 "Ptynews" 11 "Aux_ExtSource" 12 "MobileNavAndTelMute" 13 "ManualAudioMute" 14 "NotReq" ;
VAL_TABLE_ EFP_Bezel_Diag_St 15 "Reserved" 3 "CalibrationPartNumber" 2 "HardwarePartNumber" 1 "SoftwarePartNumber" 0 "Inactive_NOP" ;
VAL_TABLE_ Invalid_SupportedNotSup 2 "Not_Supported" 1 "Supported" 0 "Invalid" ;
VAL_TABLE_ BattTracWarnLamp_B_Rq 1 "On" 0 "Off" ;
VAL_TABLE_ BattTracSrvcRqd_B_Rq 1 "On" 0 "Off" ;
VAL_TABLE_ HtrnWarnLamp_B_Dsply 1 "On" 0 "Off" ;
VAL_TABLE_ HtrnSrvcRqd_B_Dsply 1 "On" 0 "Off" ;
VAL_TABLE_ NoData_Faulty_7E_7F 127 "Faulty" 126 "NoDataExists" ;
VAL_TABLE_ PtWakeupActv1_B_Rq 1 "Wake_up_Powertrain_via_HW" 0 "Don_t_Wake_Up_Powertrain" ;
VAL_TABLE_ TimeAdjustRequest 0 "NoTimeAdjustRequest" 1 "TimeAdjustRequest" ;
VAL_TABLE_ DateAdjustRequest 0 "NoDateAdjustRequest" 1 "DateAdjustRequest" ;
VAL_TABLE_ Invalid_EnabledDisabled2 0 "Invalid" 2 "Disabled" 1 "Enabled" ;
VAL_TABLE_ Disp_LangSel_St 31 "Thai" 30 "Slovak" 29 "Arabic" 28 "Taiwanese" 27 "Mandarin_Chinese" 26 "Korean" 25 "AU_English" 24 "Japanese" 23 "Braz_Portuguese" 22 "EU_Portuguese" 21 "Finish" 20 "Norwegian" 19 "Danish" 18 "Swedish" 17 "Hungarian" 16 "Greek" 15 "Czech" 14 "Polish" 13 "Flemish" 12 "Dutch" 11 "Russian" 10 "Turkish" 9 "Mex_Spanish" 8 "EU_Spanish" 7 "Cana_French" 6 "EU_French" 5 "Italian" 4 "German" 3 "NA_English" 2 "UK_English" 1 "Unknown" 0 "Invalid" ;
VAL_TABLE_ Diagnostic_Operation_Rq 7 "SignalStrength" 6 "SDARSESNNumber" 5 "SpeakerWalkAround" 4 "CalibrationPartNumber" 15 "Reserved" 3 "HardwarePartNumber" 2 "SoftwarePartNumber" 1 "GetAllBackgroundDiagRq" 0 "Inactive" ;
VAL_TABLE_ Bezel_Diag_Module_Rq 15 "Reserved" 3 "EFP" 2 "DSP_AMP" 1 "AHU" 0 "Inactive" ;
VAL_TABLE_ Surround_Sound_Upmix 2 "Surround" 1 "Stereo" 0 "Inactive" ;
VAL_TABLE_ HMI_HMIMode_St 7 "NotUsed2" 6 "NotUsed1" 5 "Load_Shed_Active" 0 "Invalid" 1 "OffMode" 2 "On" 3 "Phone" 4 "Climate" ;
VAL_TABLE_ FuelPumpPwr_D_Stat 7 "NotUsed3" 6 "NotUsed2" 5 "NotUsed1" 4 "Power_Off_Default" 3 "Power_Off_Command" 2 "Power_Off_Service" 1 "Power_Off_Impact" 0 "Power_On" ;
VAL_TABLE_ PrmtrAlrmEvnt_D_Stat 15 "Diag_Tamper" 14 "Trailer" 13 "Shock_Sensor" 12 "Post_Crash" 11 "Panic" 10 "Intrusion" 9 "Inclination" 8 "Ign_Tamper" 7 "LG_Door" 6 "Decklid" 5 "Hood" 4 "PR_Door" 3 "PF_Door" 2 "DR_Door" 1 "DF_Door" 0 "Null" ;
VAL_TABLE_ SecurityMsgTxt_D_Rq 3 "Message3" 2 "Message2" 1 "Message1" 0 "NoMessage" ;
VAL_TABLE_ BattChrgRdyStat_D_Actl 7 "NotUsed2" 6 "NotUsed1" 5 "Faulted" 4 "ChargeComplete" 3 "Charging" 2 "BatteryChargeReady" 1 "ChargeWait" 0 "NotReady" ;
VAL_TABLE_ BattChrgInhbt_D_Rq 3 "MaintainTargetSoc" 2 "NotUsed" 1 "InhibitChargingThermal" 0 "Enable_Charging" ;
VAL_TABLE_ Fault_7FF_NoData 2047 "Fault" 2046 "NoDataExists" ;
VAL_TABLE_ Deactivate_Activate 1 "Activate" 0 "Deactivate" ;
VAL_TABLE_ PtcHtr_D_Stat 3 "Faulty" 2 "NotUsed" 1 "On" 0 "Off" ;
VAL_TABLE_ PtcHtr_D_Cmd 3 "TurnOn" 2 "AutoMode" 1 "TurnOff" 0 "NoDecision_Initializing" ;
VAL_TABLE_ Fault_FFFFFF 16777215 "Fault" ;
VAL_TABLE_ NoData_Fault_FFFE_FFFF 65535 "Fault" 65534 "NoDataExists" ;
VAL_TABLE_ EngOffTe_B_Dsply 1 "Eng_warm_engh_for_pd" 0 "Eng_not_warm_engh_for_pd" ;
VAL_TABLE_ DrvEffLvlIncDec_D_Cmd 3 "NotUsed" 2 "Decrease_Level_by_1" 1 "Increase_Level_by_1" 0 "Null_State" ;
VAL_TABLE_ Fault_FFFF_NoData_FFFE 65535 "Fault" 65534 "NoDataExists" ;
VAL_TABLE_ Fault_1FFF 8191 "Fault" ;
VAL_TABLE_ TrlrBattChrg_D_Stat 3 "Reverse" 2 "Normal" 1 "Low" 0 "Null" ;
VAL_TABLE_ TrlrLampCtl_D_Stat 3 "NotUsed" 2 "TrlrLampCnnctDrvFailure" 1 "TrlrLampNotCnnctDrvFailure" 0 "Null" ;
VAL_TABLE_ ElPw_D_StatStrtStop 15 "NotUsed6" 14 "NotUsed5" 13 "NotUsed4" 12 "NotUsed3" 11 "NotUsed2" 10 "NotUsed1" 9 "Supported_Level_4" 8 "Supported_Level_3" 7 "Supported_Level_2" 6 "Supported_Level_1" 5 "Limited_Support" 4 "Fault_Limited" 3 "LV_Event_in_Progress" 2 "Not_Supported_Imminent" 1 "Supported_All" 0 "Not_Supported" ;
VAL_TABLE_ ImpactEvntFdbck_D_Stat 3 "NotUsed" 2 "EventComplete" 1 "EventInProgress" 0 "Normal" ;
VAL_TABLE_ StopStrtIODTxt_D_Rq 31 "Message31" 30 "Message30" 29 "Message29" 28 "Message28" 27 "Message27" 26 "Message26" 25 "Message25" 24 "Message24" 23 "Message23" 22 "Message22" 21 "Message21" 20 "Message20" 19 "Message19" 18 "Message18" 17 "Message17" 16 "Message16" 15 "Message15" 14 "Message14" 13 "Message13" 12 "Message12" 11 "Message11" 10 "Message10" 9 "Message9" 8 "Message8" 7 "Message7" 6 "Message6" 5 "Message5" 4 "Message4" 3 "Message3" 2 "Message2" 1 "Message1" 0 "NoMessage" ;
VAL_TABLE_ NoData_Fault_7FFE_7FFF 32767 "Fault" 32766 "NoDataExists" ;
VAL_TABLE_ NoData_Fault_3E_3F 63 "Fault" 62 "NoDataExists" ;
VAL_TABLE_ DrvSte_D_Stat 15 "NotUsed10" 14 "NotUsed9" 13 "NotUsed8" 12 "NotUsed7" 11 "NotUsed6" 10 "NotUsed5" 9 "NotUsed4" 8 "NotUsed3" 7 "NotUsed2" 6 "NotUsed1" 5 "Request_Active" 4 "Ignition_Off" 3 "DSR_in_Normal_Idle_Mode" 2 "EPAS_Comm_Disturbed" 1 "DSR_Request_Not_Applicable" 0 "DSR_Deactivated" ;
VAL_TABLE_ StrtrMtrCtlMsgTxt_D_Rq 7 "Start_In_Gear_Allowed" 6 "Pending_Start_Cancelled" 5 "Start_Pending_Please_Wait" 4 "Cranking_Limit_Exceeded" 3 "Press_Brk_and_Shift_to_P_N" 2 "Press_Clutch_and_Brake" 1 "Press_Clutch_To_Start" 0 "No_Display" ;
VAL_TABLE_ Null_Open 1 "Open" 0 "Null" ;
VAL_TABLE_ Invalid_Ok_NotOk 2 "NotOk" 1 "Ok" 0 "Invalid" ;
VAL_TABLE_ Invalid_OffOn 0 "Invalid" 1 "Off" 2 "On" ;
VAL_TABLE_ NoUpdate_Update 1 "Update" 0 "NoUpdate" ;
VAL_TABLE_ Mc_DB1SetTrkSetFilt3_Rq 1023 "All" 1022 "SIIndex_1022" 1 "SIIndex_1" 0 "NotEngaged" ;
VAL_TABLE_ Mc_DB1SetTrkSetFilt1_Rq 65535 "All" 65534 "SIIndex_65534" 1 "SIIndex_1" 0 "NotEngaged" ;
VAL_TABLE_ Mc_CutItem_Rq 3 "Inactive" 2 "ThreeQuarterFromBeginOneQ" 1 "End" 0 "Beginning" ;
VAL_TABLE_ Mc_FolderContent_Rq 2 "Inactive" 1 "ReqContentParentFolderOf" 0 "ReqContentParameterFolder" ;
VAL_TABLE_ Inactive_Cancel 1 "Cancel" 0 "Inactive" ;
VAL_TABLE_ Mc_TextMessage_Rq 3 "Cancel" 2 "Ignore" 1 "Listen" 0 "Invalid" ;
VAL_TABLE_ Mc_BTInCallOptions_Rq 6 "EndHoldCall" 5 "HoldCall" 4 "GotoHandsfreeMode" 3 "GotoPrivacyMode" 2 "JoinCalls" 1 "SwitchCalls" 0 "Inactive" ;
VAL_TABLE_ Mc_PhMicrophoneMute_Rq 3 "Reserved" 2 "MicrophoneUnmute" 1 "MicrophoneMute" 0 "Inactive" ;
VAL_TABLE_ Mc_AudioSourceSel_Rq 4 "Reserved" 5 "SDcard" 3 "USB" 2 "BTAudio" 1 "CD" 0 "Inactive" ;
VAL_TABLE_ Disp_VehUntTripCoUsrSel 3 "Inactive" 1 "Imperial" 0 "Metric" ;
VAL_TABLE_ Disp_VehUnitTempUsrSel 3 "Inactive" 1 "Fahrenheit" 0 "Celsius" ;
VAL_TABLE_ Disp_LangSel_Rq 31 "Thai" 30 "Slovak" 29 "Arabic" 28 "Taiwanese" 27 "Mandarin_Chinese" 26 "Korean" 25 "AU_English" 24 "Japanese" 23 "Braz_Portuguese" 22 "EU_Portuguese" 21 "Finish" 20 "Norwegian" 19 "Danish" 18 "Swedish" 17 "Hungarian" 16 "Greek" 15 "Czech" 14 "Polish" 13 "Flemish" 12 "Dutch" 11 "Russian" 10 "Turkish" 9 "Mex_Spanish" 8 "EU_Spanish" 7 "Cana_French" 6 "EU_French" 5 "Italian" 4 "German" 3 "NA_English" 2 "UK_English" 1 "Unknown" 0 "Invalid" ;
VAL_TABLE_ Chime_Occurence 15 "Continuous" 14 "14Repititions" 13 "13Repititions" 12 "12Repititions" 11 "11Repititions" 10 "10Repititions" 9 "9Repititions" 8 "8Repititions" 7 "7Repititions" 6 "6Repititions" 5 "5Repititions" 4 "4Repititions" 3 "3Repititions" 2 "2Repititions" 1 "PlayOnce" 0 "Inactive" ;
VAL_TABLE_ Inactive_HighLow 2 "Low" 1 "High" 0 "Inactive" ;
VAL_TABLE_ Chime_Directionality 3 "RearSpeakers" 2 "FrontSpeakers" 1 "ALL" 0 "Inactive" ;
VAL_TABLE_ TempDegreesC_DegreesF 0 "Temperature_deg_c" 1 "Temperature_deg_f" ;
VAL_TABLE_ LangUpdate_Rsp 2 "Language_Not_Supported" 1 "Language_Updated" 0 "Inactive" ;
VAL_TABLE_ HEC_TUPresetArea_Rq 13 "reserved" 12 "GetSAT3PresetData" 11 "GetSAT2PresetData" 15 "reserved_last" 10 "GetSAT1PresetData" 9 "GetDAB2PresetData" 8 "GetDAB1PresetData" 7 "Reserved1" 6 "GetAmPresetData" 5 "GetAmAstPresetData" 4 "GetFmAstPresetData" 3 "GetFm3PresetData" 2 "GetFm2PresetData" 1 "GetFm1PresetData" 0 "Inactive" ;
VAL_TABLE_ HEC_SetCurrTUBand_Rq 12 "reserved" 11 "SAT3" 10 "SAT2" 15 "reserved_last" 9 "SAT1" 8 "DAB2" 7 "DAB1" 6 "AmAst" 5 "Am" 4 "FmAst" 3 "Fm3" 2 "Fm2" 1 "Fm1" 0 "Inactive" ;
VAL_TABLE_ BeltminderAudioMute 2 "On" 1 "Off" 0 "Invalid" ;
VAL_TABLE_ Chime_Source 2 "Cluster" 1 "Infotainment_Sys" 0 "Invalid" ;
VAL_TABLE_ Invalid_DayNight 2 "Night" 1 "Day" 0 "Invalid" ;
VAL_TABLE_ Invalid_12h_24h 2 "24h_mode" 1 "12h_mode" 0 "Invalid" ;
VAL_TABLE_ Invalid_Theme1_2 2 "Theme_2" 1 "Theme_1" 0 "Invalid" ;
VAL_TABLE_ LanguageSelect_St 33 "Ukrainian" 32 "Indian_English" 31 "Thai" 30 "Slovak" 29 "Arabic" 28 "Taiwanese" 27 "Mandarin_Chinese" 26 "Korean" 25 "AU_English" 24 "Japanese" 23 "Braz_Portuguese" 22 "EU_Portuguese" 21 "Finish" 20 "Norwegian" 19 "Danish" 18 "Swedish" 17 "Hungarian" 16 "Greek" 15 "Czech" 14 "Polish" 13 "Flemish" 12 "Dutch" 11 "Russian" 10 "Turkish" 9 "Mex_Spanish" 8 "EU_Spanish" 7 "Cana_French" 6 "EU_French" 5 "Italian" 4 "German" 3 "NA_English" 2 "UK_English" 1 "Unknown" 0 "Invalid" ;
VAL_TABLE_ Standard_OneItem 1 "OneItem" 0 "Standard" ;
VAL_TABLE_ Mc_DB1GetInfSetConf_Rq 31 "UnknownActive" 30 "Reserved_last" 9 "Reserved" 8 "Podcast" 7 "Audiobook" 6 "Composer" 5 "Track" 4 "Genre" 3 "Album" 2 "Artist" 1 "Playlist" 0 "Root" ;
VAL_TABLE_ Mc_DB1GetInfSetFilt3_Rq 1023 "All" 1022 "SIIndex_1022" 1 "SIIndex_1" 0 "NotEngaged" ;
VAL_TABLE_ Mc_DB1GetInfSetFilt1_Rq 65535 "All" 65534 "SIIndex_65534" 1 "SIIndex_1" 0 "NotEngaged" ;
VAL_TABLE_ Mc_DB1SetTrkSetConf_Rq 9 "Reserved" 8 "Podcast" 7 "Audiobook" 6 "Composer" 5 "Track" 4 "Genre" 3 "Album" 2 "Artist" 1 "Playlist" 0 "Root" 31 "UnknownActive" 30 "Reserved_last" ;
VAL_TABLE_ Mc_PerTUPresetArea_Rq 13 "reserved" 12 "GetSAT3PresetData" 11 "GetSAT2PresetData" 15 "reserved_last" 10 "GetSAT1PresetData" 9 "GetDAB2PresetData" 8 "GetDAB1PresetData" 7 "GetDAB3PresetData" 6 "GetAmPresetData" 5 "GetAmAstPresetData" 4 "GetFmAstPresetData" 3 "GetFm3PresetData" 2 "GetFm2PresetData" 1 "GetFm1PresetData" 0 "Inactive" ;
VAL_TABLE_ Mc_SetCurrStatMCCh_Rq 7 "MCChannel7" 6 "MCChannel6" 5 "MCChannel5" 4 "MCChannel4" 3 "MCChannel3" 2 "MCChannel2" 1 "MCChannel1" 0 "Inactive" ;
VAL_TABLE_ Mc_SetCurrentStatOp_Rq 0 "Inactive" 1 "SetCurrentFrequency" 2 "SetCurrentPiCode" 3 "SetCurrentStation" ;
VAL_TABLE_ HEC_BTIncomingCall_Rq 0 "Inactive" 1 "AcceptIncomingCall" 2 "DeclineIncomingCall" ;
VAL_TABLE_ HEC_BTEndTelService_Rq 1 "EndOngoingTelephonyCall" 0 "Inactive" ;
VAL_TABLE_ Temp_Detents 15 "Unused5" 14 "Unused4" 13 "Unused3" 12 "Unused2" 11 "Unused1" 10 "Display_Blank" 9 "_4_Heat_Bars" 8 "_3_Heat_Bars" 7 "_2_Heat_Bars" 6 "_1_Heat_Bar" 5 "Neutral_Bar_Only" 4 "_1_Cool_Bar" 3 "_2_Cool_Bars" 2 "_3_Cool_Bars" 1 "_4_Cool_Bars" 0 "No_Bars" ;
VAL_TABLE_ Set_Temp_Dig3 2 "_5" 1 "_0" 0 "Off" ;
VAL_TABLE_ Set_Temp_Dig 15 "Blank2" 14 "Blank1" 13 "I" 12 "H" 11 "O" 10 "L" 9 "_9" 8 "_8" 7 "_7" 6 "_6" 5 "_5" 4 "_4" 3 "_3" 2 "_2" 1 "_1" 0 "_0" ;
VAL_TABLE_ Btn_Status 31 "NotUsed_7" 30 "NotUsed_6" 29 "NotUsed_5" 28 "NotUsed_4" 27 "NotUsed_3" 26 "NotUsed_2" 25 "NotUsed_1" 24 "Third_Sync_Pressed" 23 "Third_Rr_Pwr_Pressed" 22 "Third_Auto_Pressed" 21 "Third_Pnl_Flr_Pressed" 20 "Third_Floor_Pressed" 19 "Third_Panel_Pressed" 18 "Third_Blwr_Dec_Pressed" 17 "Third_Blwr_Inc_Pressed" 16 "Rear_Lock_Pressed" 15 "RHS_Cld_Seat_Pressed" 14 "LHS_Cld_Seat_Pressed" 13 "RHS_Htd_Seat_Pressed" 12 "LHS_Htd_Seat_Pressed" 11 "Rear_Power_Pressed" 10 "AUTO_Pressed" 9 "Blwr_Dec_Pressed" 8 "Blwr_Inc_Pressed" 7 "RHS_Temp_Dec_Pressed" 6 "RHS_Temp_Inc_Pressed" 5 "LHS_Temp_Dec_Pressed" 4 "LHS_Temp_Inc_Pressed" 3 "Floor_Pressed" 2 "Panel_Floor_Pressed" 1 "Panel_Pressed" 0 "None_Pressed" ;
VAL_TABLE_ Cond_Seat_Status 7 "Unused" 6 "Level_3_Heating" 5 "Level_2_Heating" 4 "Level_1_Heating" 3 "Level_3_Cooling" 2 "Level_2_Cooling" 1 "Level_1_Cooling" 0 "Off" ;
VAL_TABLE_ Htd_Strg_Whl_Status 3 "Level_3_Heating" 2 "Level_2_Heating" 1 "Level_1_Heating" 0 "Off" ;
VAL_TABLE_ Frt_Btn_Status_1st 36 "MdeMnu_Pressed" 35 "AAR_Pressed" 34 "Heat_Pressed" 33 "RearMnu_Pressed" 32 "FrontMnu_Pressed" 63 "NotUsed_10" 62 "NotUsed_9" 61 "NotUsed_8" 60 "NotUsed_7" 59 "NotUsed_6" 58 "AUTO_Dec_Pressed" 57 "AUTO_Inc_Pressed" 56 "AUTO_Hi_Pressed" 55 "AUTO_Med_Pressed" 54 "AUTO_Lo_Pressed" 53 "RHS_Cld_Seat3_Pressed" 52 "RHS_Cld_Seat2_Pressed" 51 "RHS_Cld_Seat1_Pressed" 50 "LHS_Cld_Seat3_Pressed" 49 "LHS_Cld_Seat2_Pressed" 48 "LHS_Cld_Seat1_Pressed" 47 "RHS_Auto_Seat_Pressed" 46 "RHS_Htd_Seat3_Pressed" 45 "RHS_Htd_Seat2_Pressed" 44 "RHS_Htd_Seat1_Pressed" 43 "RHS_Seat_Off_Pressed" 42 "LHS_Auto_Seat_Pressed" 41 "LHS_Htd_Seat3_Pressed" 40 "LHS_Htd_Seat2_Pressed" 39 "LHS_Htd_Seat1_Pressed" 38 "LHS_Seat_Off_Pressed" 37 "DrvrFcsdMde_Pressed" 31 "Defrost_Pressed" 30 "Htg_Strg_Whl_Pressed" 29 "RHS_Cld_Seat_Pressed" 28 "LHS_Cld_Seat_Pressed" 27 "RHS_Htd_Seat_Pressed" 26 "LHS_Htd_Seat_Pressed" 25 "Max_Defrost_Pressed" 24 "My_Temp_Pressed" 23 "Front_Power_Pressed" 22 "Rear_Defrost_Pressed" 21 "Pnl_Flr_Ws_Pressed" 20 "Pnl_Ws_Pressed" 19 "Windscreen_Pressed" 18 "Htd_Frt_Wsh_Pressed" 17 "Auto_Recirc_Pressed" 16 "Outside_Pressed" 15 "Recirc_Pressed" 14 "Max_AC_Pressed" 13 "AUTO_Pressed" 12 "Blwr_Dec_Pressed" 11 "Blwr_Inc_Pressed" 10 "RHS_Temp_Dec_Pressed" 9 "RHS_Temp_Inc_Pressed" 8 "LHS_Temp_Dec_Pressed" 7 "LHS_Temp_Inc_Pressed" 6 "Dual_Pressed" 5 "AC_Pressed" 4 "Floor_Ws_Pressed" 3 "Floor_Pressed" 2 "Panel_Floor_Pressed" 1 "Panel_Pressed" 0 "None_Pressed" ;
VAL_TABLE_ Frt_Blower_Speed 3 "NotUsed" 2 "Max_Blower" 1 "Min_Blower" 0 "No_Request" ;
VAL_TABLE_ Blower_Indicate 15 "Display_Blank" 14 "14_Indicators_On" 13 "13_Indicators_On" 12 "12_Indicators_On" 11 "11_Indicators_On" 10 "10_Indicators_On" 9 "9_Indicators_On" 8 "8_Indicators_On" 7 "7_Indicators_On" 6 "6_Indicators_On" 5 "5_Indicators_On" 4 "4_Indicators_On" 3 "3_Indicators_On" 2 "2_Indicators_On" 1 "1_Indicator_On" 0 "Indicators_Off" ;
VAL_TABLE_ Front_AUTO_Label 3 "Full" 2 "Mode" 1 "Blower" 0 "Off" ;
VAL_TABLE_ Drv_Set_Temp 31 "HI" 30 "29_5" 29 "29_0" 28 "28_5" 27 "28_0" 26 "27_5" 25 "27_0" 24 "26_5" 23 "26_0" 22 "25_5" 21 "25_0" 20 "24_5" 19 "24_0" 18 "23_5" 17 "23_0" 16 "22_5" 15 "22_0" 14 "21_5" 13 "21_0" 12 "20_5" 11 "20_0" 10 "19_5" 9 "19_0" 8 "18_5" 7 "18_0" 6 "17_5" 5 "17_0" 4 "16_5" 3 "16_0" 2 "15_5" 1 "LO" 0 "No_Request" ;
VAL_TABLE_ CC_Fr_Stat_User_Adj 7 "Unused4" 6 "RHS_AUTO_St_Selection" 5 "LHS_AUTO_St_Selection" 4 "DrvrFcsdMde_Selection" 3 "Fr_Blwr_Spd_Selection" 2 "FRHS_SetPt_Selection" 1 "FLHS_SetPt_Selection" 0 "None" ;
VAL_TABLE_ CC_Rr_Stat_User_Adj 15 "Unused9" 14 "Unused8" 13 "Unused7" 12 "Unused6" 11 "Unused5" 10 "Unused4" 9 "Unused3" 8 "Unused2" 7 "Unused1" 6 "Rr_Auto_Selection" 5 "Rr_Control_Selection" 4 "Rr_Power_Selection" 3 "Rr_Blwr_Spd_Selection" 2 "RRHS_SetPt_Selection" 1 "RLHS_SetPt_Selection" 0 "None" ;
VAL_TABLE_ CC_Fr_Btn_User_Adj 31 "Unused15" 30 "Unused14" 29 "Unused13" 28 "Unused12" 27 "Unused11" 26 "Unused10" 25 "Unused9" 24 "Unused8" 23 "Unused7" 22 "Unused6" 21 "RHS_Cld_St_Selection" 20 "LHS_Cld_St_Selection" 19 "UFC_Interrupted" 18 "UFC_Complete" 17 "UFC_Active" 16 "Htd_WS_Selection" 15 "RHS_Htd_St_Selection" 14 "LHS_Htd_St_Selection" 13 "HSW_Selection" 12 "Dual_Selection" 11 "Rear_Defrost_Selection" 10 "Max_Defrost_Selection" 9 "Defrost_Selection" 8 "Fr_Air_Dist_Selection" 7 "Max_AC_Selection" 6 "Fr_Power_Selection" 5 "Recirc_Selection" 4 "AC_Selection" 3 "Fr_Auto_Selection" 2 "Use_MyTemp_Selection" 1 "Save_MyTemp_Selection" 0 "None" ;
VAL_TABLE_ HeadLghtHiFdbck_D_Stat 3 "NotUsed" 2 "Cancel" 1 "Hold" 0 "Allow_Change" ;
VAL_TABLE_ Backlit_LED_Status 15 "Unused3" 14 "Unused2" 13 "Unused1" 12 "Night_12" 11 "Night_11" 10 "Night_10" 9 "Night_9" 8 "Night_8" 7 "Night_7" 6 "Night_6" 5 "Night_5" 4 "Night_4" 3 "Night_3" 2 "Night_2" 1 "Night_1" 0 "Off" ;
VAL_TABLE_ Veh_Lock_Status 3 "UNLOCK_DRV" 2 "UNLOCK_ALL" 1 "LOCK_ALL" 0 "LOCK_DBL" ;
VAL_TABLE_ PrkLckCtlMsgTxt_D_Rq 3 "BTSI_DI_3" 2 "BTSI_DI_2" 1 "BTSI_DI_1" 0 "Null_BTSI_DI" ;
VAL_TABLE_ NoShift_Shift 1 "Shift" 0 "NoShift" ;
VAL_TABLE_ CcdMsgTxt_D_RqDsply 15 "Unused8" 14 "Unused7" 13 "Unused6" 12 "Unused5" 11 "Unused4" 10 "Unused3" 9 "Unused2" 8 "StationaryMode" 7 "Mode_Change_Unavailable" 6 "CCD_Temporarily_Off" 5 "CCD_Service_Required" 4 "Faulty" 3 "Sport" 2 "Normal" 1 "Comfort" 0 "No_Mode_Selected" ;
VAL_TABLE_ CrashEvnt_D_Stat 3 "Invalid" 2 "Fuel_Cutoff_Event" 1 "Deploy_Event" 0 "No_Event" ;
VAL_TABLE_ ReducedGuard_D_Stat 3 "NotUsed" 2 "Alarm_On" 1 "Alarm_Off_Previously_On" 0 "Alarm_Off" ;
VAL_TABLE_ HvacPrecondBlwr_D_Rq 15 "NotUsed6" 14 "NotUsed5" 13 "NotUsed4" 12 "NotUsed3" 11 "NotUsed2" 10 "NotUsed1" 9 "Last_User_Setting" 8 "Auto" 7 "Speed7" 6 "Speed6" 5 "Speed5" 4 "Speed4" 3 "Speed3" 2 "Speed2" 1 "Speed1" 0 "Off" ;
VAL_TABLE_ HvacPrecondMode_D_Rq 15 "NotUsed4" 14 "NotUsed3" 13 "NotUsed2" 12 "NotUsed1" 11 "Last_User_Settings" 10 "Auto" 9 "Max_Defrost" 8 "Windshield_Panel_Floor" 7 "Windshield_Panel" 6 "Windshield" 5 "Windshield_Floor" 4 "Floor" 3 "Panel_Floor" 2 "Panel" 1 "MAX_AC" 0 "Off" ;
VAL_TABLE_ ButtonNotPressed 1 "Button_Pressed" 0 "Button_Not_Pressed" ;
VAL_TABLE_ Null_Pressed 1 "Pressed" 0 "Null" ;
VAL_TABLE_ FobComm_D_Stat 3 "NotUsed" 2 "RemEngStartOK" 1 "RemEngStartFail" 0 "Null" ;
VAL_TABLE_ PudLamp_D_Rq 3 "RAMP_DOWN" 2 "RAMP_UP" 1 "ON" 0 "OFF" ;
VAL_TABLE_ WndwGlbl_D_Cmd 7 "NotUsed3" 6 "NotUsed2" 5 "NotUsed1" 4 "GLEARN" 3 "GCLOSE" 2 "GOPEN" 1 "GSTOP" 0 "Null" ;
VAL_TABLE_ LockMsg 7 "MSG7" 6 "MSG6" 5 "MSG5" 4 "MSG4" 3 "MSG3" 2 "MSG2" 1 "MSG1" 0 "NO_WARNING" ;
VAL_TABLE_ ChildLockDisplay 3 "NOT_SUPPORTED" 2 "ERROR" 1 "CHILD_UNLOCK" 0 "CHILD_LOCK" ;
VAL_TABLE_ Null_Lock_Unlock 3 "NotUsed" 2 "Unlock" 1 "Lock" 0 "Null" ;
VAL_TABLE_ NotDown_Down 1 "Down" 0 "Not_Down" ;
VAL_TABLE_ NotUp_Up 1 "Up" 0 "Not_Up" ;
VAL_TABLE_ Wiper 15 "NO_DATA_EXISTS" 14 "STALLED" 13 "RESERVED" 12 "AUTO_ADJUST" 11 "COURTESYWIPE" 10 "AUTO_HIGH" 9 "AUTO_LOW" 8 "WASH" 7 "MIST_FLICK" 6 "MAN_HIGH" 5 "MAN_LOW" 4 "MAN_INT_ON" 3 "MAN_INT_OFF" 2 "OFF_MOVING" 1 "AUTO_OFF" 0 "OFF" ;
VAL_TABLE_ Turn_switch 3 "Unused_Treat_As_Off" 2 "Right" 1 "Left" 0 "Off" ;
VAL_TABLE_ PrkLght_D_Stat 3 "Park_Both" 2 "Park_Right" 1 "Park_Left" 0 "Off" ;
VAL_TABLE_ LghtAmb_D_Sns 7 "No_Data_Exists" 6 "Unused2" 5 "Unused1" 4 "Tunnel_Off" 3 "Tunnel_On" 2 "Twilight" 1 "Light" 0 "Dark" ;
VAL_TABLE_ HeadLghtSwtch_D_Stat 3 "Autolamp" 2 "Headlamp" 1 "Parklamp" 0 "Off" ;
VAL_TABLE_ EmgcyBrkLamp_D_Rq 3 "NotUsed" 2 "Active_at_standstill" 1 "Active_at_speed" 0 "Inactive" ;
VAL_TABLE_ OpenPressedFault 3 "Fault" 2 "Unused" 1 "Pressed" 0 "Open" ;
VAL_TABLE_ LaHandsOff_D_Dsply 3 "Suppressed" 2 "Level2" 1 "Level1" 0 "HandsOn" ;
VAL_TABLE_ Avail_Unavail 1 "Unavailable" 0 "Available" ;
VAL_TABLE_ LaActvStats_D_Dsply 31 "Unused7" 30 "LA_Off" 29 "Unused5" 28 "Unused4" 27 "Unused3" 26 "Unused2" 25 "Unused1" 24 "InerveneLeft_InterveneRght" 23 "WarnLeft_InterveneRight" 22 "SuppressLeft_InterveneRght" 21 "AvailLeft_InterveneRhtt" 20 "NoLeft_InterveneRight" 19 "InterveneLeft_WarnRight" 18 "WarnLeft_WarnRight" 17 "SuppressLeft_WarnRight" 16 "AvailableLeft_WarnRight" 15 "NoLeft_WarnRight" 14 "InterveneLeft_SuppressRght" 13 "WarnLeft_SuppressRight" 12 "SuppressLeft_SuppressRight" 11 "AvailLeft_SuppressRight" 10 "NoLeft_SuppressRight" 9 "InterveneLeft_AvailRight" 8 "WarnLeft_AvailRight" 7 "SuppressLeft_AvailRight" 6 "AvailableLeft_AvailRight" 5 "NoLeft_AvailableRight" 4 "InterveneLeft_NoRight" 3 "WarnLeft_NoRight" 2 "SuppressLeft_NoRight" 1 "AvailableLeft_NoRight" 0 "NoLeft_NoRight" ;
VAL_TABLE_ AhbcHiBeam_D_Rq 3 "Deactivated_Unavailabl" 2 "Unused" 1 "Main_HighBeamRecommend" 0 "Dipped_LowBeamRecommend" ;
VAL_TABLE_ GrllShtrPos_D_Cmd 15 "Fully_Open" 14 "Position14" 13 "Position13" 12 "Position12" 11 "Position11" 10 "Position10" 9 "Position9" 8 "Position8" 7 "Position7" 6 "Position6" 5 "Position5" 4 "Position4" 3 "Position3" 2 "Position2" 1 "Position1" 0 "Fully_Closed" ;
VAL_TABLE_ LifeCycMde_D_Actl 3 "Transport" 2 "NotUsed" 1 "Factory" 0 "Normal" ;
VAL_TABLE_ TrnMsgTxt_D_Rq 15 "Message_15" 14 "Message_14" 13 "Message_13" 12 "Message_12" 11 "Message_11" 10 "Message_10" 9 "Message_9" 8 "Message_8" 7 "Message_7" 6 "Message_6" 5 "Message_5" 4 "Message_4" 3 "Message_3" 2 "Message_2" 1 "Message_1" 0 "NoMessage" ;
VAL_TABLE_ DieslPrtcRgen_D_Rq 7 "Unused_2" 6 "Unused_1" 5 "Full_Regen_2" 4 "Full_Regen_1" 3 "HeatUp_3" 2 "HeatUp_2" 1 "HeatUp_1" 0 "Normal_Mode_NoRegen" ;
VAL_TABLE_ ClimtHeat_D_Rq 7 "NotUsed4" 6 "NotUsed3" 5 "HtrCoreClntFlwOnly" 4 "PtcHtrTestMde" 3 "Defrost_Defog" 2 "FastTempPullDownHeatingReq" 1 "OpportunisticHeatingReq" 0 "NoHeatingRequest" ;
VAL_TABLE_ TrnNtrlTowCmd_D_Actl 3 "NotUsed" 2 "Neutral_Tow_Entry" 1 "Car_Wash_Mode" 0 "Normal_Mode" ;
VAL_TABLE_ TrnValidGear_D_Cnfm 3 "Accept" 2 "Reject" 1 "Internal_Request" 0 "No_Command" ;
VAL_TABLE_ TrnGear_D_RqPt 7 "Fault" 6 "NotUsed" 5 "Manual" 4 "Drive" 3 "Neutral" 2 "Reverse" 1 "Park" 0 "No_Gear" ;
VAL_TABLE_ TrnValidGearRq_D_Stat 3 "Valid_Request" 2 "Valid_Degraded_Request" 1 "Invalid_Request" 0 "No_Request" ;
VAL_TABLE_ NoData_Fault_3FE_3FF 1023 "Fault" 1022 "NoDataExists" ;
VAL_TABLE_ ClimtCool_D_Rq 7 "NotUsed4" 6 "NotUsed3" 5 "NotUsed2" 4 "ElACTestMde" 3 "Defrost_Defog" 2 "FastTempPullDownCoolReq" 1 "OpportunisticCoolingReq" 0 "NoCoolingRequest" ;
VAL_TABLE_ HtrnHvilOpen_B_Actl 1 "HVIL_is_Open" 0 "Normal_Operation" ;
VAL_TABLE_ EngTeHi_B_Actl 1 "EngineTempHigh" 0 "Normal" ;
VAL_TABLE_ EngFuelCutFull_B_Inhbt 1 "Inhibit_DFSO" 0 "Normal" ;
VAL_TABLE_ VehStrtStop_D_Rq 3 "NotUsed" 2 "Vehicle_Start_Request" 1 "Vehicle_Stop_Request" 0 "NoRequest" ;
VAL_TABLE_ HvacRec_D_RqMxBatt 15 "NotUsed5" 14 "NotUsed4" 13 "NotUsed3" 12 "NotUsed2" 11 "NotUsed1" 10 "No_Override" 9 "90Percent_RecircMax" 8 "80Percent_RecircMax" 7 "70Percent_RecircMax" 6 "60Percent_RecircMax" 5 "50Percent_RecircMax" 4 "40Percent_RecircMax" 3 "30Percent_RecircMax" 2 "20Percent_RecircMax" 1 "10Percent_RecircMax" 0 "0Percent_RecircFullOpen" ;
VAL_TABLE_ PrkBrkStatus 7 "GeneralFault_MaintenceMode" 6 "ECD_by_Brake_ECU_Active" 5 "EPB_Limphome_Active" 4 "Rear_Caliper_Open" 3 "RWU_By_EPB_Active" 2 "Rear_Caliper_Transition" 1 "Rear_Caliper_Closed" 0 "Not_Supported" ;
VAL_TABLE_ ElLoadCtl_D_Rq 7 "Unused3" 6 "Unused2" 5 "Unused1" 4 "HoldAllDrvrInvisibleLoads" 3 "StdDriverInvisibleLoadsOn" 2 "AllDriverInvisibleLoadsOn" 1 "All_Possible_Loads_Off" 0 "No_Request" ;
VAL_TABLE_ BattTracCool 3 "NotUsed" 2 "DCDC_Overtemperature" 1 "CoolingRequiredbyDCDC" 0 "NoCoolingRequiredbyDCDC" ;
VAL_TABLE_ Quality_Data 3 "OK" 2 "Not_Within_Specifications" 1 "Eval_In_Progress" 0 "Fault" ;
VAL_TABLE_ PwSrcULoFalt_D_Stat 3 "Fault_No_Output" 2 "Fault_Reduced_Output" 1 "Fault_NonSpecific" 0 "No_Fault" ;
VAL_TABLE_ DontCare_StartInhibit 1 "Start_Inhibit" 0 "Dont_Care" ;
VAL_TABLE_ BattULoChrg_D_Rq 3 "Low_Battery_Temperature" 2 "Charging_Requested" 1 "Chrg_Requested_HighCurrent" 0 "No_Request" ;
VAL_TABLE_ PwSysULoFalt_D_Stat 15 "Not_Used_6" 14 "LowBatterySOC" 13 "PSS_Shed2_Contin" 12 "Not_Used_4" 11 "Not_Used_3" 10 "Not_Used_2" 9 "BattMonitoringSensorFault" 8 "LowBattVoltDuringPwSrcOn" 7 "LowBatt2_PowerSaveMode" 6 "LowBatt1_Warning" 5 "Overvoltage" 4 "Fault_NoOutput" 3 "Fault_ReducedOutput" 2 "Fault_Nonspecific" 1 "Cluster_Proveout" 0 "No_Fault" ;
VAL_TABLE_ AccStopMde_D_Rq 3 "Stop_Mode_Active" 2 "EPBApplyOrBrakeReleaseWarn" 1 "Limit_Rolling_Speed" 0 "Stop_Mode_Not_Active" ;
VAL_TABLE_ Eng_D_Stat 3 "NotUsed" 2 "EngAutoStopped" 1 "EngOn" 0 "EngOff" ;
VAL_TABLE_ ElPw_D_Stat 7 "NotUsed_3" 6 "NotUsed_2" 5 "NotUsed_1" 4 "Fault_Limited" 3 "LV_Event_In_Progress" 2 "Not_Supported_Imminent" 1 "Supported" 0 "Not_Supported" ;
VAL_TABLE_ PwPckTq_D_Stat 3 "PwPckOn_TqAvailable" 2 "StartInPrgrss_TqNotAvail" 1 "PwPckOn_TqNotAvailable" 0 "PwPckOff_TqNotAvailable" ;
VAL_TABLE_ BattTracCool_D_Falt 3 "NotUsed" 2 "CoolSysPartialyOperational" 1 "Cooling_System_Faulted" 0 "Cooling_System_Operational" ;
VAL_TABLE_ Fault_FF 255 "Fault" ;
VAL_TABLE_ ElCmprOverTe_D_Stat 3 "OverTempStop" 2 "OverTempWarning" 1 "Normal" 0 "Undefined" ;
VAL_TABLE_ ElCmprUHi_D_Stat 3 "Overvoltage" 2 "Undervoltage" 1 "InRange" 0 "Undetermined" ;
VAL_TABLE_ ElCmpr_D_Stat 7 "Signal_Invalid" 6 "Comp_Off_ActlSpd_Abnormal" 5 "Comp_Off_TrgtSpd_OutRange" 4 "Comp_Shutdown" 3 "Comp_Stopped_Self_Protect" 2 "Comp_Degraded" 1 "Comp_On" 0 "Comp_Off" ;
VAL_TABLE_ Southern_Northern 3 "Fault" 2 "Northern" 1 "Southern" 0 "Invalid" ;
VAL_TABLE_ PsngrFrntDetct_D_Actl 3 "Unknown" 2 "Empty" 0 "Faulty" 1 "Occupied" ;
VAL_TABLE_ Inactive_Supported_NotSup 3 "Not_Used" 2 "Not_Supported" 1 "Supported" 0 "Inactive" ;
VAL_TABLE_ Normal_Mode1_2 3 "Undefined" 2 "Mode2" 1 "Mode1" 0 "Normal_Mode" ;
VAL_TABLE_ LaActvAvail 3 "LKA_LCA_LDW_Avail" 2 "LCA_LKA_Avail_LDW_Suppress" 1 "LCA_LKA_Suppress_LDW_Avail" 0 "LCA_LKA_LDW_Suppress" ;
VAL_TABLE_ LA_NotDenied 1 "LA_Denied" 0 "LA_Not_Denied" ;
VAL_TABLE_ HandsOn_Off 1 "Hands_Off" 0 "Hands_On" ;
VAL_TABLE_ Fault_3FF 1023 "Fault" ;
VAL_TABLE_ VedsEvnt_6 5 "Unused_3" 4 "Unused_2" 3 "Unused_1" 2 "NotBelted" 1 "Belted" 0 "NoEvent" 7 "Fault" 6 "NotSupported" ;
VAL_TABLE_ VedsEvnt_5 7 "Fault" 6 "NotSupported" 5 "Unused_3" 4 "Unused_2" 3 "Unused_1" 2 "ChildNotDetected" 1 "ChildDetected" 0 "NoEvent" ;
VAL_TABLE_ VedsEvnt_4 7 "Fault" 6 "NotSupported" 5 "Unused_3" 4 "Unused_2" 3 "Unused_1" 2 "NotDeployed" 1 "Deployed" 0 "NoEvent" ;
VAL_TABLE_ VedsEvnt_3 0 "NoEvent" 255 "Fault" 254 "NotSupported" ;
VAL_TABLE_ VedsEvnt_2 7 "Fault" 6 "NotSupported" 5 "Unused_3" 4 "Unused_2" 3 "Unused_1" 2 "Yes" 1 "No" 0 "NoEvent" ;
VAL_TABLE_ VedsEvnt_1 7 "Fault" 6 "NotSupported" 5 "Unused" 4 "Rolllover" 3 "Rear" 2 "Side" 1 "Frontal" 0 "NoEvent" ;
VAL_TABLE_ Fault_F 15 "Fault" ;
VAL_TABLE_ Fault_1F 31 "Fault" ;
VAL_TABLE_ TmsStatRqDsply 15 "Reserved4" 14 "Reserved3" 13 "Reserved2" 12 "Crawl_Mode_4LOW_Reqd" 11 "Economy_Mode_Select" 10 "ModeChangeNotAvailable" 9 "Terrain_Sys_Not_Avail" 8 "Terrain_System_Fault" 7 "Mode_Change_InProgress" 6 "Dynamics_Mode_Select" 5 "Rock_Crawl_Mode_Select" 4 "Sand_Mode_Select" 3 "Mud_Ruts_Mode_Select" 2 "Low_Mu_Mode_Select" 1 "Special_Modes_Off" 0 "No_Message" ;
VAL_TABLE_ LockInhibit 1 "Inhibit" 0 "No_Inhibit" ;
VAL_TABLE_ Temp_Units 2 "Fahrenheit" 1 "Celsius" 0 "Off" ;
VAL_TABLE_ DieslFuelBio_B_ActlDrv 1 "Biodiesel_User" 0 "Non_Biodiesel_User" ;
VAL_TABLE_ Invalid_FFF 4095 "Invalid" ;
VAL_TABLE_ Off_0x0 0 "Off" ;
VAL_TABLE_ ParkAid_Chime 15 "Zone15_Chime" 14 "Zone14_Chime" 13 "Zone13_Chime" 12 "Zone12_Chime" 11 "Zone11_Chime" 10 "Zone10_Chime" 9 "Zone9_Chime" 8 "Zone8_Chime" 7 "Zone7_Chime" 6 "Zone6_Chime" 5 "Zone5_Chime" 4 "Zone4_Chime" 3 "Zone3_Chime" 2 "Zone2_Chime" 1 "Zone1_Chime" 0 "No_Chime" ;
VAL_TABLE_ Shed_Feature_Group_ID 16 "PtcHeater" 30 "NotUsed_7" 29 "NotUsed_6" 28 "NotUsed_5" 27 "NotUsed_4" 26 "NotUsed_3" 25 "NotUsed_2" 24 "NotUsed_1" 23 "Dcac" 22 "UpFitter_6" 21 "UpFitter_5" 20 "UpFitter_4" 19 "UpFitter_3" 18 "UpFitter_2" 17 "UpFitter_1" 14 "HtdMirr" 13 "HvacRearBlwr_Third" 12 "HvacRearBlwr_Second" 11 "HvacRearBlwr_First" 31 "All LSHED1 Features" 10 "Htd_Windscrn" 9 "SpltHtdBcklight_HtdMirr" 8 "HtdBcklight_HtdMirr" 7 "HtdCoolSeat_FrtDriver" 6 "HtdCoolSeat_FrtPass" 5 "HtdCoolSeat_RearPass" 4 "HtdCoolSeat_RearDriver" 3 "SmartTrlrTowBattCharge" 2 "Htd_StrWhl" 1 "Htd_Washer_Fluid" 0 "No_LSHED1_Features" 15 "Engine_Coolant_Fan" ;
VAL_TABLE_ CoolantFanStepAct 31 "Unused7" 30 "Unused6" 29 "Unused5" 28 "Unused4" 27 "Unused3" 26 "Unused2" 25 "Unused1" 23 "Step23" 22 "Step22" 21 "Step21" 20 "Step20" 19 "Step19" 18 "Step18" 17 "Step17" 16 "Step16" 15 "Step15" 14 "Step14" 13 "Step13" 12 "Step12" 11 "Step11" 10 "Step10" 9 "Step9" 8 "Step8" 7 "Step7" 6 "Step6" 5 "Step5" 4 "Step4" 3 "Step3" 2 "Step2" 1 "Step1" 24 "Max_Fan_Speed_Req" 0 "Fan_Cmd_Off" ;
VAL_TABLE_ Null_Cancel 1 "Cancel" 0 "Null" ;
VAL_TABLE_ Null_Drive_EasyEntry 2 "Easy_Entry" 1 "Drive" 0 "Null" ;
VAL_TABLE_ Veh_Lock_Requestor 31 "Walk_Away_Locking" 30 "Remote_Park_Assist" 29 "DoorsOffToOn_Smart_Unlock" 28 "Rgtm_Shutlock_Switch" 27 "Boundary_Alert" 26 "Transit_Vehicle_Relock" 25 "Transit_Cargo_Relock" 24 "Transit_Ajar_Lock" 23 "Diagnostics" 22 "Console_Lock" 21 "Child_Lock" 20 "Double_Lock" 19 "Passive_Pasenger" 18 "Passive_Driver" 17 "Slam_Lock_Protect" 16 "SYNC" 15 "Passport" 14 "Passive_Smart_Unlock" 13 "Autorelock" 12 "RemoteStart" 0 "Null" 1 "Autolock" 11 "Smart_Unlock" 10 "Sliding_Door" 9 "Passive" 8 "Remote" 7 "Programming" 6 "Powerslide" 5 "Keypad" 4 "Key_Cylinder" 3 "Interior" 2 "Auto_Unlock" ;
VAL_TABLE_ EPAS_FAILURE 3 "SERVICE_POWER_STEERING_NOW" 2 "SERVICE_POWER_STEERING" 1 "POWER_STRG_ASSIST_FAULT" 0 "EPAS_OK_NO_MESSAGE" ;
VAL_TABLE_ Perimeter_Alarm_Mode 3 "Activated" 2 "Armed" 1 "Prearmed" 0 "Disarmed" ;
VAL_TABLE_ Invalid_FFFF 65535 "Invalid" ;
VAL_TABLE_ OilPressureWarning 1 "Low_Pressure_Lamp_On" 0 "Normal_Pressure_Lamp_Off" ;
VAL_TABLE_ MyKey_KeyTypeChangeReq 3 "Search_PE_BackupSlot" 2 "Clear_All_MyKeys" 1 "Request_New_MyKey" 0 "None" ;
VAL_TABLE_ MyKey_Key_Count 13 "Thirteen" 12 "Twelve" 11 "Eleven" 10 "Ten" 9 "Nine" 8 "Eight" 7 "Seven" 6 "Six" 5 "Five" 4 "Four" 3 "Three" 2 "Two" 1 "One" 0 "Zero" 15 "Invalid" 14 "Unlimited" ;
VAL_TABLE_ GearEngag_D_Actl 7 "Undefined" 6 "Fwd_Clutch_Fully_Engaged" 5 "Neutral_Idle" 4 "Disengaged_to_Neutral_Idle" 3 "Disengaged_to_Neutral_Park" 2 "Engagement_in_Progress" 1 "InitializeFwdClutchEngagmt" 0 "Park_Neutral" ;
VAL_TABLE_ Shed_Level_Req 7 "SHED3" 6 "Loads_On" 5 "SHED_ENG_OFF" 4 "SOON_ENG_OFF" 3 "SHED2_CONTIN" 2 "SHED2_TRANS" 1 "SHED1" 0 "NO_SHED" ;
VAL_TABLE_ BpedMove_D_Actl 3 "Unknown" 2 "DriverApplyingBrakePedal" 1 "NoAutonomousBrkPdlMovement" 0 "AutonomousBrkPedalMove" ;
VAL_TABLE_ Eastern_Western 0 "Invalid" 1 "Eastern" 2 "Western" 3 "Fault" ;
VAL_TABLE_ EATC_Temp_Digit3 2 "_5" 1 "_0" 0 "OFF" ;
VAL_TABLE_ EATC_Units 2 "Fahrenheit" 1 "Celsius" 0 "Off" ;
VAL_TABLE_ Invalid_1FF 511 "Invalid" ;
VAL_TABLE_ ChargeMode 7 "Undefined_2" 6 "Undefined_1" 5 "Battery_Identify" 4 "Battery_Refresh" 3 "SlowRegenAllowNoDischarge" 2 "Fast_Regen_Allowed" 1 "Slow_Regen_Allowed" 0 "Conventional_Charging" ;
VAL_TABLE_ Unknown_FFFE_Invalid_FFFF 65535 "Invalid" 65534 "Unknown" ;
VAL_TABLE_ eCallNotification 3 "Not_Used" 2 "Active" 1 "Normal" 0 "Not_Supported" ;
VAL_TABLE_ eCallConfirmation 7 "Unused_2" 6 "CallComplete_DTMF_Timeout" 5 "eCall_Configured_Off" 4 "Call_Unsuccessful" 3 "Call_Cancelled" 2 "Call_Completed" 1 "Call_In_Progress" 0 "Normal" ;
VAL_TABLE_ SAPPAngleControlStat5 1 "StrgColTorqueExceed_EAROn" 0 "ExternalSigContentOKforEAC" ;
VAL_TABLE_ Closed_Open_Active_Fault 3 "Fault" 2 "Active" 1 "Open" 0 "Closed" ;
VAL_TABLE_ SAPPAngleControlStat2 1 "Rel_ExtSteeringAngleReqx" 0 "NoRel_ExtSteeringAngleReqx" ;
VAL_TABLE_ SAPPAngleControlStat3 1 "EARactiveNoReverseEngage" 0 "ExternalSigContentOKforEAC" ;
VAL_TABLE_ RstrnImpactEvntStatus 7 "Invalid" 6 "Not_Used_4" 5 "Threshold_2_Exceeded" 4 "Not_Used_3" 3 "Threshold_1_Exceeded" 2 "Not_Used_2" 1 "Not_Used_1" 0 "Normal" ;
VAL_TABLE_ EDRTriggerEvntSync 1 "Threshold_Exceeded" 0 "Normal" ;
VAL_TABLE_ EngTeColdPrtct_D_Stats 3 "Engine_Warm_RdcPwr" 2 "OK_to_Drive" 1 "Engine_Warm_PlsWait" 0 "Normal_Operation" ;
VAL_TABLE_ HILL_DESC_MC 7 "Fault_Detected" 6 "Cooling_Down" 5 "Abort_Apply_Brakes" 4 "Active" 3 "Disabled" 2 "Enabled" 1 "Off_Road" 0 "Normal" ;
VAL_TABLE_ Closed_Ajar 1 "Ajar" 0 "Closed" ;
VAL_TABLE_ CADS_Autio_Mute 7 "Unknown" 6 "Attenuation_6" 5 "Attenuation_5" 4 "Attenuation_4" 3 "Attenuation_3" 2 "Attenuation_2" 1 "Attenuation_1" 0 "No_Attenuation_of_Audio" ;
VAL_TABLE_ Quality_Factor 3 "OK" 2 "Not_Within_Specifications" 1 "No_Data_Exists" 0 "Faulty" ;
VAL_TABLE_ Null_Day_Night 3 "NotUsed" 2 "Night" 1 "Day" 0 "Null" ;
VAL_TABLE_ Null_Flash_High 3 "NotUsed" 2 "High" 1 "Flash_to_Pass" 0 "Null" ;
VAL_TABLE_ GearPos_D_Actl 15 "Unknown" 14 "Reverse" 13 "Undefined_5" 12 "Undefined_4" 11 "Undefined_3" 10 "Tenth" 9 "Ninth" 8 "Eighth" 7 "Seventh" 6 "Sixth" 5 "Fifth" 4 "Fourth" 3 "Third" 2 "Second" 1 "First" 0 "Neutral" ;
VAL_TABLE_ OffOn_SlowFast_Flash 3 "Fast_Flash" 2 "Slow_Flash" 1 "On" 0 "Off" ;
VAL_TABLE_ AwdStat_D_RqDsply 31 "Rear_Diff_Lock_Not_Avail" 30 "_4wd_Lock_Required" 29 "Cfg_Perf_Redc_See_Manual" 28 "To_Engage_4x4_Release_Aped" 27 "To_Engage_4x4_Slow_To_3MPH" 26 "Shift_To_Neutral" 25 "Lkr_Mode_Unavail_TMS" 24 " _4x4_Mode_Unavail_TMS" 23 "Out_of_4Low_Crawl" 22 "AWD_PTU_Oil_Changed" 21 "Change_AWD_PTU_Oil" 20 "Neutral_Tow_Disabled" 19 "Neutral_Tow_Enabled" 18 "AWD_OFF" 17 "_4x4_Off_Road_Speed" 16 "_4x4_Extreme_Off_Road_Mode" 15 "_4x4_Exiting_Off_Road" 14 "_4x4_Off_Road_Mode" 10 "_4x4_Locked_Temporarily" 9 "Shift_In_Progress" 13 "Blocked_Shift_Assist" 12 "_4x4_Auto_Restored" 11 "_4x4_Disabled_Temporarily" 7 "Out_of_4Low__Neutral" 6 "Out_of_4Low__Brake" 5 "Out_of_4Low__Speed" 4 "Into_4Low__Clutch" 3 "Into_4Low__Neutral" 2 "Into_4Low__Brake" 1 "Into_4Low__Speed" 0 "Normal__No_Message" 8 "Out_of_4Low__Clutch" ;
VAL_TABLE_ AngleReached 1 "RequestedAngleNotReached" 0 "RequestedAngleCanBeReached" ;
VAL_TABLE_ WhlDir 3 "Faulty" 2 "NoDataExists" 1 "Backward" 0 "Forward" ;
VAL_TABLE_ VehVLimStat_D_Actl 7 "Undefined_3" 6 "Undefined_2" 5 "Undefined_1" 4 "ASL_Fault_Condition" 3 "Active_and_Limiting" 2 "Active_but_Not_Limiting" 1 "Standby" 0 "Off" ;
VAL_TABLE_ Unknown_Fault_1FE_1FF 511 "Fault" 510 "Unknown" ;
VAL_TABLE_ Fault_NoFault 1 "Fault" 0 "No_Fault" ;
VAL_TABLE_ TrnIpcDsplyMde_D_Actl 7 "Manual_3" 6 "Manual_2" 5 "Manual_1_Low" 4 "Sport" 3 "Drive" 2 "Neutral" 1 "Reverse" 0 "Park" ;
VAL_TABLE_ TrnIpcDsplyMde_D_Stat 3 "Reserved_Blank_No_Display" 2 "Flash" 1 "On" 0 "Blank_No_Display" ;
VAL_TABLE_ TrnIpcDsplyGear_D_Actl 15 "No_Gear_Selected" 14 "_14th_Gear" 13 "_13th_Gear" 12 "_12th_Gear" 11 "_11th_Gear" 10 "_10th_Gear" 9 "_9th_Gear" 8 "_8th_Gear" 7 "_7th_Gear" 6 "_6th_Gear" 5 "_5th_Gear" 4 "_4th_Gear" 3 "_3rd_Gear" 2 "_2nd_Gear" 1 "_1st_Gear" 0 "Neutral" ;
VAL_TABLE_ TerrMde_D_Actl 7 "Fail_Safe_Default" 6 "Dynamic_Mode" 5 "Rock_Crawl_Mode" 4 "Mud_Ruts_Mode" 3 "Sand_Mode" 2 "Undefined" 1 "Low_Mu_Mode" 0 "Special_Operating_Mode_Off" ;
VAL_TABLE_ TerrMdeChng_D_Rdy 7 "Fault" 6 "Undefined_2" 5 "Undefined_1" 4 "ModeUnavailDrInputRqd" 3 "SpOpModes_NotSupported" 2 "ModeUnavailDynamicCond" 1 "Module_In_Initialization" 0 "Mode_Change_Available" ;
VAL_TABLE_ Unknown_Fault_FFFE_FFFF 65535 "Fault" 65534 "Unknown" ;
VAL_TABLE_ Invalid_FFFFFF 16777215 "Invalid" ;
VAL_TABLE_ AutoParkSpdExitCond 1 "SpeedLimitExceededEAROn" 0 "ExternalSigContentOKforEAC" ;
VAL_TABLE_ EngOilLvlDsply_D_Rq 15 "EngOil_LevelSys_CheckFault" 14 "Reserved_2" 13 "Reserved_1" 12 "Conditions_Unsuitable" 11 "Dipstick_Below_Minimum" 10 "Dipstick_Above_Maximum" 9 "Dipstick_Minimum" 8 "Dipstick_12_5_MinMaxRange" 7 "Dipstick_25_MinMaxRange" 6 "Dipstick_37_5_MinMaxRange" 5 "Dipstick_50_MinMaxRange" 4 "Dipstick_62_5_MinMaxRange" 3 "Dipstick_75_MinMaxRange" 2 "Dipstick_87_5_MinMaxRange" 1 "Dipstick_Maximum_Displayed" 0 "No_Message" ;
VAL_TABLE_ HdcMde_D_Actl 7 "Fault" 6 "Temporarily_Unavailable" 5 "NotEnabled_WrongGearSel" 4 "NotEnabled_SpdLimitExceed" 3 "Active_Braking" 2 "Not_Active_Braking" 1 "Off" 0 "Undefined" ;
VAL_TABLE_ GearLvrPos_D_Actl 15 "Fault" 14 "Unknown_Position" 13 "Undefined_Treat_as__Fault" 12 "Undefined_Treat_as_Fault" 11 "sixth" 10 "fifth" 9 "fourth" 8 "third" 7 "second" 6 "first" 5 "Low" 4 "Sport_DriveSport" 3 "Drive" 2 "Neutral" 1 "Reverse" 0 "Park" ;
VAL_TABLE_ FcwMsgTxt_D_Rq 7 "Undefined_3" 6 "Undefined_2" 5 "Low_Visibility" 4 "Unavailable_DueTo_LowSpeed" 3 "Available" 2 "Unavailable" 1 "Off" 0 "No_Text" ;
VAL_TABLE_ FcwSens_B_Actl 3 "FCW_Sensitivity_3" 2 "FCW_Sensitivity_2" 1 "FCW_Sensitivity_1" 0 "Not_Used" ;
VAL_TABLE_ EngTurboMde_D_Actl 3 "Fault" 2 "One_Turbo_Active" 1 "Two_Turbos_Active" 0 "Initializing" ;
VAL_TABLE_ DrvHdcMsg_D_Rq 7 "Undefined" 6 "Speed_too_High" 5 "Temporarily_Unavailable" 4 "System_Fault" 3 "Select_Gear" 2 "Off" 1 "On" 0 "No_Message" ;
VAL_TABLE_ CcStat_D_Actl 7 "Undefined_2" 6 "Undefined_1" 5 "Active" 4 "Active_Que_Assist" 3 "Standby" 2 "Standby_Denied" 1 "Denied" 0 "Off" ;
VAL_TABLE_ BpedDrvAppl_D_Actl 3 "_Not_Allowed" 2 "Driver_Braking" 1 "Driver_Not_Braking" 0 "Not_Allowed" ;
VAL_TABLE_ AslIconDsply_D_Rq 3 "On_Passive_Overridden" 2 "On_Active" 1 "On_Passive" 0 "Off" ;
VAL_TABLE_ Unknown_Fault_3E_3F 63 "Fault" 62 "Unknown" ;
VAL_TABLE_ AccWarn_D_Dsply 3 "BrakeReleaseWarn_In_StopMd" 2 "Brake_Capacity_Warning" 1 "Cancel_Warning" 0 "No_Warning" ;
VAL_TABLE_ AccTrgDist2_D_Dsply 15 "DIST_ACTIVE_13_Farthest" 14 "DIST_ACTIVE_12" 13 "DIST_ACTIVE_11" 12 "DIST_ACTIVE_10" 11 "DIST_ACTIVE_9" 10 "DIST_ACTIVE_8" 9 "DIST_ACTIVE_7" 8 "DIST_ACTIVE_6" 7 "DIST_ACTIVE_5" 6 "DIST_ACTIVE_4" 5 "DIST_ACTIVE_3" 4 "DIST_ACTIVE_2" 3 "DIST_ACTIVE_1_Closest" 2 "DIST_ACTIVE_No_Target" 1 "DIST_STANDBY" 0 "DIST_OFF" ;
VAL_TABLE_ AccTGap_D_Dsply 7 "Undefined_2" 6 "Undefined_1" 5 "Time_Gap_5" 4 "Time_Gap_4" 3 "Time_Gap_3" 2 "Time_Gap_2" 1 "Time_Gap_1" 0 "Not_Used" ;
VAL_TABLE_ AccEngStat_D_Actl 7 "Undefined_2" 6 "Undefined_1" 5 "ACCSoonCancel_due_Low_Spd" 4 "Shift_Down_Recommendation" 3 "Shift_Up_Recommendation" 2 "ACCNotAllowedToBeActivated" 1 "ACCStandby_due_Auto_Cancel" 0 "Normal_Operation" ;
VAL_TABLE_ NotPressed_Pressed 1 "Pressed" 0 "Not_Pressed" ;
VAL_TABLE_ TrnGear_D_RqDrv 31 "Fault" 30 "NotUsed_25" 29 "NotUsed_24" 28 "NotUsed_23" 27 "NotUsed_22" 26 "NotUsed_21" 25 "NotUsed_20" 24 "NotUsed_19" 23 "NotUsed_18" 22 "NotUsed_17" 21 "Return_To_Park" 20 "NotUsed_15" 19 "NotUsed_14" 18 "NotUsed_13" 17 "NotUsed_12" 16 "Manual" 15 "Not_Used11" 14 "Not_Used10" 13 "NotUsed_9" 12 "NotUsed_8" 11 "NotUsed_7" 10 "NotUsed_6" 9 "NotUsed_5" 8 "Drive" 7 "NotUsed_4" 6 "NotUsed_3" 5 "NotUsed_2" 4 "Neutral" 3 "NotUsed_1" 2 "Reverse" 1 "Park" 0 "No_Gear" ;
VAL_TABLE_ Open_Close 1 "Close" 0 "Open" ;
VAL_TABLE_ DasWarn 3 "Undefined" 2 "Warning_Level_2" 1 "Warning_Level_1" 0 "No_Warning" ;
VAL_TABLE_ DasAlert 5 "Alertness_Level_5" 4 "Alertness_Level_4" 3 "Alertness_Level_3" 2 "Alertness_Level_2" 1 "Alertness_Level_1" 0 "Undefined" ;
VAL_TABLE_ DasStat 3 "Available" 2 "Unavailable_Other" 1 "Feedback_due_to_Speed" 0 "Off" ;
VAL_TABLE_ No_Crank_Req 1 "Crank_Request" 0 "No_Crank_Request" ;
VAL_TABLE_ DrvSlipCtlMde_D_Rq 3 "App_Specific_Off_Mode_3" 2 "App_Specific_Off_Mode_2" 1 "App_Specific_Off_Mode_1" 0 "Default_Mode" ;
VAL_TABLE_ AwdOffRoadMode 3 "Invalid" 2 "Extreme_Off_Road" 1 "Off_Road" 0 "Normal_Mode" ;
VAL_TABLE_ NotQuiet_Quiet 1 "Quiet" 0 "Not_Quiet" ;
VAL_TABLE_ Normal_AdaptiveCruise 1 "Adaptive_Cruise" 0 "Normal_Cruise" ;
VAL_TABLE_ Remote_Device_Feedback 7 "Unused3" 6 "Unused2" 5 "Unused1" 4 "Shutdown" 3 "Running" 2 "Starting" 1 "Acknowledge" 0 "Null" ;
VAL_TABLE_ TrnManShif_D_IndDrv 7 "Undefined_3" 6 "Undefined_2" 5 "Shift_to_Neutral" 4 "Downshift_Recommendation" 3 "Upshift_Warning" 2 "Upshift_Performance" 1 "Upshift_Fuel_Economy" 0 "No_Indication" ;
VAL_TABLE_ Unlock_Lock 1 "Locked" 0 "Unlock" ;
VAL_TABLE_ DieslPrtc_D_RqDsply 7 "Unused_2" 6 "Unused_1" 5 "DPF_SOOT_Level3_Blocked" 4 "DPFSootLvl2_SevereOverload" 3 "DPFRegen_ExhFilterComplete" 2 "DPFRegen_CleanExhFilter" 1 "DPF_Soot_Level1_Overloaded" 0 "DPF_OK_Normal_Operation" ;
VAL_TABLE_ PE_BackupSlot_Status 3 "No_Valid_FOB_In_Slot" 2 "MyKey_FOB_In_Slot" 1 "Standard_FOB_In_Slot" 0 "Null" ;
VAL_TABLE_ Unknown_Fault_FFE_FFF 4095 "Fault" 4094 "Unknown" ;
VAL_TABLE_ Unknown_Fault_1FFE_1FFF 8191 "Fault" 8190 "Unknown" ;
VAL_TABLE_ TrnCnvtClu_D_Actl 3 "Transition_or_Micro_Slip" 2 "Lock_Up_Fixed" 1 "Lock_Up_Slip" 0 "No_Lock_Up" ;
VAL_TABLE_ InhibitNoinhibit 1 "Inhibit" 0 "No_Inibit" ;
VAL_TABLE_ DisableEnable 1 "Enable" 0 "Disable" ;
VAL_TABLE_ Unknown_Fault_7FFE_7FFF 32767 "Fault" 32766 "Unknown" ;
VAL_TABLE_ Side_Detect_Sn_State 3 "Second_Warning_Audio" 2 "System_Failure" 1 "Blocked" 0 "Clear" ;
VAL_TABLE_ Litval_values 255 "Invalid" 254 "Unknown" 5 "Day" 4 "Twilight_4" 3 "Twilight_3" 2 "Twilight_2" 1 "Twilight_1" 0 "Night" ;
VAL_TABLE_ Dimming_Lvl 255 "Invalid" 254 "Unknown" 18 "Day_6" 17 "Day_5" 16 "Day_4" 15 "Day_3" 14 "Day_2" 13 "Day_1" 12 "Night_12" 11 "Night_11" 10 "Night_10" 9 "Night_9" 8 "Night_8" 7 "Night_7" 6 "Night_6" 5 "Night_5" 4 "Night_4" 3 "Night_3" 2 "Night_2" 1 "Night_1" 0 "Off" ;
VAL_TABLE_ NotOperating 1 "Operating" 0 "Not_Operating" ;
VAL_TABLE_ CamraStat 3 "FrtCam_TempUnavailOther" 2 "FrtCam_TempUnavailVisibile" 1 "Front_Camera_Service_Reqd" 0 "Front_Camera_OK" ;
VAL_TABLE_ EngPtoMde_D_Actl 7 "Undefined" 6 "Split_Shaft_Stationary" 5 "Not_Used_2" 4 "PTO_Mobile" 3 "Not_Used_1" 2 "PTO_Stationary" 1 "BCP" 0 "Off" ;
VAL_TABLE_ ManRgen_D_Rq 3 "NotUsed2" 2 "NotUsed1" 1 "CustInitManExhFilterClean" 0 "No_Customer_Request" ;
VAL_TABLE_ Remote_Start_Status 3 "Invalid" 2 "Unknown" 1 "Remote" 0 "Null" ;
VAL_TABLE_ Enabled_Active_Disabled 3 "Unused" 2 "Disabled" 1 "Active" 0 "Enabled_Inactive" ;
VAL_TABLE_ Lock_Subld 15 "Unused7" 14 "Unused6" 13 "Unused5" 12 "Unused4" 11 "Unused3" 10 "Unused2" 9 "Unused1" 8 "Customer_8" 7 "Customer_7" 6 "Customer_6" 5 "Customer_5" 4 "Customer_4" 3 "Customer_3" 2 "Customer_2" 1 "Customer_1" 0 "Null" ;
VAL_TABLE_ Brake_Fluid 3 "Invalid" 2 "Unknown" 1 "Low" 0 "OK" ;
VAL_TABLE_ Unknown_Invalid_FE_FF 255 "Invalid" 254 "Unknown" ;
VAL_TABLE_ Invalid_FF 255 "Invalid" ;
VAL_TABLE_ NotLow_Low 1 "Low" 0 "Not_Low" ;
VAL_TABLE_ Disabled_Enabled_Status 2 "Status" 3 "NotUsed" 1 "Enabled" 0 "Disabled" ;
VAL_TABLE_ Key_In_Ignition_Status 1 "In" 0 "Out" ;
VAL_TABLE_ Ignition_Status 0 "Unknown" 1 "Off" 15 "Invalid" 8 "Start" 4 "Run" 2 "Accessory" ;
VAL_TABLE_ Disabled_Enabled_Faulted 3 "Faulted" 2 "Unused" 1 "Enabled" 0 "Disabled" ;
VAL_TABLE_ Disabled_Enabled_NoSupport 2 "Unused" 3 "Not_Supported" 1 "Enabled" 0 "Disabled" ;
VAL_TABLE_ Unknown_Fault_FE_FF 255 "Fault" 254 "Unknown" ;
VAL_TABLE_ Null_Unlock 1 "Unlock" 0 "Null" ;
VAL_TABLE_ Null_Active 1 "Active" 0 "Null" ;
VAL_TABLE_ MemoryCmd 7 "Recall_3" 4 "Store_4" 3 "Store_3" 6 "Recall_2" 5 "Recall_1" 2 "Store_2" 1 "Store_1" 0 "Null" 8 "Recall_4" ;
VAL_TABLE_ HsaStat_D_Actl 7 "Faulty" 6 "FaultyWithDriverIndication" 5 "SlowRelease" 4 "FastRelease" 3 "ActiveBrakePedalReleased" 2 "ActiveBrakePedalPressed" 1 "FindingGradient" 0 "Inactive" ;
VAL_TABLE_ Off_Auto_Manual 3 "Undefined" 2 "Manual" 1 "Automatic" 0 "Off" ;
VAL_TABLE_ HsaStat_D_Dsply 7 "NotUsed3" 6 "NotUsed2" 5 "NotUsed1" 4 "NotAvailable" 3 "SlowReleaseWithChime" 2 "SlowReleaseWithoutChime" 1 "Active" 0 "Inactive" ;
VAL_TABLE_ EngMsgTxt_D_Rq 3 "Undefined_2" 2 "Undefined_1" 1 "Power_Reduced_to_LowerTemp" 0 "No_Message" ;
VAL_TABLE_ PassRstrnInd_Stat 7 "Invalid" 6 "Unused_2" 5 "Unused_1" 4 "Both_Indicators_Faulted" 3 "AirbagOff_Indicator_fault" 2 "AirbagOn_Indicator_fault" 1 "Normal" 0 "Not_Supported" ;
VAL_TABLE_ PassRstrnInd_Req 3 "ABOnNotIllum_OffNotIllum" 2 "AirbagOnNot_Illum_OffIllum" 1 "AirbagOn_Illum_OffNotIllum" 0 "AirbagOn_Illum_Off_Illum" ;
VAL_TABLE_ RearDiffLckMsg_D_Rq 7 "Locker_Disabled" 6 "Locker_Enabled" 5 "Locker_Accel_Pedal" 4 "Speed4" 3 "Speed3" 2 "Spee2" 1 "Speed1" 0 "Normal__No_Message " ;
VAL_TABLE_ GPS_dimension 2 "_3D" 1 "_2D" 0 "No_Fix" ;
VAL_TABLE_ GPS_Compass_dirctn 7 "NorthWest" 6 "West" 5 "SouthWest" 4 "South" 3 "SouthEast" 2 "East" 1 "NorthEast" 0 "North" ;
VAL_TABLE_ GPS_Actual_Infer 1 "Inferred_Position" 0 "Actual_Postition" ;
VAL_TABLE_ DrvHdcWarnInfo_D_Rq 3 "Undefined" 2 "Lamp_On_Continuously" 1 "Lamp_Flashing" 0 "Lamp_Off_Continuously" ;
VAL_TABLE_ DieslPrtcRgen_D_Actl 3 "Undefined" 2 "Regen_Level_2" 1 "Regen_Level_1" 0 "No_regen" ;
VAL_TABLE_ Off_On 1 "On" 0 "Off" ;
VAL_TABLE_ CcMde_D_Actl 7 "TapDownWaiting" 6 "TapUpWaiting" 5 "Resuming_Low" 4 "Resuming_High" 3 "Decelerating" 2 "Accelerating" 1 "Keeping_Speed" 0 "Not_Active" ;
VAL_TABLE_ InactiveActive 1 "Active" 0 "Inactive" ;
VAL_TABLE_ ManRgenTxt_D_RqDsply 7 "NotUsed3" 6 "NotUsed2" 5 "NotUsed1" 4 "Cleaning_Aborted_Stopped" 3 "Cleaning_Completed" 2 "Cleaning_In_Progress" 1 "Cleaning_Allowed" 0 "Cleaning_Not_Allowed" ;
VAL_TABLE_ Fault_FFFF 65535 "Fault" ;
VAL_TABLE_ Fault_7F 127 "Fault" ;
VAL_TABLE_ EngOilLvlWarn_D_Rq 7 "Undefined_3" 6 "Undefined_2" 5 "Engine_Oil_Monitor_Fault" 3 "Engine_Oil_High" 2 "Engine_Oil_Critical_Low" 1 "Engine_Oil_Low" 0 "No_Message" 4 "Engine_Oil_Critical_High" ;
VAL_TABLE_ UreaQltySys_D_RqDsply 7 "Undefined" 6 "ZZ_Overrides" 5 "EngineIdled" 4 "Engine_Idle_Upon_Refuel" 3 "SPEED_LIMITED_to_YY_mph" 2 "YY_MPH_MAX_UPON_Restart" 1 "CONTAMINATED_ExhFluid" 0 "NoQualityProblem" ;
VAL_TABLE_ Unknown_Invalid_1E_1F 31 "Invalid" 30 "Unknown" ;
VAL_TABLE_ Unknown_Invalid_3FFE_3FFF 16383 "Invalid" 16382 "Unknown" ;
VAL_TABLE_ NoYes 1 "Yes" 0 "No" ;
BA_DEF_ BO_  "FrameRouting" STRING ;
BA_DEF_ BO_  "NetworkInitialization" ENUM  "No","Yes";
BA_DEF_ BO_  "GenMsgStartDelayTime" INT 0 10000;
BA_DEF_ BO_  "GenMsgNrOfRepetition" INT 0 100;
BA_DEF_ BO_  "GenMsgDelayTime" INT 0 1000;
BA_DEF_ BO_  "GenMsgCycleTime" INT 0 100000;
BA_DEF_ BO_  "GenMsgSendType" ENUM  "FixedPeriodic","Event","EnabledPeriodic","NotUsed","NotUsed","EventPeriodic","NotUsed","NotUsed","NoMsgSendType";
BA_DEF_ SG_  "U_V710_MY2023_Tx" ENUM  "No","Yes";
BA_DEF_ SG_  "U_P708_MY2023_Tx" ENUM  "No","Yes";
BA_DEF_ SG_  "U_V713AV_MY2022_Tx" ENUM  "No","Yes";
BA_DEF_ SG_  "U_V713N_MY2022_Tx" ENUM  "No","Yes";
BA_DEF_ SG_  "ECGUsedTxSignal" ENUM  "No","Yes";
BA_DEF_ SG_  "U_V710_MY2023_Rx" ENUM  "No","Yes";
BA_DEF_ SG_  "U_P708_MY2023_Rx" ENUM  "No","Yes";
BA_DEF_ SG_  "U_V713AV_MY2022_Rx" ENUM  "No","Yes";
BA_DEF_ SG_  "U_V713N_MY2022_Rx" ENUM  "No","Yes";
BA_DEF_ SG_  "ECGUsedRxSignal" ENUM  "No","Yes";
BA_DEF_ SG_  "UsedOnPgmDBC" ENUM  "No","Yes";
BA_DEF_ SG_  "ContentDependant" ENUM  "No","Yes";
BA_DEF_ SG_  "GenSigStartValue" HEX 0 268435455;
BA_DEF_ SG_  "MetaData" ENUM  "No","Yes";
BA_DEF_ SG_  "WakeupSignal" ENUM  "No","Yes";
BA_DEF_ SG_  "GenSigInactiveValue" INT 0 100000;
BA_DEF_ SG_  "GenSigSendType" ENUM  "Cyclic","OnWrite","vector_leerstring","OnChange","vector_leerstring","IfActive","vector_leerstring","NoSigSendType";
BA_DEF_ BO_  "TpTxIndex" INT 0 536870911;
BA_DEF_ BO_  "OvtpPushApplication" ENUM  "FALSE","TRUE";
BA_DEF_ BO_  "SCP_FreshnessValueLength" INT 0 512;
BA_DEF_ BO_  "SCP_DataId" INT 0 17663;
BA_DEF_ BO_  "SCP_FreshnessValueTxLength" INT 0 512;
BA_DEF_ BO_  "SCP_AuthInfoTxLength" INT 0 512;
BA_DEF_ BO_  "SC_Message" ENUM  "No","Yes";
BA_DEF_ BO_  "GenMsgRoutingTimeoutTime" INT 0 5000;
BA_DEF_ BO_  "MessageGateway" ENUM  "No","Yes";
BA_DEF_ BO_  "NmAsrMessage" ENUM  "No","Yes";
BA_DEF_ BO_  "DiagState" ENUM  "No","Yes";
BA_DEF_ BO_  "DiagRequest" ENUM  "No","Yes";
BA_DEF_ BO_  "DiagResponse" ENUM  "No","Yes";
BA_DEF_ BO_  "GenMsgILSupport" ENUM  "No","Yes";
BA_DEF_DEF_  "FrameRouting" "";
BA_DEF_DEF_  "NetworkInitialization" "Yes";
BA_DEF_DEF_  "GenMsgStartDelayTime" 0;
BA_DEF_DEF_  "GenMsgNrOfRepetition" 1;
BA_DEF_DEF_  "GenMsgDelayTime" 20;
BA_DEF_DEF_  "GenMsgCycleTime" 0;
BA_DEF_DEF_  "GenMsgSendType" "NoMsgSendType";
BA_DEF_DEF_  "U_V710_MY2023_Tx" "No";
BA_DEF_DEF_  "U_P708_MY2023_Tx" "No";
BA_DEF_DEF_  "U_V713AV_MY2022_Tx" "No";
BA_DEF_DEF_  "U_V713N_MY2022_Tx" "No";
BA_DEF_DEF_  "ECGUsedTxSignal" "No";
BA_DEF_DEF_  "U_V710_MY2023_Rx" "No";
BA_DEF_DEF_  "U_P708_MY2023_Rx" "No";
BA_DEF_DEF_  "U_V713AV_MY2022_Rx" "No";
BA_DEF_DEF_  "U_V713N_MY2022_Rx" "No";
BA_DEF_DEF_  "ECGUsedRxSignal" "No";
BA_DEF_DEF_  "UsedOnPgmDBC" "Yes";
BA_DEF_DEF_  "ContentDependant" "No";
BA_DEF_DEF_  "GenSigStartValue" 0;
BA_DEF_DEF_  "MetaData" "No";
BA_DEF_DEF_  "WakeupSignal" "No";
BA_DEF_DEF_  "GenSigInactiveValue" 0;
BA_DEF_DEF_  "GenSigSendType" "NoSigSendType";
BA_DEF_DEF_  "TpTxIndex" 0;
BA_DEF_DEF_  "OvtpPushApplication" "FALSE";
BA_DEF_DEF_  "SCP_FreshnessValueLength" 64;
BA_DEF_DEF_  "SCP_DataId" 0;
BA_DEF_DEF_  "SCP_FreshnessValueTxLength" 11;
BA_DEF_DEF_  "SCP_AuthInfoTxLength" 53;
BA_DEF_DEF_  "SC_Message" "No";
BA_DEF_DEF_  "GenMsgRoutingTimeoutTime" 0;
BA_DEF_DEF_  "MessageGateway" "No";
BA_DEF_DEF_  "NmAsrMessage" "No";
BA_DEF_DEF_  "DiagState" "No";
BA_DEF_DEF_  "DiagRequest" "No";
BA_DEF_DEF_  "DiagResponse" "No";
BA_DEF_DEF_  "GenMsgILSupport" "Yes";
