/* LIN description file */
/* B2yy/C34x/B232/B299MCA DSPL/ICP LIN connection (R1-R3 were for B2yy only)*/
/* hand-coded version -- this is the master!*/
/* FoE/EESE/EI/FI-MUX/Martin Ostermann (R1-R5)*/
/* FoE/EESE/EI/FI-MUX/Horst Wickinghoff (from R6 onwards)*/
/* FoE/EESE/EI/FI-MUX/Matthias Ley/ Christian Grossmann (draft SAEJ2602-implementation)*/
/* FoE/EESE/EI/FI-MUX/Matthias Ley/ Christian Grossmann (changes in Dimm Level Signals)*/
/* FoE/EESE/EI/FI-MUX/Matthias Ley/ Christian Grossmann (changes in Dimm Zone bitfield encoding remarks)*/
/* FoE/EESE/EI/FI-MUX/Matthias Ley/ Christian Grossmann (changes in Button ID encoding remarks)*/
/* FoE/EESE/EI/FI-MUX/Matthias Ley/ Christian Grossmann (added Signals and Frame for ICP Serial number transfer)*/
/* R1 2006-08-04 */
/* R2 2006-10-20 */
/* R3 2006-07-25 */
/* R4 2008-04-01 */
/* R5 2009-06-25 */
/* R6 2011-08-25 */
/* R7 2013-03-15 */
/* R001 2014-10-24 */
/* R003 2014-12-10 */
/* FoE/EESE/EI/FI-MUX/Matthias Ley/ Christian Grossmann rorderdered ICPStatusID,ICPStatusValue,ICPLINStatus, to better conform to SAE J2602 spec*/
/* R003 2015-01-08 */
/* FoE/EESE/EI/FI-MUX/Matthias Ley changed init values for ICPBtnID_[A-D] signals to 255, which correlates to 'idle' */
/* R005 2015-02-10 */
/* FoE/EESE/EI/FI-MUX/Matthias Ley/ Christian Grossmann redesign of APINFO bits / replacement for ICPStatusID and ICPStatusValue to better conform to SAE J2602 spec*/
/* R005_Draft 2015-03-23 */
/* R007 Release with added schedules for Master Request Frame and Slave Response Frame in acc. with Supplier Proposal*/
/* R007 Release on 20150910 */
/* R008-Draft with encoding type ICPSrNrDigit_EnCodingType error corrected ( value range now 0-15 ilo 0-16) */
/* R008 with encoding type ICPBtnID_EncodingType added value 110 ICPBtnID_Camera */
/* R008 Release on 20160506 */
/* R009 Revised Value in documentation of DSPLIlluZone_EncodingType: Value $20 was 'reserved' changed to 'Chrome'*/
/* R009 Revised File Name for Cross Carline usage was '201xB479_DSPL_LIN_SAEJ2602_R009' */
/* R009 Released 20170801 */
/* R010 added button ID for calm screen and driver assist for CD542 */
/* R010 Released 20190923 */

LIN_description_file;
LIN_protocol_version = "J2602_1_1.0";
LIN_language_version = "J2602_3_1.0";
LIN_speed = 10.417 kbps;

Nodes {
  Master: DSPL, 3 ms, 0.5 ms, 40 bits, 20 %;
  Slaves: ICP, sunroof ;
}

Signals {
  ICP_APINFO_0: 1, 0, ICP, DSPL ;
  ICP_APINFO_1: 1, 0, ICP, DSPL ;
  ICP_APINFO_2: 1, 0, ICP, DSPL ;
  ICP_APINFO_3: 1, 0, ICP, DSPL ;
  ICP_APINFO_4: 1, 0, ICP, DSPL ;
  ICPBtnCoding_A: 4, 0, ICP, DSPL ;
  ICPBtnCoding_B: 4, 0, ICP, DSPL ;
  ICPBtnCoding_C: 4, 0, ICP, DSPL ;
  ICPBtnCoding_D: 4, 0, ICP, DSPL ;
  ICPLINStatus: 3, 0, ICP, DSPL ;
  ICPRotaryCmd: 4, 7, ICP, DSPL ;
  ICPVolumeCmd: 8, 30, ICP, DSPL ;
  ICPVolumeCmd2: 4, 7, ICP, DSPL ;
  ICPBtnID_A: 8, 255, ICP, DSPL ;
  ICPBtnID_B: 8, 255, ICP, DSPL ;
  ICPBtnID_C: 8, 255, ICP, DSPL ;
  ICPBtnID_D: 8, 255, ICP, DSPL ;
  ICPPartNumIndex: 8, 0, ICP, DSPL ;
  ICPPartNumData0: 8, 0, ICP, DSPL ;
  ICPPartNumData1: 8, 0, ICP, DSPL ;
  ICPPartNumData2: 8, 0, ICP, DSPL ;
  ICPPartNumData3: 8, 0, ICP, DSPL ;
  ICPPartNumData4: 8, 0, ICP, DSPL ;
  ICPPartNumData5: 8, 0, ICP, DSPL ;
  ICPSrNrDigit00: 4, 0, ICP, DSPL ;
  ICPSrNrDigit01: 4, 0, ICP, DSPL ;
  ICPSrNrDigit02: 4, 0, ICP, DSPL ;
  ICPSrNrDigit03: 4, 0, ICP, DSPL ;
  ICPSrNrDigit04: 4, 0, ICP, DSPL ;
  ICPSrNrDigit05: 4, 0, ICP, DSPL ;
  ICPSrNrDigit06: 4, 0, ICP, DSPL ;
  ICPSrNrDigit07: 4, 0, ICP, DSPL ;
  ICPSrNrDigit08: 4, 0, ICP, DSPL ;
  ICPSrNrDigit09: 4, 0, ICP, DSPL ;
  ICPSrNrDigit10: 4, 0, ICP, DSPL ;
  ICPSrNrDigit11: 4, 0, ICP, DSPL ;
  ICPSrNrDigit12: 4, 0, ICP, DSPL ;
  ICPSrNrDigit13: 4, 0, ICP, DSPL ;
  DSPLIlluZone: 8, 0, DSPL, ICP ;
  DSPLDimmLvl1: 8, 0, DSPL, ICP ;
  DSPLDimmLvl2: 8, 0, DSPL, ICP ;
  DSPLConfigIndex: 8, 0, DSPL, ICP ;
  DSPLConfigData0: 8, 0, DSPL, ICP ;
  DSPLConfigData1: 8, 0, DSPL, ICP ;
  DSPLConfigData2: 8, 0, DSPL, ICP ;
  DSPLConfigData3: 8, 0, DSPL, ICP ;
  DSPLConfigData4: 8, 0, DSPL, ICP ;
  DSPLConfigData5: 8, 0, DSPL, ICP ;
  DSPLConfigData6: 8, 0, DSPL, ICP ;
  APIMSunroofControl: 4, 0, DSPL, sunroof ;
  APIMSunshadeControl: 4, 0, DSPL, sunroof ;
  SunroofDSPLStatusAntiPinch: 1, 0, sunroof, DSPL ;
  SunroofDSPLStatusPosition: 4, 0, sunroof, DSPL ;
  SunroofDSPLStatusMovement: 3, 0, sunroof, DSPL ;
  SunroofDSPLStatusAntiPinchSS: 1, 0, sunroof, DSPL ;
  SunroofDSPLStatusPositionSS: 4, 0, sunroof, DSPL ;
  SunroofDSPLStatusMovementSS: 3, 0, sunroof, DSPL ;
  SunroofDSPLStatusNetwork: 1, 0, sunroof, DSPL ;
  SunroofDSPLStatusRelay: 1, 0, sunroof, DSPL ;
  SunroofDSPLStatusHallSensor: 1, 0, sunroof, DSPL ;
  SunroofDSPLStatusOvertemp: 1, 0, sunroof, DSPL ;
  SunroofDSPLStatusNormalization: 1, 0, sunroof, DSPL ;
  SunroofDSPLStatusInitialization: 1, 0, sunroof, DSPL ;
  SunroofDSPLStatusLearn: 1, 0, sunroof, DSPL ;
  SunroofDSPLStatusOvervoltage: 1, 0, sunroof ;
  SunroofDSPLStatusUndervoltage: 1, 0, sunroof ;
  SunroofDSPLStatusRelaySS: 1, 0, sunroof, DSPL ;
  SunroofDSPLStatusHallSensorSS: 1, 0, sunroof, DSPL ;
  SunroofDSPLStatusOvertempSS: 1, 0, sunroof, DSPL ;
  SunroofDSPLStatusOvervoltageSS: 1, 0, sunroof ;
  SunroofDSPLStatusUndervoltageSS: 1, 0, sunroof ;
  SunroofDSPLStatusModeSS: 1, 0, sunroof, DSPL ;
  SunroofDSPLStatusNormalizationSS: 1, 0, sunroof, DSPL ;
  SunroofDSPLStatusLearnSS: 1, 0, sunroof, DSPL ;
  SunroofDSPLStatusInitializationSS: 1, 0, sunroof, DSPL ;
  SROvervoltage: 1, 0, sunroof, DSPL ;
  SRUndervoltage: 1, 0, sunroof, DSPL ;
  SSOvervoltage: 1, 0, sunroof, DSPL ;
  SSUndervoltage: 1, 0, sunroof, DSPL ;
  SR_APINFO_4: 1, 0, sunroof, DSPL ;
  SRLINStatus: 3, 0, sunroof, DSPL ;
  DSPLIgnition_Status: 4, 0, DSPL, ICP ;
  DSPL_ACInd: 1, 0, DSPL, ICP ;
  DSPL_RecInd: 1, 0, DSPL, ICP ;
  DSPL_MaxDefInd: 1, 0, DSPL, ICP ;
  DSPL_MaxAcInd: 1, 0, DSPL, ICP ;
  DSPL_BlowerInd: 1, 0, DSPL, ICP ;
}

Frames {
  ICPBtnState: 0, ICP, 8 {
    ICP_APINFO_0, 0 ;
    ICP_APINFO_1, 1 ;
    ICP_APINFO_2, 2 ;
    ICP_APINFO_3, 3 ;
    ICP_APINFO_4, 4 ;
    ICPLINStatus, 5 ;
    ICPBtnID_A, 8 ;
    ICPBtnID_B, 16 ;
    ICPBtnID_C, 24 ;
    ICPBtnID_D, 32 ;
    ICPBtnCoding_A, 40 ;
    ICPBtnCoding_B, 44 ;
    ICPBtnCoding_C, 48 ;
    ICPBtnCoding_D, 52 ;
    ICPVolumeCmd, 56 ;
  }
  DSPLSendSignals: 1, DSPL, 5 {
    DSPLIlluZone, 0 ;
    DSPLDimmLvl1, 8 ;
    DSPLDimmLvl2, 16 ;
    DSPL_ACInd, 24 ;
    DSPL_RecInd, 25 ;
    DSPL_MaxDefInd, 26 ;
    DSPL_MaxAcInd, 27 ;
    DSPL_BlowerInd, 28 ;
    DSPLIgnition_Status, 32 ;
  }
  ICPBtnStateRotary: 2, ICP, 8 {
    ICP_APINFO_0, 0 ;
    ICP_APINFO_1, 1 ;
    ICP_APINFO_2, 2 ;
    ICP_APINFO_3, 3 ;
    ICP_APINFO_4, 4 ;
    ICPLINStatus, 5 ;
    ICPBtnID_A, 8 ;
    ICPBtnID_B, 16 ;
    ICPBtnID_C, 24 ;
    ICPBtnID_D, 32 ;
    ICPBtnCoding_A, 40 ;
    ICPBtnCoding_B, 44 ;
    ICPBtnCoding_C, 48 ;
    ICPBtnCoding_D, 52 ;
    ICPVolumeCmd2, 56 ;
    ICPRotaryCmd, 60 ;
  }
  DSPLConfigCalibrate: 3, DSPL, 8 {
    DSPLConfigIndex, 0 ;
    DSPLConfigData0, 8 ;
    DSPLConfigData1, 16 ;
    DSPLConfigData2, 24 ;
    DSPLConfigData3, 32 ;
    DSPLConfigData4, 40 ;
    DSPLConfigData5, 48 ;
    DSPLConfigData6, 56 ;
  }
  ICPPartNum: 4, ICP, 8 {
    ICP_APINFO_0, 0 ;
    ICP_APINFO_1, 1 ;
    ICP_APINFO_2, 2 ;
    ICP_APINFO_3, 3 ;
    ICP_APINFO_4, 4 ;
    ICPLINStatus, 5 ;
    ICPPartNumIndex, 8 ;
    ICPPartNumData0, 16 ;
    ICPPartNumData1, 24 ;
    ICPPartNumData2, 32 ;
    ICPPartNumData3, 40 ;
    ICPPartNumData4, 48 ;
    ICPPartNumData5, 56 ;
  }
  ICPSerialNum: 5, ICP, 8 {
    ICP_APINFO_0, 0 ;
    ICP_APINFO_1, 1 ;
    ICP_APINFO_2, 2 ;
    ICP_APINFO_3, 3 ;
    ICP_APINFO_4, 4 ;
    ICPLINStatus, 5 ;
    ICPSrNrDigit00, 8 ;
    ICPSrNrDigit01, 12 ;
    ICPSrNrDigit02, 16 ;
    ICPSrNrDigit03, 20 ;
    ICPSrNrDigit04, 24 ;
    ICPSrNrDigit05, 28 ;
    ICPSrNrDigit06, 32 ;
    ICPSrNrDigit07, 36 ;
    ICPSrNrDigit08, 40 ;
    ICPSrNrDigit09, 44 ;
    ICPSrNrDigit10, 48 ;
    ICPSrNrDigit11, 52 ;
    ICPSrNrDigit12, 56 ;
    ICPSrNrDigit13, 60 ;
  }
  DSPLSunroof: 40, DSPL, 2 {
    APIMSunroofControl, 0 ;
    APIMSunshadeControl, 4 ;
  }
  SunroofDSPLStatus: 41, sunroof, 5 {
    SunroofDSPLStatusAntiPinch, 8 ;
    SunroofDSPLStatusPosition, 9 ;
    SunroofDSPLStatusMovement, 13 ;
    SunroofDSPLStatusAntiPinchSS, 16 ;
    SunroofDSPLStatusPositionSS, 17 ;
    SunroofDSPLStatusMovementSS, 21 ;
    SunroofDSPLStatusNetwork, 24 ;
    SunroofDSPLStatusRelay, 25 ;
    SunroofDSPLStatusHallSensor, 26 ;
    SunroofDSPLStatusOvertemp, 27 ;
    SunroofDSPLStatusNormalization, 28 ;
    SunroofDSPLStatusInitialization, 29 ;
    SunroofDSPLStatusLearn, 30 ;
    SunroofDSPLStatusRelaySS, 31 ;
    SunroofDSPLStatusHallSensorSS, 32 ;
    SunroofDSPLStatusOvertempSS, 33 ;
    SunroofDSPLStatusModeSS, 34 ;
    SunroofDSPLStatusNormalizationSS, 35 ;
    SunroofDSPLStatusLearnSS, 36 ;
    SunroofDSPLStatusInitializationSS, 37 ;
    SROvervoltage, 0 ;
    SRUndervoltage, 1 ;
    SSOvervoltage, 2 ;
    SSUndervoltage, 3 ;
    SR_APINFO_4, 4 ;
    SRLINStatus, 5 ;
  }
}

Node_attributes {
  ICP{
    LIN_protocol = "J2602_1_1.0" ;
    configured_NAD = 0x60 ;
    product_id = 0x1000, 0x1000, 100 ;
    response_error = ICPLINStatus ;
    P2_min = 0 ms ;
    ST_min = 0 ms ;
    configurable_frames {
      ICPBtnState = 0x0 ;
      ICPBtnStateRotary = 0x0 ;
      ICPPartNum = 0x0 ;
      ICPSerialNum = 0x0 ;
      DSPLSendSignals = 0x0 ;
      DSPLConfigCalibrate = 0x0 ;
    }
    response_tolerance = 20 % ;
  }
  sunroof{
    LIN_protocol = "J2602_1_1.0" ;
    configured_NAD = 0x64 ;
    product_id = 0x2E, 0x400, 100 ;
    P2_min = 0 ms ;
    ST_min = 0 ms ;
    configurable_frames {
      DSPLSunroof = 0x0 ;
      SunroofDSPLStatus = 0x0 ;
    }
    response_tolerance = 40 % ;
  }
}

Schedule_tables {
 LIN11 {
    ICPBtnState delay 15 ms ;
    DSPLSendSignals delay 15 ms ;
  }
 LIN12 {
    ICPBtnStateRotary delay 15 ms ;
    DSPLSendSignals delay 15 ms ;
  }
 LIN13 {
    ICPBtnStateRotary delay 15 ms ;
  }
 LINConfig1 {
    DSPLConfigCalibrate delay 15 ms ;
    ICPPartNum delay 15 ms ;
    ICPSerialNum delay 15 ms ;
  }
 MRF_schedule {
    MasterReq delay 15 ms ;
  }
 SRF_schedule {
    SlaveResp delay 18 ms ;
  }
 LIN14 {
    DSPLSunroof delay 9 ms ;
  }
 LIN15 {
    SunroofDSPLStatus delay 18 ms ;
  }
}

Signal_encoding_types {
  APIMSunroofControl_Encoding {
    physical_value, 0, 15, 1, 0 ;
    logical_value, 0, "no action" ;
    logical_value, 1, "10%" ;
    logical_value, 2, "20%" ;
    logical_value, 3, "30%" ;
    logical_value, 4, "40%" ;
    logical_value, 5, "50%" ;
    logical_value, 6, "60%" ;
    logical_value, 7, "70%" ;
    logical_value, 8, "80%" ;
    logical_value, 9, "90%" ;
    logical_value, 10, "fully open" ;
    logical_value, 11, "fully close" ;
    logical_value, 12, "tilt up" ;
    logical_value, 13, "comfort" ;
    logical_value, 14, "+10%" ;
    logical_value, 15, "-10%" ;
  }
  APIMSunshadeControl_Encoding {
    physical_value, 0, 15, 1, 0 ;
    logical_value, 0, "no action" ;
    logical_value, 1, "10%" ;
    logical_value, 2, "20%" ;
    logical_value, 3, "30%" ;
    logical_value, 4, "40%" ;
    logical_value, 5, "50%" ;
    logical_value, 6, "60%" ;
    logical_value, 7, "70%" ;
    logical_value, 8, "80%" ;
    logical_value, 9, "90%" ;
    logical_value, 10, "fully open" ;
    logical_value, 11, "fully close" ;
    logical_value, 12, "mid" ;
    logical_value, 13, "+10%" ;
    logical_value, 14, "-10%" ;
    logical_value, 15, "reserved" ;
  }
  DSPL_ACInd_Encoding {
    physical_value, 0, 1, 1, 0 ;
    logical_value, 0, "Off" ;
    logical_value, 1, "On" ;
  }
  DSPL_BlowerInd_Encoding {
    physical_value, 0, 1, 1, 0 ;
    logical_value, 0, "Off" ;
    logical_value, 1, "On" ;
  }
  DSPL_MaxAcInd_Encoding {
    physical_value, 0, 1, 1, 0 ;
    logical_value, 0, "Off" ;
    logical_value, 1, "On" ;
  }
  DSPL_MaxDefInd_Encoding {
    physical_value, 0, 1, 1, 0 ;
    logical_value, 0, "Off" ;
    logical_value, 1, "On" ;
  }
  DSPL_RecInd_Encoding {
    physical_value, 0, 1, 1, 0 ;
    logical_value, 0, "Off" ;
    logical_value, 1, "On" ;
  }
  DSPLDimmLvl_EncodingType {
    physical_value, 0, 255, 1, 0 ;
    logical_value, 0, "Off" ;
    logical_value, 255, "Max" ;
  }
  DSPLIgnition_Status_Encoding {
    physical_value, 0, 15, 1, 0 ;
    logical_value, 0, "Unknown" ;
    logical_value, 1, "Off" ;
    logical_value, 2, "Accessory" ;
    logical_value, 4, "Run" ;
    logical_value, 8, "Start" ;
    logical_value, 15, "Invalid" ;
  }
  DSPLIlluZone_EncodingType {
    physical_value, 0, 255, 1, 0, "bitfield" ;
  }
  ICP_APINFO_0_EncodingType {
    logical_value, 0, "No Vol_Knob Error" ;
    logical_value, 1, "Vol_Knob Error Present" ;
  }
  ICP_APINFO_1_EncodingType {
    logical_value, 0, "No Rotary Error" ;
    logical_value, 1, "Rotary Error Present" ;
  }
  ICP_APINFO_2_EncodingType {
    logical_value, 0, "No Error" ;
    logical_value, 1, "UnderVoltage Event" ;
  }
  ICP_APINFO_3_EncodingType {
    logical_value, 0, "No Error" ;
    logical_value, 1, "OverVoltage Event" ;
  }
  ICP_APINFO_4_EncodingType {
    logical_value, 0, "No Configuration Need" ;
    logical_value, 1, "Configuration Required" ;
  }
  ICPBtnCoding_EncodingType {
    logical_value, 0, "Inactive" ;
    logical_value, 1, "Active" ;
    logical_value, 2, "ShortEvent" ;
    logical_value, 3, "ShortElapsed" ;
    logical_value, 4, "LongEvent" ;
    logical_value, 5, "Stuck" ;
    logical_value, 15, "Idle" ;
  }
  ICPBtnID_EncodingType {
    logical_value, 0, "ICPBtnID_0" ;
    logical_value, 1, "ICPBtnID_1" ;
    logical_value, 2, "ICPBtnID_2" ;
    logical_value, 3, "ICPBtnID_3" ;
    logical_value, 4, "ICPBtnID_4" ;
    logical_value, 5, "ICPBtnID_5" ;
    logical_value, 6, "ICPBtnID_6" ;
    logical_value, 7, "ICPBtnID_7" ;
    logical_value, 8, "ICPBtnID_8" ;
    logical_value, 9, "ICPBtnID_9" ;
    logical_value, 10, "ICPBtnID_Star" ;
    logical_value, 11, "ICPBtnID_Cross" ;
    logical_value, 19, "ICPBtnID_Sirius" ;
    logical_value, 20, "ICPBtnID_Radio" ;
    logical_value, 21, "ICPBtnID_CD" ;
    logical_value, 22, "ICPBtnID_AUX" ;
    logical_value, 23, "ICPBtnID_Menu" ;
    logical_value, 24, "ICPBtnID_Sound" ;
    logical_value, 25, "ICPBtnID_Phone" ;
    logical_value, 26, "ICPBtnID_NAV" ;
    logical_value, 27, "ICPBtnID_Map" ;
    logical_value, 28, "ICPBtnID_Traffic" ;
    logical_value, 29, "ICPBtnID_Clock" ;
    logical_value, 31, "ICPBtnID_OnOff" ;
    logical_value, 40, "ICPBtnID_OK" ;
    logical_value, 41, "ICPBtnID_ArrowLeft" ;
    logical_value, 42, "ICPBtnID_ArrowRight" ;
    logical_value, 43, "ICPBtnID_ArrowUp" ;
    logical_value, 44, "ICPBtnID_ArrowDown" ;
    logical_value, 50, "ICPBtnID_SeekLeft" ;
    logical_value, 51, "ICPBtnID_SeekRight" ;
    logical_value, 52, "ICPBtnID_Eject" ;
    logical_value, 53, "ICPBtnID_Load" ;
    logical_value, 54, "ICPBtnID_TA" ;
    logical_value, 55, "ICPBtnID_Info" ;
    logical_value, 56, "ICPBtnID_Home" ;
    logical_value, 57, "ICPBtnID_Dsp" ;
    logical_value, 58, "ICPBtnID_Mute" ;
    logical_value, 59, "ICPBtnID_DayNight" ;
    logical_value, 60, "ICPBtnID_SKey1" ;
    logical_value, 61, "ICPBtnID_SKey2" ;
    logical_value, 62, "ICPBtnID_SKey3" ;
    logical_value, 63, "ICPBtnID_SKey4" ;
    logical_value, 74, "ICPBtnID_Tune_Up" ;
    logical_value, 75, "ICPBtnID_Tune_Down" ;
    logical_value, 79, "ICPBtnID_Media" ;
    logical_value, 80, "ICPBtnID_Disp" ;
    logical_value, 101, "ICPBtnID_Tune" ;
    logical_value, 102, "ICPBtnID_PlayPause" ;
    logical_value, 103, "ICPBtnID_StarSound" ;
    logical_value, 104, "ICPBtnID_Back" ;
    logical_value, 105, "ICPBtnID_Audio" ;
    logical_value, 106, "ICPBtnID_Settings" ;
    logical_value, 107, "ICPBtnID_Apps" ;
    logical_value, 110, "ICPBtnID_Camera" ;
    logical_value, 111, "ICPBtnID_CalmScreen" ;
    logical_value, 112, "ICPBtnID_DriverAssist" ;
    logical_value, 249, "ICPBtnID_Blower" ;
    logical_value, 250, "ICPBtnID_AC" ;
    logical_value, 251, "ICPBtnID_Rec" ;
    logical_value, 252, "ICPBtnID_MaxDef" ;
    logical_value, 253, "ICPBtnID_MaxAC" ;
    logical_value, 255, "ICPBtnID_Idle" ;
  }
  ICPLINStatus_EncodingType {
    logical_value, 0, "No detected fault" ;
    logical_value, 1, "Reset" ;
    logical_value, 2, "Reserved" ;
    logical_value, 3, "Reserved" ;
    logical_value, 4, "Data Error" ;
    logical_value, 5, "Checksum Error " ;
    logical_value, 6, "Byte Field Framing Error" ;
    logical_value, 7, "ID Parity Error" ;
  }
  ICPRotaryCmd_EncodingType {
    physical_value, 0, 14, 1, -7, "Increment" ;
    logical_value, 7, "Inactive" ;
  }
  ICPSrNrDigit_EnCodingType {
    physical_value, 0, 15, 1, 0, "One Dgit 0 - 9 to be used" ;
  }
  ICPVolumeCmd_EncodingType {
    physical_value, 0, 60, 1, -30, "Increment" ;
    logical_value, 30, "Inactive" ;
  }
  ICPVolumeCmd2_EncodingType {
    physical_value, 0, 14, 1, -7, "Increment" ;
    logical_value, 7, "Inactive" ;
  }
  SR_APINFO_0_Encoding {
    physical_value, 0, 1, 1, 0 ;
    logical_value, 0, "no error" ;
    logical_value, 1, "sunroof over voltage" ;
  }
  SR_APINFO_1_Encoding {
    physical_value, 0, 1, 1, 0 ;
    logical_value, 0, "no error" ;
    logical_value, 1, "sunroof under voltage" ;
  }
  SR_APINFO_2_Encoding {
    physical_value, 0, 1, 1, 0 ;
    logical_value, 0, "no error" ;
    logical_value, 1, "sunshade over voltage" ;
  }
  SR_APINFO_3_Encoding {
    physical_value, 0, 1, 1, 0 ;
    logical_value, 0, "no error" ;
    logical_value, 1, "sunshade under voltage" ;
  }
  SR_APINFO_4_Encoding {
    physical_value, 0, 1, 1, 0 ;
    logical_value, 0, "reserved" ;
    logical_value, 1, "reserved" ;
  }
  SRLINStatus_Encoding {
    physical_value, 0, 7, 1, 0 ;
    logical_value, 0, "no fault" ;
    logical_value, 1, "reset" ;
    logical_value, 2, "reserved" ;
    logical_value, 3, "reserved" ;
    logical_value, 4, "data error" ;
    logical_value, 5, "checksum error" ;
    logical_value, 6, "byte field framing error" ;
    logical_value, 7, "reserved" ;
  }
  SunroofDSPLStatusAntiPinch_Encoding {
    physical_value, 0, 1, 1, 0 ;
    logical_value, 0, "normal" ;
    logical_value, 1, "active" ;
  }
  SunroofDSPLStatusAntiPinchSS_Encoding {
    physical_value, 0, 0, 1, 0 ;
    logical_value, 0, "normal" ;
    logical_value, 1, "active" ;
  }
  SunroofDSPLStatusHallSensor_Encoding {
    physical_value, 0, 1, 1, 0 ;
    logical_value, 0, "no error" ;
    logical_value, 1, "error" ;
  }
  SunroofDSPLStatusHallSensorSS_Encoding {
    physical_value, 0, 1, 1, 0 ;
    logical_value, 0, "no error" ;
    logical_value, 1, "error" ;
  }
  SunroofDSPLStatusInitialization_Encoding {
    physical_value, 0, 1, 1, 0 ;
    logical_value, 0, "not in the initializating" ;
    logical_value, 1, "in the initializating" ;
  }
  SunroofDSPLStatusInitializationSS_Encoding {
    physical_value, 0, 0, 1, 0 ;
    logical_value, 0, "not in the Initializating" ;
    logical_value, 1, "in the Initializating" ;
  }
  SunroofDSPLStatusLearn_Encoding {
    physical_value, 0, 1, 1, 0 ;
    logical_value, 0, "no teach run" ;
    logical_value, 1, "teach run successful" ;
  }
  SunroofDSPLStatusLearnSS_Encoding {
    physical_value, 0, 1, 1, 0 ;
    logical_value, 0, "not teach run" ;
    logical_value, 1, "teach run successful" ;
  }
  SunroofDSPLStatusModeSS_Encoding {
    physical_value, 0, 1, 1, 0 ;
    logical_value, 0, "nomal(delay ACC = H)" ;
    logical_value, 1, "standby(delay ACC = L)" ;
  }
  SunroofDSPLStatusMovement_Encoding {
    physical_value, 0, 7, 1, 0 ;
    logical_value, 0, "stopped" ;
    logical_value, 1, "opening tilt" ;
    logical_value, 2, "closing tilt" ;
    logical_value, 3, "opening slide" ;
    logical_value, 4, "closing slide" ;
    logical_value, 5, "reversing(AP/stall)" ;
    logical_value, 6, "moving uninitialized" ;
    logical_value, 7, "reserved" ;
  }
  SunroofDSPLStatusMovementSS_Encoding {
    physical_value, 0, 7, 1, 0 ;
    logical_value, 0, "stopped" ;
    logical_value, 1, "Reserved" ;
    logical_value, 2, "Reserved" ;
    logical_value, 3, "opening slide" ;
    logical_value, 4, "closing slide" ;
    logical_value, 5, "reversing" ;
    logical_value, 6, "moving uninitialized" ;
    logical_value, 7, "reserved" ;
  }
  SunroofDSPLStatusNetworkl_Encoding {
    physical_value, 0, 1, 1, 0 ;
    logical_value, 0, "no error" ;
    logical_value, 1, "error" ;
  }
  SunroofDSPLStatusNormalization_Encoding {
    physical_value, 0, 1, 1, 0 ;
    logical_value, 0, "not normalized" ;
    logical_value, 1, "normalized" ;
  }
  SunroofDSPLStatusNormalizationSS_Encoding {
    physical_value, 0, 1, 1, 0 ;
    logical_value, 0, "not normalized" ;
    logical_value, 1, "normalized" ;
  }
  SunroofDSPLStatusOvertemp_Encoding {
    physical_value, 0, 1, 1, 0 ;
    logical_value, 0, "no error" ;
    logical_value, 1, "error" ;
  }
  SunroofDSPLStatusOvertempSS_Encoding {
    physical_value, 0, 1, 1, 0 ;
    logical_value, 0, "no error" ;
    logical_value, 1, "error" ;
  }
  SunroofDSPLStatusOvervoltage_Encoding {
    physical_value, 0, 1, 1, 0 ;
    logical_value, 0, "no error" ;
    logical_value, 1, "error" ;
  }
  SunroofDSPLStatusOvervoltageSS_Encoding {
    physical_value, 0, 1, 1, 0 ;
    logical_value, 0, "no error" ;
    logical_value, 1, "error" ;
  }
  SunroofDSPLStatusPosition_Encoding {
    physical_value, 0, 15, 1, 0 ;
    logical_value, 0, "init" ;
    logical_value, 1, "10%" ;
    logical_value, 2, "20%" ;
    logical_value, 3, "30%" ;
    logical_value, 4, "40%" ;
    logical_value, 5, "50%" ;
    logical_value, 6, "60%" ;
    logical_value, 7, "70%" ;
    logical_value, 8, "80%" ;
    logical_value, 9, "90%" ;
    logical_value, 10, "fully open" ;
    logical_value, 11, "fully close" ;
    logical_value, 12, "tilt up" ;
    logical_value, 13, "vent area" ;
    logical_value, 14, "uninitialized" ;
    logical_value, 15, "comfort" ;
  }
  SunroofDSPLStatusPositionSS_Encoding {
    physical_value, 0, 15, 1, 0 ;
    logical_value, 0, "init" ;
    logical_value, 1, "10%" ;
    logical_value, 2, "20%" ;
    logical_value, 3, "30%" ;
    logical_value, 4, "40%" ;
    logical_value, 5, "50%" ;
    logical_value, 6, "60%" ;
    logical_value, 7, "70%" ;
    logical_value, 8, "80%" ;
    logical_value, 9, "90%" ;
    logical_value, 10, "fully open" ;
    logical_value, 11, "fully close" ;
    logical_value, 12, "reserved" ;
    logical_value, 13, "reserved" ;
    logical_value, 14, "uninitiallized" ;
    logical_value, 15, "mid" ;
  }
  SunroofDSPLStatusRelay_Encoding {
    physical_value, 0, 1, 1, 0 ;
    logical_value, 0, "no error" ;
    logical_value, 1, "error" ;
  }
  SunroofDSPLStatusRelaySS_Encoding {
    physical_value, 0, 1, 1, 0 ;
    logical_value, 0, "no error" ;
    logical_value, 1, "error" ;
  }
  SunroofDSPLStatusUndervoltage_Encoding {
    physical_value, 0, 1, 1, 0 ;
    logical_value, 0, "no error" ;
    logical_value, 1, "error" ;
  }
  SunroofDSPLStatusUndervoltageSS_Encoding {
    physical_value, 0, 1, 1, 0 ;
    logical_value, 0, "no error" ;
    logical_value, 1, "error" ;
  }
}

Signal_representation {
  APIMSunroofControl_Encoding: APIMSunroofControl ;
  APIMSunshadeControl_Encoding: APIMSunshadeControl ;
  DSPL_ACInd_Encoding: DSPL_ACInd ;
  DSPL_BlowerInd_Encoding: DSPL_BlowerInd ;
  DSPL_MaxAcInd_Encoding: DSPL_MaxAcInd ;
  DSPL_MaxDefInd_Encoding: DSPL_MaxDefInd ;
  DSPL_RecInd_Encoding: DSPL_RecInd ;
  DSPLDimmLvl_EncodingType: DSPLDimmLvl1, DSPLDimmLvl2 ;
  DSPLIgnition_Status_Encoding: DSPLIgnition_Status ;
  DSPLIlluZone_EncodingType: DSPLIlluZone ;
  ICP_APINFO_0_EncodingType: ICP_APINFO_0 ;
  ICP_APINFO_1_EncodingType: ICP_APINFO_1 ;
  ICP_APINFO_2_EncodingType: ICP_APINFO_2 ;
  ICP_APINFO_3_EncodingType: ICP_APINFO_3 ;
  ICP_APINFO_4_EncodingType: ICP_APINFO_4 ;
  ICPBtnCoding_EncodingType: ICPBtnCoding_A, ICPBtnCoding_B, ICPBtnCoding_C, ICPBtnCoding_D ;
  ICPBtnID_EncodingType: ICPBtnID_A, ICPBtnID_B, ICPBtnID_C, ICPBtnID_D ;
  ICPLINStatus_EncodingType: ICPLINStatus ;
  ICPRotaryCmd_EncodingType: ICPRotaryCmd ;
  ICPSrNrDigit_EnCodingType: ICPSrNrDigit00, ICPSrNrDigit01, ICPSrNrDigit02, ICPSrNrDigit03, ICPSrNrDigit04, ICPSrNrDigit05, ICPSrNrDigit06, ICPSrNrDigit07, ICPSrNrDigit08, ICPSrNrDigit09, ICPSrNrDigit10, ICPSrNrDigit11, ICPSrNrDigit12, ICPSrNrDigit13 ;
  ICPVolumeCmd_EncodingType: ICPVolumeCmd ;
  ICPVolumeCmd2_EncodingType: ICPVolumeCmd2 ;
  SR_APINFO_0_Encoding: SROvervoltage ;
  SR_APINFO_1_Encoding: SRUndervoltage ;
  SR_APINFO_2_Encoding: SSOvervoltage ;
  SR_APINFO_3_Encoding: SSUndervoltage ;
  SR_APINFO_4_Encoding: SR_APINFO_4 ;
  SRLINStatus_Encoding: SRLINStatus ;
  SunroofDSPLStatusAntiPinch_Encoding: SunroofDSPLStatusAntiPinch ;
  SunroofDSPLStatusAntiPinchSS_Encoding: SunroofDSPLStatusAntiPinchSS ;
  SunroofDSPLStatusHallSensor_Encoding: SunroofDSPLStatusHallSensor ;
  SunroofDSPLStatusHallSensorSS_Encoding: SunroofDSPLStatusHallSensorSS ;
  SunroofDSPLStatusInitialization_Encoding: SunroofDSPLStatusInitialization ;
  SunroofDSPLStatusInitializationSS_Encoding: SunroofDSPLStatusInitializationSS ;
  SunroofDSPLStatusLearn_Encoding: SunroofDSPLStatusLearn ;
  SunroofDSPLStatusLearnSS_Encoding: SunroofDSPLStatusLearnSS ;
  SunroofDSPLStatusModeSS_Encoding: SunroofDSPLStatusModeSS ;
  SunroofDSPLStatusMovement_Encoding: SunroofDSPLStatusMovement ;
  SunroofDSPLStatusMovementSS_Encoding: SunroofDSPLStatusMovementSS ;
  SunroofDSPLStatusNetworkl_Encoding: SunroofDSPLStatusNetwork ;
  SunroofDSPLStatusNormalization_Encoding: SunroofDSPLStatusNormalization ;
  SunroofDSPLStatusNormalizationSS_Encoding: SunroofDSPLStatusNormalizationSS ;
  SunroofDSPLStatusOvertemp_Encoding: SunroofDSPLStatusOvertemp ;
  SunroofDSPLStatusOvertempSS_Encoding: SunroofDSPLStatusOvertempSS ;
  SunroofDSPLStatusOvervoltage_Encoding: SunroofDSPLStatusOvervoltage ;
  SunroofDSPLStatusOvervoltageSS_Encoding: SunroofDSPLStatusOvervoltageSS ;
  SunroofDSPLStatusPosition_Encoding: SunroofDSPLStatusPosition ;
  SunroofDSPLStatusPositionSS_Encoding: SunroofDSPLStatusPositionSS ;
  SunroofDSPLStatusRelay_Encoding: SunroofDSPLStatusRelay ;
  SunroofDSPLStatusRelaySS_Encoding: SunroofDSPLStatusRelaySS ;
  SunroofDSPLStatusUndervoltage_Encoding: SunroofDSPLStatusUndervoltage ;
  SunroofDSPLStatusUndervoltageSS_Encoding: SunroofDSPLStatusUndervoltageSS ;
}
